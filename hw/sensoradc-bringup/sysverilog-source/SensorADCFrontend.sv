// Generated by CIRCT unknown git version
// Standard header to adapt well known macros for register randomization.
`ifndef RANDOMIZE
  `ifdef RANDOMIZE_MEM_INIT
    `define RANDOMIZE
  `endif // RANDOMIZE_MEM_INIT
`endif // not def RANDOMIZE
`ifndef RANDOMIZE
  `ifdef RANDOMIZE_REG_INIT
    `define RANDOMIZE
  `endif // RANDOMIZE_REG_INIT
`endif // not def RANDOMIZE

// RANDOM may be set to an expression that produces a 32-bit random unsigned value.
`ifndef RANDOM
  `define RANDOM $random
`endif // not def RANDOM

// Users can define INIT_RANDOM as general code that gets injected into the
// initializer block for modules with registers.
`ifndef INIT_RANDOM
  `define INIT_RANDOM
`endif // not def INIT_RANDOM

// If using random initialization, you can also define RANDOMIZE_DELAY to
// customize the delay used, otherwise 0.002 is used.
`ifndef RANDOMIZE_DELAY
  `define RANDOMIZE_DELAY 0.002
`endif // not def RANDOMIZE_DELAY

// Define INIT_RANDOM_PROLOG_ for use in our modules below.
`ifndef INIT_RANDOM_PROLOG_
  `ifdef RANDOMIZE
    `ifdef VERILATOR
      `define INIT_RANDOM_PROLOG_ `INIT_RANDOM
    `else  // VERILATOR
      `define INIT_RANDOM_PROLOG_ `INIT_RANDOM #`RANDOMIZE_DELAY begin end
    `endif // VERILATOR
  `else  // RANDOMIZE
    `define INIT_RANDOM_PROLOG_
  `endif // RANDOMIZE
`endif // not def INIT_RANDOM_PROLOG_

// Include register initializers in init blocks unless synthesis is set
`ifndef SYNTHESIS
  `ifndef ENABLE_INITIAL_REG_
    `define ENABLE_INITIAL_REG_
  `endif // not def ENABLE_INITIAL_REG_
`endif // not def SYNTHESIS

// Include rmemory initializers in init blocks unless synthesis is set
`ifndef SYNTHESIS
  `ifndef ENABLE_INITIAL_MEM_
    `define ENABLE_INITIAL_MEM_
  `endif // not def ENABLE_INITIAL_MEM_
`endif // not def SYNTHESIS

// Standard header to adapt well known macros for prints and assertions.

// Users can define 'PRINTF_COND' to add an extra gate to prints.
`ifndef PRINTF_COND_
  `ifdef PRINTF_COND
    `define PRINTF_COND_ (`PRINTF_COND)
  `else  // PRINTF_COND
    `define PRINTF_COND_ 1
  `endif // PRINTF_COND
`endif // not def PRINTF_COND_

module SensorADCFrontend(
  input         clock,
                reset,
  output        auto_control_xing_in_a_ready,	// @[generators/rocket-chip/src/main/scala/diplomacy/LazyModule.scala:366:18]
  input         auto_control_xing_in_a_valid,	// @[generators/rocket-chip/src/main/scala/diplomacy/LazyModule.scala:366:18]
  input  [2:0]  auto_control_xing_in_a_bits_opcode,	// @[generators/rocket-chip/src/main/scala/diplomacy/LazyModule.scala:366:18]
                auto_control_xing_in_a_bits_param,	// @[generators/rocket-chip/src/main/scala/diplomacy/LazyModule.scala:366:18]
  input  [1:0]  auto_control_xing_in_a_bits_size,	// @[generators/rocket-chip/src/main/scala/diplomacy/LazyModule.scala:366:18]
  input  [15:0] auto_control_xing_in_a_bits_source,	// @[generators/rocket-chip/src/main/scala/diplomacy/LazyModule.scala:366:18]
                auto_control_xing_in_a_bits_address,	// @[generators/rocket-chip/src/main/scala/diplomacy/LazyModule.scala:366:18]
  input  [3:0]  auto_control_xing_in_a_bits_mask,	// @[generators/rocket-chip/src/main/scala/diplomacy/LazyModule.scala:366:18]
  input  [31:0] auto_control_xing_in_a_bits_data,	// @[generators/rocket-chip/src/main/scala/diplomacy/LazyModule.scala:366:18]
  input         auto_control_xing_in_a_bits_corrupt,	// @[generators/rocket-chip/src/main/scala/diplomacy/LazyModule.scala:366:18]
                auto_control_xing_in_d_ready,	// @[generators/rocket-chip/src/main/scala/diplomacy/LazyModule.scala:366:18]
  output        auto_control_xing_in_d_valid,	// @[generators/rocket-chip/src/main/scala/diplomacy/LazyModule.scala:366:18]
  output [2:0]  auto_control_xing_in_d_bits_opcode,	// @[generators/rocket-chip/src/main/scala/diplomacy/LazyModule.scala:366:18]
  output [1:0]  auto_control_xing_in_d_bits_size,	// @[generators/rocket-chip/src/main/scala/diplomacy/LazyModule.scala:366:18]
  output [15:0] auto_control_xing_in_d_bits_source,	// @[generators/rocket-chip/src/main/scala/diplomacy/LazyModule.scala:366:18]
  output [31:0] auto_control_xing_in_d_bits_data,	// @[generators/rocket-chip/src/main/scala/diplomacy/LazyModule.scala:366:18]
  output        io_backend_status_status0_ready,	// @[generators/scumv-sensor-adc/src/main/scala/sensoradc/SensorADC.scala:103:13]
  input         io_backend_status_status0_valid,	// @[generators/scumv-sensor-adc/src/main/scala/sensoradc/SensorADC.scala:103:13]
  input  [31:0] io_backend_status_status0_bits,	// @[generators/scumv-sensor-adc/src/main/scala/sensoradc/SensorADC.scala:103:13]
                io_backend_status_status1_bits,	// @[generators/scumv-sensor-adc/src/main/scala/sensoradc/SensorADC.scala:103:13]
                io_backend_status_status2_bits,	// @[generators/scumv-sensor-adc/src/main/scala/sensoradc/SensorADC.scala:103:13]
                io_backend_status_status3_bits,	// @[generators/scumv-sensor-adc/src/main/scala/sensoradc/SensorADC.scala:103:13]
                io_backend_status_status4_bits,	// @[generators/scumv-sensor-adc/src/main/scala/sensoradc/SensorADC.scala:103:13]
                io_backend_status_status5_bits,	// @[generators/scumv-sensor-adc/src/main/scala/sensoradc/SensorADC.scala:103:13]
  output        io_backend_adc_data_out_ready,	// @[generators/scumv-sensor-adc/src/main/scala/sensoradc/SensorADC.scala:103:13]
  input         io_backend_adc_data_out_valid,	// @[generators/scumv-sensor-adc/src/main/scala/sensoradc/SensorADC.scala:103:13]
  input  [19:0] io_backend_adc_data_out_bits,	// @[generators/scumv-sensor-adc/src/main/scala/sensoradc/SensorADC.scala:103:13]
  output        io_backend_chopper_control_chopper_div_1_valid,	// @[generators/scumv-sensor-adc/src/main/scala/sensoradc/SensorADC.scala:103:13]
  output [24:0] io_backend_chopper_control_chopper_div_1_bits,	// @[generators/scumv-sensor-adc/src/main/scala/sensoradc/SensorADC.scala:103:13]
  output        io_backend_chopper_control_chopper_div_2_valid,	// @[generators/scumv-sensor-adc/src/main/scala/sensoradc/SensorADC.scala:103:13]
  output [24:0] io_backend_chopper_control_chopper_div_2_bits,	// @[generators/scumv-sensor-adc/src/main/scala/sensoradc/SensorADC.scala:103:13]
  output        io_backend_chopper_control_chopper_clock_en_valid,	// @[generators/scumv-sensor-adc/src/main/scala/sensoradc/SensorADC.scala:103:13]
  output [1:0]  io_backend_chopper_control_chopper_clock_en_bits,	// @[generators/scumv-sensor-adc/src/main/scala/sensoradc/SensorADC.scala:103:13]
  output        io_backend_dsp_control_valid,	// @[generators/scumv-sensor-adc/src/main/scala/sensoradc/SensorADC.scala:103:13]
  output [7:0]  io_backend_dsp_control_bits,	// @[generators/scumv-sensor-adc/src/main/scala/sensoradc/SensorADC.scala:103:13]
  output        io_backend_auto_mux,	// @[generators/scumv-sensor-adc/src/main/scala/sensoradc/SensorADC.scala:103:13]
  output [31:0] io_tuning_adc_tuning	// @[generators/scumv-sensor-adc/src/main/scala/sensoradc/SensorADC.scala:103:13]
);

  reg  [7:0]  tuning_0;	// @[generators/scumv-sensor-adc/src/main/scala/sensoradc/SensorADC.scala:108:25]
  reg  [7:0]  tuning_1;	// @[generators/scumv-sensor-adc/src/main/scala/sensoradc/SensorADC.scala:109:25]
  reg  [7:0]  tuning_2;	// @[generators/scumv-sensor-adc/src/main/scala/sensoradc/SensorADC.scala:111:25]
  reg  [7:0]  tuning_3;	// @[generators/scumv-sensor-adc/src/main/scala/sensoradc/SensorADC.scala:112:25]
  reg  [7:0]  auto_mux;	// @[generators/scumv-sensor-adc/src/main/scala/sensoradc/SensorADC.scala:136:25]
  wire        in_bits_read = auto_control_xing_in_a_bits_opcode == 3'h4;	// @[generators/rocket-chip/src/main/scala/tilelink/RegisterRouter.scala:69:36]
  wire [31:0] out_backMask = {{8{auto_control_xing_in_a_bits_mask[3]}}, {8{auto_control_xing_in_a_bits_mask[2]}}, {8{auto_control_xing_in_a_bits_mask[1]}}, {8{auto_control_xing_in_a_bits_mask[0]}}};	// @[generators/rocket-chip/src/main/scala/tilelink/RegisterRouter.scala:82:24]
  wire        _GEN = auto_control_xing_in_a_bits_address[5:2] == 4'h1;	// @[generators/rocket-chip/src/main/scala/tilelink/RegisterRouter.scala:82:24, generators/rocket-chip/src/main/scala/util/MuxLiteral.scala:49:10]
  wire        _GEN_0 = auto_control_xing_in_a_bits_address[5:2] == 4'h2;	// @[generators/rocket-chip/src/main/scala/tilelink/RegisterRouter.scala:82:24, generators/rocket-chip/src/main/scala/util/MuxLiteral.scala:49:10]
  wire        _GEN_1 = auto_control_xing_in_a_bits_address[5:2] == 4'h3;	// @[generators/rocket-chip/src/main/scala/tilelink/RegisterRouter.scala:82:24, generators/rocket-chip/src/main/scala/util/MuxLiteral.scala:49:10]
  wire        _GEN_2 = auto_control_xing_in_a_bits_address[5:2] == 4'h4;	// @[generators/rocket-chip/src/main/scala/tilelink/RegisterRouter.scala:82:24, generators/rocket-chip/src/main/scala/util/MuxLiteral.scala:49:10]
  wire        _GEN_3 = auto_control_xing_in_a_bits_address[5:2] == 4'h5;	// @[generators/rocket-chip/src/main/scala/tilelink/RegisterRouter.scala:82:24, generators/rocket-chip/src/main/scala/util/MuxLiteral.scala:49:10]
  wire        _GEN_4 = auto_control_xing_in_a_bits_address[5:2] == 4'h6;	// @[generators/rocket-chip/src/main/scala/tilelink/RegisterRouter.scala:82:24, generators/rocket-chip/src/main/scala/util/MuxLiteral.scala:49:10]
  wire        _GEN_5 = auto_control_xing_in_a_bits_address[5:2] == 4'h7;	// @[generators/rocket-chip/src/main/scala/tilelink/RegisterRouter.scala:82:24, generators/rocket-chip/src/main/scala/util/MuxLiteral.scala:49:10]
  wire        _GEN_6 = auto_control_xing_in_a_bits_address[5:2] == 4'h8;	// @[generators/rocket-chip/src/main/scala/tilelink/RegisterRouter.scala:82:24, generators/rocket-chip/src/main/scala/util/MuxLiteral.scala:49:10]
  wire        _GEN_7 = auto_control_xing_in_a_bits_address[5:2] == 4'h9;	// @[generators/rocket-chip/src/main/scala/tilelink/RegisterRouter.scala:82:24, generators/rocket-chip/src/main/scala/util/MuxLiteral.scala:49:10]
  wire        _GEN_8 = auto_control_xing_in_a_bits_address[5:2] == 4'hA;	// @[generators/rocket-chip/src/main/scala/tilelink/RegisterRouter.scala:82:24, generators/rocket-chip/src/main/scala/util/MuxLiteral.scala:49:10]
  wire        _GEN_9 = auto_control_xing_in_a_bits_address[5:2] == 4'hB;	// @[generators/rocket-chip/src/main/scala/tilelink/RegisterRouter.scala:82:24, generators/rocket-chip/src/main/scala/util/MuxLiteral.scala:49:10]
  wire        _GEN_10 = auto_control_xing_in_a_bits_address[5:2] == 4'hC;	// @[generators/rocket-chip/src/main/scala/tilelink/RegisterRouter.scala:82:24, generators/rocket-chip/src/main/scala/util/MuxLiteral.scala:49:10]
  wire        _GEN_11 = auto_control_xing_in_a_bits_address[5:2] == 4'hD;	// @[generators/rocket-chip/src/main/scala/tilelink/RegisterRouter.scala:82:24, generators/rocket-chip/src/main/scala/util/MuxLiteral.scala:49:10]
  wire        _GEN_12 = auto_control_xing_in_a_bits_address[5:2] == 4'hE;	// @[generators/rocket-chip/src/main/scala/tilelink/RegisterRouter.scala:82:24, generators/rocket-chip/src/main/scala/util/MuxLiteral.scala:49:10]
  wire        out_oready = ~in_bits_read | (&(auto_control_xing_in_a_bits_address[5:2])) | _GEN_12 | _GEN_11 | _GEN_10 | _GEN_9 | _GEN_8 | _GEN_7 | _GEN_6 | _GEN_5 | _GEN_4 | _GEN_3 | _GEN_2 | _GEN_1 | _GEN_0 | (_GEN ? io_backend_status_status0_valid | ~(|out_backMask) | (|(auto_control_xing_in_a_bits_address[11:6])) : io_backend_adc_data_out_valid | ~(|out_backMask) | (|(auto_control_xing_in_a_bits_address[11:6])));	// @[generators/rocket-chip/src/main/scala/tilelink/Edges.scala:192:34, generators/rocket-chip/src/main/scala/tilelink/RegisterRouter.scala:69:36, :82:24, generators/rocket-chip/src/main/scala/tilelink/RegisterRouter.scala 68:18:70:19, generators/rocket-chip/src/main/scala/util/MuxLiteral.scala:49:10]
  wire        buffer_nodeIn_a_ready = auto_control_xing_in_d_ready & out_oready;	// @[generators/rocket-chip/src/main/scala/tilelink/RegisterRouter.scala:82:24]
  wire        _out_wofireMux_T = auto_control_xing_in_a_valid & auto_control_xing_in_d_ready;	// @[generators/rocket-chip/src/main/scala/tilelink/RegisterRouter.scala:82:24]
  wire        _out_rofireMux_T_1 = _out_wofireMux_T & in_bits_read;	// @[generators/rocket-chip/src/main/scala/tilelink/RegisterRouter.scala:69:36, :82:24]
  wire        _out_wofireMux_T_2 = _out_wofireMux_T & ~in_bits_read;	// @[generators/rocket-chip/src/main/scala/tilelink/RegisterRouter.scala:69:36, :82:24]
  wire        buffer_nodeIn_d_valid = auto_control_xing_in_a_valid & out_oready;	// @[generators/rocket-chip/src/main/scala/tilelink/RegisterRouter.scala:82:24]
  wire [2:0]  buffer_nodeIn_d_bits_opcode = {2'h0, in_bits_read};	// @[generators/rocket-chip/src/main/scala/diplomacy/Nodes.scala:1214:17, generators/rocket-chip/src/main/scala/tilelink/RegisterRouter.scala:69:36, :100:19]
  wire        out_woready_9 = _out_wofireMux_T_2 & auto_control_xing_in_a_bits_address[5:2] == 4'h7 & ~(|(auto_control_xing_in_a_bits_address[11:6]));	// @[generators/rocket-chip/src/main/scala/tilelink/Edges.scala:192:34, generators/rocket-chip/src/main/scala/tilelink/RegisterRouter.scala:82:24, generators/rocket-chip/src/main/scala/tilelink/RegisterRouter.scala 68:18:70:19, generators/rocket-chip/src/main/scala/util/MuxLiteral.scala:49:10]
  always @(posedge clock) begin
    if (reset) begin
      tuning_0 <= 8'h0;	// @[generators/rocket-chip/src/main/scala/tilelink/RegisterRouter.scala:82:24, generators/scumv-sensor-adc/src/main/scala/sensoradc/SensorADC.scala:108:25]
      tuning_1 <= 8'h0;	// @[generators/rocket-chip/src/main/scala/tilelink/RegisterRouter.scala:82:24, generators/scumv-sensor-adc/src/main/scala/sensoradc/SensorADC.scala:109:25]
      tuning_2 <= 8'h0;	// @[generators/rocket-chip/src/main/scala/tilelink/RegisterRouter.scala:82:24, generators/scumv-sensor-adc/src/main/scala/sensoradc/SensorADC.scala:111:25]
      tuning_3 <= 8'h0;	// @[generators/rocket-chip/src/main/scala/tilelink/RegisterRouter.scala:82:24, generators/scumv-sensor-adc/src/main/scala/sensoradc/SensorADC.scala:112:25]
      auto_mux <= 8'h0;	// @[generators/rocket-chip/src/main/scala/tilelink/RegisterRouter.scala:82:24, generators/scumv-sensor-adc/src/main/scala/sensoradc/SensorADC.scala:136:25]
    end
    else begin
      if (out_woready_9 & auto_control_xing_in_a_bits_mask[0])	// @[generators/rocket-chip/src/main/scala/tilelink/RegisterRouter.scala:82:24]
        tuning_0 <= auto_control_xing_in_a_bits_data[7:0];	// @[generators/rocket-chip/src/main/scala/tilelink/RegisterRouter.scala:82:24, generators/scumv-sensor-adc/src/main/scala/sensoradc/SensorADC.scala:108:25]
      if (out_woready_9 & auto_control_xing_in_a_bits_mask[1])	// @[generators/rocket-chip/src/main/scala/tilelink/RegisterRouter.scala:82:24]
        tuning_1 <= auto_control_xing_in_a_bits_data[15:8];	// @[generators/rocket-chip/src/main/scala/tilelink/RegisterRouter.scala:82:24, generators/scumv-sensor-adc/src/main/scala/sensoradc/SensorADC.scala:109:25]
      if (out_woready_9 & auto_control_xing_in_a_bits_mask[2])	// @[generators/rocket-chip/src/main/scala/tilelink/RegisterRouter.scala:82:24]
        tuning_2 <= auto_control_xing_in_a_bits_data[23:16];	// @[generators/rocket-chip/src/main/scala/tilelink/RegisterRouter.scala:82:24, generators/scumv-sensor-adc/src/main/scala/sensoradc/SensorADC.scala:111:25]
      if (out_woready_9 & auto_control_xing_in_a_bits_mask[3])	// @[generators/rocket-chip/src/main/scala/tilelink/RegisterRouter.scala:82:24]
        tuning_3 <= auto_control_xing_in_a_bits_data[31:24];	// @[generators/rocket-chip/src/main/scala/tilelink/RegisterRouter.scala:82:24, generators/scumv-sensor-adc/src/main/scala/sensoradc/SensorADC.scala:112:25]
      if (_out_wofireMux_T_2 & auto_control_xing_in_a_bits_address[5:2] == 4'hC & ~(|(auto_control_xing_in_a_bits_address[11:6])) & auto_control_xing_in_a_bits_mask[0])	// @[generators/rocket-chip/src/main/scala/tilelink/Edges.scala:192:34, generators/rocket-chip/src/main/scala/tilelink/RegisterRouter.scala:82:24, generators/rocket-chip/src/main/scala/tilelink/RegisterRouter.scala 68:18:70:19, generators/rocket-chip/src/main/scala/util/MuxLiteral.scala:49:10]
        auto_mux <= auto_control_xing_in_a_bits_data[7:0];	// @[generators/rocket-chip/src/main/scala/tilelink/RegisterRouter.scala:82:24, generators/scumv-sensor-adc/src/main/scala/sensoradc/SensorADC.scala:136:25]
    end
  end // always @(posedge)
  `ifdef ENABLE_INITIAL_REG_
    `ifdef FIRRTL_BEFORE_INITIAL
      `FIRRTL_BEFORE_INITIAL
    `endif // FIRRTL_BEFORE_INITIAL
    logic [31:0] _RANDOM[0:1];
    initial begin
      `ifdef INIT_RANDOM_PROLOG_
        `INIT_RANDOM_PROLOG_
      `endif // INIT_RANDOM_PROLOG_
      `ifdef RANDOMIZE_REG_INIT
        for (logic [1:0] i = 2'h0; i < 2'h2; i += 2'h1) begin
          _RANDOM[i[0]] = `RANDOM;
        end
        tuning_0 = _RANDOM[1'h0][7:0];	// @[generators/scumv-sensor-adc/src/main/scala/sensoradc/SensorADC.scala:108:25]
        tuning_1 = _RANDOM[1'h0][15:8];	// @[generators/scumv-sensor-adc/src/main/scala/sensoradc/SensorADC.scala:108:25, :109:25]
        tuning_2 = _RANDOM[1'h0][23:16];	// @[generators/scumv-sensor-adc/src/main/scala/sensoradc/SensorADC.scala:108:25, :111:25]
        tuning_3 = _RANDOM[1'h0][31:24];	// @[generators/scumv-sensor-adc/src/main/scala/sensoradc/SensorADC.scala:108:25, :112:25]
        auto_mux = _RANDOM[1'h1][7:0];	// @[generators/scumv-sensor-adc/src/main/scala/sensoradc/SensorADC.scala:136:25]
      `endif // RANDOMIZE_REG_INIT
    end // initial
    `ifdef FIRRTL_AFTER_INITIAL
      `FIRRTL_AFTER_INITIAL
    `endif // FIRRTL_AFTER_INITIAL
  `endif // ENABLE_INITIAL_REG_
  TLMonitor_84 monitor (	// @[generators/rocket-chip/src/main/scala/tilelink/Nodes.scala:24:25]
    .clock                (clock),
    .reset                (reset),
    .io_in_a_ready        (buffer_nodeIn_a_ready),	// @[generators/rocket-chip/src/main/scala/tilelink/RegisterRouter.scala:82:24]
    .io_in_a_valid        (auto_control_xing_in_a_valid),
    .io_in_a_bits_opcode  (auto_control_xing_in_a_bits_opcode),
    .io_in_a_bits_param   (auto_control_xing_in_a_bits_param),
    .io_in_a_bits_size    (auto_control_xing_in_a_bits_size),
    .io_in_a_bits_source  (auto_control_xing_in_a_bits_source),
    .io_in_a_bits_address (auto_control_xing_in_a_bits_address),
    .io_in_a_bits_mask    (auto_control_xing_in_a_bits_mask),
    .io_in_a_bits_corrupt (auto_control_xing_in_a_bits_corrupt),
    .io_in_d_ready        (auto_control_xing_in_d_ready),
    .io_in_d_valid        (buffer_nodeIn_d_valid),	// @[generators/rocket-chip/src/main/scala/tilelink/RegisterRouter.scala:82:24]
    .io_in_d_bits_opcode  (buffer_nodeIn_d_bits_opcode),	// @[generators/rocket-chip/src/main/scala/diplomacy/Nodes.scala:1214:17, generators/rocket-chip/src/main/scala/tilelink/RegisterRouter.scala:100:19]
    .io_in_d_bits_size    (auto_control_xing_in_a_bits_size),
    .io_in_d_bits_source  (auto_control_xing_in_a_bits_source)
  );
  assign auto_control_xing_in_a_ready = buffer_nodeIn_a_ready;	// @[generators/rocket-chip/src/main/scala/tilelink/RegisterRouter.scala:82:24]
  assign auto_control_xing_in_d_valid = buffer_nodeIn_d_valid;	// @[generators/rocket-chip/src/main/scala/tilelink/RegisterRouter.scala:82:24]
  assign auto_control_xing_in_d_bits_opcode = buffer_nodeIn_d_bits_opcode;	// @[generators/rocket-chip/src/main/scala/diplomacy/Nodes.scala:1214:17, generators/rocket-chip/src/main/scala/tilelink/RegisterRouter.scala:100:19]
  assign auto_control_xing_in_d_bits_size = auto_control_xing_in_a_bits_size;
  assign auto_control_xing_in_d_bits_source = auto_control_xing_in_a_bits_source;
  assign auto_control_xing_in_d_bits_data = ~((&(auto_control_xing_in_a_bits_address[5:2])) | _GEN_12 | _GEN_11 | ~(|(auto_control_xing_in_a_bits_address[11:6]))) | (&(auto_control_xing_in_a_bits_address[5:2])) | _GEN_12 | _GEN_11 | _GEN_10 | _GEN_9 | _GEN_8 | _GEN_7 | _GEN_6 ? 32'h0 : _GEN_5 ? {tuning_3, tuning_2, tuning_1, tuning_0} : _GEN_4 ? io_backend_status_status5_bits : _GEN_3 ? io_backend_status_status4_bits : _GEN_2 ? io_backend_status_status3_bits : _GEN_1 ? io_backend_status_status2_bits : _GEN_0 ? io_backend_status_status1_bits : _GEN ? io_backend_status_status0_bits : {12'h0, io_backend_adc_data_out_bits};	// @[generators/rocket-chip/src/main/scala/tilelink/Bundles.scala:259:74, generators/rocket-chip/src/main/scala/tilelink/Edges.scala:192:34, generators/rocket-chip/src/main/scala/tilelink/RegisterRouter.scala:82:24, generators/rocket-chip/src/main/scala/tilelink/RegisterRouter.scala 68:18:70:19, generators/rocket-chip/src/main/scala/util/MuxLiteral.scala:49:10, generators/scumv-sensor-adc/src/main/scala/sensoradc/SensorADC.scala:108:25, :109:25, :111:25, :112:25, src/main/scala/chisel3/util/OneHot.scala:58:35]
  assign io_backend_status_status0_ready = _out_rofireMux_T_1 & auto_control_xing_in_a_bits_address[5:2] == 4'h1 & ~(|(auto_control_xing_in_a_bits_address[11:6])) & (|out_backMask);	// @[generators/rocket-chip/src/main/scala/tilelink/Edges.scala:192:34, generators/rocket-chip/src/main/scala/tilelink/RegisterRouter.scala:82:24, generators/rocket-chip/src/main/scala/tilelink/RegisterRouter.scala 68:18:70:19, generators/rocket-chip/src/main/scala/util/MuxLiteral.scala:49:10]
  assign io_backend_adc_data_out_ready = _out_rofireMux_T_1 & auto_control_xing_in_a_bits_address[5:2] == 4'h0 & ~(|(auto_control_xing_in_a_bits_address[11:6])) & (|out_backMask);	// @[generators/rocket-chip/src/main/scala/tilelink/Edges.scala:192:34, generators/rocket-chip/src/main/scala/tilelink/RegisterRouter.scala:82:24, generators/rocket-chip/src/main/scala/tilelink/RegisterRouter.scala 68:18:70:19, src/main/scala/chisel3/util/OneHot.scala:58:35]
  assign io_backend_chopper_control_chopper_div_1_valid = _out_wofireMux_T_2 & auto_control_xing_in_a_bits_address[5:2] == 4'h8 & ~(|(auto_control_xing_in_a_bits_address[11:6])) & (&out_backMask);	// @[generators/rocket-chip/src/main/scala/tilelink/Edges.scala:192:34, generators/rocket-chip/src/main/scala/tilelink/RegisterRouter.scala:82:24, generators/rocket-chip/src/main/scala/tilelink/RegisterRouter.scala 68:18:70:19, generators/rocket-chip/src/main/scala/util/MuxLiteral.scala:49:10]
  assign io_backend_chopper_control_chopper_div_1_bits = auto_control_xing_in_a_bits_data[24:0];	// @[generators/scumv-sensor-adc/src/main/scala/sensoradc/SensorADC.scala:116:70]
  assign io_backend_chopper_control_chopper_div_2_valid = _out_wofireMux_T_2 & auto_control_xing_in_a_bits_address[5:2] == 4'h9 & ~(|(auto_control_xing_in_a_bits_address[11:6])) & (&out_backMask);	// @[generators/rocket-chip/src/main/scala/tilelink/Edges.scala:192:34, generators/rocket-chip/src/main/scala/tilelink/RegisterRouter.scala:82:24, generators/rocket-chip/src/main/scala/tilelink/RegisterRouter.scala 68:18:70:19, generators/rocket-chip/src/main/scala/util/MuxLiteral.scala:49:10]
  assign io_backend_chopper_control_chopper_div_2_bits = auto_control_xing_in_a_bits_data[24:0];	// @[generators/scumv-sensor-adc/src/main/scala/sensoradc/SensorADC.scala:121:70]
  assign io_backend_chopper_control_chopper_clock_en_valid = _out_wofireMux_T_2 & auto_control_xing_in_a_bits_address[5:2] == 4'hA & ~(|(auto_control_xing_in_a_bits_address[11:6])) & auto_control_xing_in_a_bits_mask[0];	// @[generators/rocket-chip/src/main/scala/tilelink/Edges.scala:192:34, generators/rocket-chip/src/main/scala/tilelink/RegisterRouter.scala:82:24, generators/rocket-chip/src/main/scala/tilelink/RegisterRouter.scala 68:18:70:19, generators/rocket-chip/src/main/scala/util/MuxLiteral.scala:49:10]
  assign io_backend_chopper_control_chopper_clock_en_bits = auto_control_xing_in_a_bits_data[1:0];	// @[generators/rocket-chip/src/main/scala/tilelink/RegisterRouter.scala:82:24]
  assign io_backend_dsp_control_valid = _out_wofireMux_T_2 & auto_control_xing_in_a_bits_address[5:2] == 4'hB & ~(|(auto_control_xing_in_a_bits_address[11:6])) & auto_control_xing_in_a_bits_mask[0];	// @[generators/rocket-chip/src/main/scala/tilelink/Edges.scala:192:34, generators/rocket-chip/src/main/scala/tilelink/RegisterRouter.scala:82:24, generators/rocket-chip/src/main/scala/tilelink/RegisterRouter.scala 68:18:70:19, generators/rocket-chip/src/main/scala/util/MuxLiteral.scala:49:10]
  assign io_backend_dsp_control_bits = auto_control_xing_in_a_bits_data[7:0];	// @[generators/rocket-chip/src/main/scala/tilelink/RegisterRouter.scala:82:24]
  assign io_backend_auto_mux = |auto_mux;	// @[generators/scumv-sensor-adc/src/main/scala/sensoradc/SensorADC.scala:136:25, :137:35]
  assign io_tuning_adc_tuning = {tuning_3, tuning_2, tuning_1, tuning_0};	// @[generators/scumv-sensor-adc/src/main/scala/sensoradc/SensorADC.scala:108:25, :109:25, :111:25, :112:25, :134:30]
endmodule

