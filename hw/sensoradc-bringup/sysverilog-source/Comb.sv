// Generated by CIRCT unknown git version
// Standard header to adapt well known macros for register randomization.
`ifndef RANDOMIZE
  `ifdef RANDOMIZE_MEM_INIT
    `define RANDOMIZE
  `endif // RANDOMIZE_MEM_INIT
`endif // not def RANDOMIZE
`ifndef RANDOMIZE
  `ifdef RANDOMIZE_REG_INIT
    `define RANDOMIZE
  `endif // RANDOMIZE_REG_INIT
`endif // not def RANDOMIZE

// RANDOM may be set to an expression that produces a 32-bit random unsigned value.
`ifndef RANDOM
  `define RANDOM $random
`endif // not def RANDOM

// Users can define INIT_RANDOM as general code that gets injected into the
// initializer block for modules with registers.
`ifndef INIT_RANDOM
  `define INIT_RANDOM
`endif // not def INIT_RANDOM

// If using random initialization, you can also define RANDOMIZE_DELAY to
// customize the delay used, otherwise 0.002 is used.
`ifndef RANDOMIZE_DELAY
  `define RANDOMIZE_DELAY 0.002
`endif // not def RANDOMIZE_DELAY

// Define INIT_RANDOM_PROLOG_ for use in our modules below.
`ifndef INIT_RANDOM_PROLOG_
  `ifdef RANDOMIZE
    `ifdef VERILATOR
      `define INIT_RANDOM_PROLOG_ `INIT_RANDOM
    `else  // VERILATOR
      `define INIT_RANDOM_PROLOG_ `INIT_RANDOM #`RANDOMIZE_DELAY begin end
    `endif // VERILATOR
  `else  // RANDOMIZE
    `define INIT_RANDOM_PROLOG_
  `endif // RANDOMIZE
`endif // not def INIT_RANDOM_PROLOG_

// Include register initializers in init blocks unless synthesis is set
`ifndef SYNTHESIS
  `ifndef ENABLE_INITIAL_REG_
    `define ENABLE_INITIAL_REG_
  `endif // not def ENABLE_INITIAL_REG_
`endif // not def SYNTHESIS

// Include rmemory initializers in init blocks unless synthesis is set
`ifndef SYNTHESIS
  `ifndef ENABLE_INITIAL_MEM_
    `define ENABLE_INITIAL_MEM_
  `endif // not def ENABLE_INITIAL_MEM_
`endif // not def SYNTHESIS

// Standard header to adapt well known macros for prints and assertions.

// Users can define 'PRINTF_COND' to add an extra gate to prints.
`ifndef PRINTF_COND_
  `ifdef PRINTF_COND
    `define PRINTF_COND_ (`PRINTF_COND)
  `else  // PRINTF_COND
    `define PRINTF_COND_ 1
  `endif // PRINTF_COND
`endif // not def PRINTF_COND_

module Comb(
  input         clock,
                reset,
                io_input_valid,	// @[generators/scumv-sensor-adc/src/main/scala/sensoradc/CIC.scala:25:14]
  input  [66:0] io_input_bits,	// @[generators/scumv-sensor-adc/src/main/scala/sensoradc/CIC.scala:25:14]
  output        io_output_valid,	// @[generators/scumv-sensor-adc/src/main/scala/sensoradc/CIC.scala:25:14]
  output [66:0] io_output_bits	// @[generators/scumv-sensor-adc/src/main/scala/sensoradc/CIC.scala:25:14]
);

  reg [66:0] shiftReg;	// @[generators/scumv-sensor-adc/src/main/scala/sensoradc/CIC.scala:30:31]
  always @(posedge clock) begin
    if (reset)
      shiftReg <= 67'h0;	// @[generators/scumv-sensor-adc/src/main/scala/sensoradc/CIC.scala:30:31]
    else if (io_input_valid)	// @[generators/scumv-sensor-adc/src/main/scala/sensoradc/CIC.scala:25:14]
      shiftReg <= io_input_bits;	// @[generators/scumv-sensor-adc/src/main/scala/sensoradc/CIC.scala:30:31]
  end // always @(posedge)
  `ifdef ENABLE_INITIAL_REG_
    `ifdef FIRRTL_BEFORE_INITIAL
      `FIRRTL_BEFORE_INITIAL
    `endif // FIRRTL_BEFORE_INITIAL
    logic [31:0] _RANDOM[0:2];
    initial begin
      `ifdef INIT_RANDOM_PROLOG_
        `INIT_RANDOM_PROLOG_
      `endif // INIT_RANDOM_PROLOG_
      `ifdef RANDOMIZE_REG_INIT
        for (logic [1:0] i = 2'h0; i < 2'h3; i += 2'h1) begin
          _RANDOM[i] = `RANDOM;
        end
        shiftReg = {_RANDOM[2'h0], _RANDOM[2'h1], _RANDOM[2'h2][2:0]};	// @[generators/scumv-sensor-adc/src/main/scala/sensoradc/CIC.scala:30:31]
      `endif // RANDOMIZE_REG_INIT
    end // initial
    `ifdef FIRRTL_AFTER_INITIAL
      `FIRRTL_AFTER_INITIAL
    `endif // FIRRTL_AFTER_INITIAL
  `endif // ENABLE_INITIAL_REG_
  assign io_output_valid = io_input_valid;
  assign io_output_bits = io_input_bits - shiftReg;	// @[generators/scumv-sensor-adc/src/main/scala/sensoradc/CIC.scala:30:31, :31:35]
endmodule

