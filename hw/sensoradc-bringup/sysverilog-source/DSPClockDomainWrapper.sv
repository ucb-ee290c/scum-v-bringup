// Generated by CIRCT unknown git version
// Standard header to adapt well known macros for register randomization.
`ifndef RANDOMIZE
  `ifdef RANDOMIZE_MEM_INIT
    `define RANDOMIZE
  `endif // RANDOMIZE_MEM_INIT
`endif // not def RANDOMIZE
`ifndef RANDOMIZE
  `ifdef RANDOMIZE_REG_INIT
    `define RANDOMIZE
  `endif // RANDOMIZE_REG_INIT
`endif // not def RANDOMIZE

// RANDOM may be set to an expression that produces a 32-bit random unsigned value.
`ifndef RANDOM
  `define RANDOM $random
`endif // not def RANDOM

// Users can define INIT_RANDOM as general code that gets injected into the
// initializer block for modules with registers.
`ifndef INIT_RANDOM
  `define INIT_RANDOM
`endif // not def INIT_RANDOM

// If using random initialization, you can also define RANDOMIZE_DELAY to
// customize the delay used, otherwise 0.002 is used.
`ifndef RANDOMIZE_DELAY
  `define RANDOMIZE_DELAY 0.002
`endif // not def RANDOMIZE_DELAY

// Define INIT_RANDOM_PROLOG_ for use in our modules below.
`ifndef INIT_RANDOM_PROLOG_
  `ifdef RANDOMIZE
    `ifdef VERILATOR
      `define INIT_RANDOM_PROLOG_ `INIT_RANDOM
    `else  // VERILATOR
      `define INIT_RANDOM_PROLOG_ `INIT_RANDOM #`RANDOMIZE_DELAY begin end
    `endif // VERILATOR
  `else  // RANDOMIZE
    `define INIT_RANDOM_PROLOG_
  `endif // RANDOMIZE
`endif // not def INIT_RANDOM_PROLOG_

// Include register initializers in init blocks unless synthesis is set
`ifndef SYNTHESIS
  `ifndef ENABLE_INITIAL_REG_
    `define ENABLE_INITIAL_REG_
  `endif // not def ENABLE_INITIAL_REG_
`endif // not def SYNTHESIS

// Include rmemory initializers in init blocks unless synthesis is set
`ifndef SYNTHESIS
  `ifndef ENABLE_INITIAL_MEM_
    `define ENABLE_INITIAL_MEM_
  `endif // not def ENABLE_INITIAL_MEM_
`endif // not def SYNTHESIS

// Standard header to adapt well known macros for prints and assertions.

// Users can define 'PRINTF_COND' to add an extra gate to prints.
`ifndef PRINTF_COND_
  `ifdef PRINTF_COND
    `define PRINTF_COND_ (`PRINTF_COND)
  `else  // PRINTF_COND
    `define PRINTF_COND_ 1
  `endif // PRINTF_COND
`endif // not def PRINTF_COND_

module DSPClockDomainWrapper(
  input         clock,
                reset,
  input  [5:0]  io_adc_counter_p,	// @[generators/scumv-sensor-adc/src/main/scala/sensoradc/DSPClockDomainWrapper.scala:8:14]
                io_adc_counter_n,	// @[generators/scumv-sensor-adc/src/main/scala/sensoradc/DSPClockDomainWrapper.scala:8:14]
  input         io_chopper_control_chopper_div_1_valid,	// @[generators/scumv-sensor-adc/src/main/scala/sensoradc/DSPClockDomainWrapper.scala:8:14]
  input  [24:0] io_chopper_control_chopper_div_1_bits,	// @[generators/scumv-sensor-adc/src/main/scala/sensoradc/DSPClockDomainWrapper.scala:8:14]
  input         io_chopper_control_chopper_div_2_valid,	// @[generators/scumv-sensor-adc/src/main/scala/sensoradc/DSPClockDomainWrapper.scala:8:14]
  input  [24:0] io_chopper_control_chopper_div_2_bits,	// @[generators/scumv-sensor-adc/src/main/scala/sensoradc/DSPClockDomainWrapper.scala:8:14]
  input         io_chopper_control_chopper_clock_en_valid,	// @[generators/scumv-sensor-adc/src/main/scala/sensoradc/DSPClockDomainWrapper.scala:8:14]
  input  [1:0]  io_chopper_control_chopper_clock_en_bits,	// @[generators/scumv-sensor-adc/src/main/scala/sensoradc/DSPClockDomainWrapper.scala:8:14]
  input         io_dsp_control_valid,	// @[generators/scumv-sensor-adc/src/main/scala/sensoradc/DSPClockDomainWrapper.scala:8:14]
  input  [7:0]  io_dsp_control_bits,	// @[generators/scumv-sensor-adc/src/main/scala/sensoradc/DSPClockDomainWrapper.scala:8:14]
  output        io_adc_sensor_out,	// @[generators/scumv-sensor-adc/src/main/scala/sensoradc/DSPClockDomainWrapper.scala:8:14]
                io_adc_data_out_valid,	// @[generators/scumv-sensor-adc/src/main/scala/sensoradc/DSPClockDomainWrapper.scala:8:14]
  output [19:0] io_adc_data_out_bits,	// @[generators/scumv-sensor-adc/src/main/scala/sensoradc/DSPClockDomainWrapper.scala:8:14]
  output        io_chopper_clock_1,	// @[generators/scumv-sensor-adc/src/main/scala/sensoradc/DSPClockDomainWrapper.scala:8:14]
                io_chopper_clock_2,	// @[generators/scumv-sensor-adc/src/main/scala/sensoradc/DSPClockDomainWrapper.scala:8:14]
  output [7:0]  io_input_mux_ctrl,	// @[generators/scumv-sensor-adc/src/main/scala/sensoradc/DSPClockDomainWrapper.scala:8:14]
  output [6:0]  io_adc_counter_diff,	// @[generators/scumv-sensor-adc/src/main/scala/sensoradc/DSPClockDomainWrapper.scala:8:14]
  output [5:0]  io_adc_counter_p_diff,	// @[generators/scumv-sensor-adc/src/main/scala/sensoradc/DSPClockDomainWrapper.scala:8:14]
                io_adc_counter_n_diff	// @[generators/scumv-sensor-adc/src/main/scala/sensoradc/DSPClockDomainWrapper.scala:8:14]
);

  wire        _cic_decim_io_output_valid;	// @[generators/scumv-sensor-adc/src/main/scala/sensoradc/DSPClockDomainWrapper.scala:135:25]
  wire [66:0] _cic_decim_io_output_bits;	// @[generators/scumv-sensor-adc/src/main/scala/sensoradc/DSPClockDomainWrapper.scala:135:25]
  wire [6:0]  _dechopper_io_output;	// @[generators/scumv-sensor-adc/src/main/scala/sensoradc/DSPClockDomainWrapper.scala:125:25]
  wire        _secondStageGen_io_clock_gen;	// @[generators/scumv-sensor-adc/src/main/scala/sensoradc/DSPClockDomainWrapper.scala:76:30]
  wire        _firstStageGen_io_clock_gen;	// @[generators/scumv-sensor-adc/src/main/scala/sensoradc/DSPClockDomainWrapper.scala:62:29]
  reg  [3:0]  pMux;	// @[generators/scumv-sensor-adc/src/main/scala/sensoradc/DSPClockDomainWrapper.scala:29:21]
  reg  [3:0]  nMux;	// @[generators/scumv-sensor-adc/src/main/scala/sensoradc/DSPClockDomainWrapper.scala:30:21]
  reg  [12:0] rCtr;	// @[generators/scumv-sensor-adc/src/main/scala/sensoradc/DSPClockDomainWrapper.scala:31:21]
  reg  [7:0]  dsp_control_buf;	// @[generators/scumv-sensor-adc/src/main/scala/sensoradc/DSPClockDomainWrapper.scala:43:32]
  reg  [1:0]  chopper_clk_en_buf;	// @[generators/scumv-sensor-adc/src/main/scala/sensoradc/DSPClockDomainWrapper.scala:55:35]
  reg  [24:0] firstStageDivider;	// @[generators/scumv-sensor-adc/src/main/scala/sensoradc/DSPClockDomainWrapper.scala:64:34]
  wire        _io_chopper_clock_1_output = ~(chopper_clk_en_buf[0]) | _firstStageGen_io_clock_gen;	// @[generators/scumv-sensor-adc/src/main/scala/sensoradc/DSPClockDomainWrapper.scala:55:35, :62:29, :70:{28,47}]
  reg  [24:0] secondStageDivider;	// @[generators/scumv-sensor-adc/src/main/scala/sensoradc/DSPClockDomainWrapper.scala:78:35]
  wire        _io_chopper_clock_2_output = ~(chopper_clk_en_buf[1]) | _secondStageGen_io_clock_gen;	// @[generators/scumv-sensor-adc/src/main/scala/sensoradc/DSPClockDomainWrapper.scala:55:35, :76:30, :84:{28,47}]
  reg  [5:0]  adc_counter_p_reg;	// @[generators/scumv-sensor-adc/src/main/scala/sensoradc/DSPClockDomainWrapper.scala:97:34]
  reg  [5:0]  adc_counter_n_reg;	// @[generators/scumv-sensor-adc/src/main/scala/sensoradc/DSPClockDomainWrapper.scala:98:34]
  reg  [5:0]  adc_counter_p_reg_z;	// @[generators/scumv-sensor-adc/src/main/scala/sensoradc/DSPClockDomainWrapper.scala:101:36]
  reg  [5:0]  adc_counter_n_reg_z;	// @[generators/scumv-sensor-adc/src/main/scala/sensoradc/DSPClockDomainWrapper.scala:102:36]
  wire [5:0]  _adc_counter_p_sub_T = adc_counter_p_reg - adc_counter_p_reg_z;	// @[generators/scumv-sensor-adc/src/main/scala/sensoradc/DSPClockDomainWrapper.scala:97:34, :101:36, :105:45]
  wire [5:0]  _adc_counter_n_sub_T = adc_counter_n_reg - adc_counter_n_reg_z;	// @[generators/scumv-sensor-adc/src/main/scala/sensoradc/DSPClockDomainWrapper.scala:98:34, :102:36, :106:45]
  wire [6:0]  _adc_counter_diff_T_2 = {1'h0, _adc_counter_p_sub_T} - {1'h0, _adc_counter_n_sub_T};	// @[generators/scumv-sensor-adc/src/main/scala/sensoradc/DSPClockDomainWrapper.scala:34:41, :105:45, :106:45, :121:52]
  reg         cic_decim_output_valid;	// @[generators/scumv-sensor-adc/src/main/scala/sensoradc/DSPClockDomainWrapper.scala:141:48]
  reg  [66:0] cic_decim_output_bits;	// @[generators/scumv-sensor-adc/src/main/scala/sensoradc/DSPClockDomainWrapper.scala:141:48]
  always @(posedge clock) begin
    pMux <= reset ? 4'h2 : pMux;	// @[generators/scumv-sensor-adc/src/main/scala/sensoradc/DSPClockDomainWrapper.scala:29:21]
    nMux <= reset ? 4'h1 : nMux;	// @[generators/scumv-sensor-adc/src/main/scala/sensoradc/DSPClockDomainWrapper.scala:30:21, :34:16]
    adc_counter_p_reg <= io_adc_counter_p;	// @[generators/scumv-sensor-adc/src/main/scala/sensoradc/DSPClockDomainWrapper.scala:97:34]
    adc_counter_n_reg <= io_adc_counter_n;	// @[generators/scumv-sensor-adc/src/main/scala/sensoradc/DSPClockDomainWrapper.scala:98:34]
    adc_counter_p_reg_z <= adc_counter_p_reg;	// @[generators/scumv-sensor-adc/src/main/scala/sensoradc/DSPClockDomainWrapper.scala:97:34, :101:36]
    adc_counter_n_reg_z <= adc_counter_n_reg;	// @[generators/scumv-sensor-adc/src/main/scala/sensoradc/DSPClockDomainWrapper.scala:98:34, :102:36]
    cic_decim_output_valid <= _cic_decim_io_output_valid;	// @[generators/scumv-sensor-adc/src/main/scala/sensoradc/DSPClockDomainWrapper.scala:135:25, :141:48]
    cic_decim_output_bits <= _cic_decim_io_output_bits;	// @[generators/scumv-sensor-adc/src/main/scala/sensoradc/DSPClockDomainWrapper.scala:135:25, :141:48]
    if (reset) begin
      rCtr <= 13'h0;	// @[generators/scumv-sensor-adc/src/main/scala/sensoradc/DSPClockDomainWrapper.scala:31:21]
      dsp_control_buf <= 8'h0;	// @[generators/scumv-sensor-adc/src/main/scala/sensoradc/DSPClockDomainWrapper.scala:43:32]
      chopper_clk_en_buf <= 2'h0;	// @[generators/scumv-sensor-adc/src/main/scala/sensoradc/DSPClockDomainWrapper.scala:55:35]
      firstStageDivider <= 25'h0;	// @[generators/scumv-sensor-adc/src/main/scala/sensoradc/DSPClockDomainWrapper.scala:64:34]
      secondStageDivider <= 25'h0;	// @[generators/scumv-sensor-adc/src/main/scala/sensoradc/DSPClockDomainWrapper.scala:64:34, :78:35]
    end
    else begin
      rCtr <= rCtr + 13'h1;	// @[generators/scumv-sensor-adc/src/main/scala/sensoradc/DSPClockDomainWrapper.scala:31:21, :37:18]
      if (io_dsp_control_valid)	// @[generators/scumv-sensor-adc/src/main/scala/sensoradc/DSPClockDomainWrapper.scala:8:14]
        dsp_control_buf <= io_dsp_control_bits;	// @[generators/scumv-sensor-adc/src/main/scala/sensoradc/DSPClockDomainWrapper.scala:43:32]
      if (io_chopper_control_chopper_clock_en_valid)	// @[generators/scumv-sensor-adc/src/main/scala/sensoradc/DSPClockDomainWrapper.scala:8:14]
        chopper_clk_en_buf <= io_chopper_control_chopper_clock_en_bits;	// @[generators/scumv-sensor-adc/src/main/scala/sensoradc/DSPClockDomainWrapper.scala:55:35]
      if (io_chopper_control_chopper_div_1_valid)	// @[generators/scumv-sensor-adc/src/main/scala/sensoradc/DSPClockDomainWrapper.scala:8:14]
        firstStageDivider <= io_chopper_control_chopper_div_1_bits;	// @[generators/scumv-sensor-adc/src/main/scala/sensoradc/DSPClockDomainWrapper.scala:64:34]
      if (io_chopper_control_chopper_div_2_valid)	// @[generators/scumv-sensor-adc/src/main/scala/sensoradc/DSPClockDomainWrapper.scala:8:14]
        secondStageDivider <= io_chopper_control_chopper_div_2_bits;	// @[generators/scumv-sensor-adc/src/main/scala/sensoradc/DSPClockDomainWrapper.scala:78:35]
    end
  end // always @(posedge)
  `ifdef ENABLE_INITIAL_REG_
    `ifdef FIRRTL_BEFORE_INITIAL
      `FIRRTL_BEFORE_INITIAL
    `endif // FIRRTL_BEFORE_INITIAL
    logic [31:0] _RANDOM[0:5];
    initial begin
      `ifdef INIT_RANDOM_PROLOG_
        `INIT_RANDOM_PROLOG_
      `endif // INIT_RANDOM_PROLOG_
      `ifdef RANDOMIZE_REG_INIT
        for (logic [2:0] i = 3'h0; i < 3'h6; i += 3'h1) begin
          _RANDOM[i] = `RANDOM;
        end
        pMux = _RANDOM[3'h0][3:0];	// @[generators/scumv-sensor-adc/src/main/scala/sensoradc/DSPClockDomainWrapper.scala:29:21]
        nMux = _RANDOM[3'h0][7:4];	// @[generators/scumv-sensor-adc/src/main/scala/sensoradc/DSPClockDomainWrapper.scala:29:21, :30:21]
        rCtr = _RANDOM[3'h0][20:8];	// @[generators/scumv-sensor-adc/src/main/scala/sensoradc/DSPClockDomainWrapper.scala:29:21, :31:21]
        dsp_control_buf = _RANDOM[3'h0][28:21];	// @[generators/scumv-sensor-adc/src/main/scala/sensoradc/DSPClockDomainWrapper.scala:29:21, :43:32]
        chopper_clk_en_buf = _RANDOM[3'h0][30:29];	// @[generators/scumv-sensor-adc/src/main/scala/sensoradc/DSPClockDomainWrapper.scala:29:21, :55:35]
        firstStageDivider = {_RANDOM[3'h0][31], _RANDOM[3'h1][23:0]};	// @[generators/scumv-sensor-adc/src/main/scala/sensoradc/DSPClockDomainWrapper.scala:29:21, :64:34]
        secondStageDivider = {_RANDOM[3'h1][31:24], _RANDOM[3'h2][16:0]};	// @[generators/scumv-sensor-adc/src/main/scala/sensoradc/DSPClockDomainWrapper.scala:64:34, :78:35]
        adc_counter_p_reg = _RANDOM[3'h2][22:17];	// @[generators/scumv-sensor-adc/src/main/scala/sensoradc/DSPClockDomainWrapper.scala:78:35, :97:34]
        adc_counter_n_reg = _RANDOM[3'h2][28:23];	// @[generators/scumv-sensor-adc/src/main/scala/sensoradc/DSPClockDomainWrapper.scala:78:35, :98:34]
        adc_counter_p_reg_z = {_RANDOM[3'h2][31:29], _RANDOM[3'h3][2:0]};	// @[generators/scumv-sensor-adc/src/main/scala/sensoradc/DSPClockDomainWrapper.scala:78:35, :101:36]
        adc_counter_n_reg_z = _RANDOM[3'h3][8:3];	// @[generators/scumv-sensor-adc/src/main/scala/sensoradc/DSPClockDomainWrapper.scala:101:36, :102:36]
        cic_decim_output_valid = _RANDOM[3'h3][9];	// @[generators/scumv-sensor-adc/src/main/scala/sensoradc/DSPClockDomainWrapper.scala:101:36, :141:48]
        cic_decim_output_bits = {_RANDOM[3'h3][31:10], _RANDOM[3'h4], _RANDOM[3'h5][12:0]};	// @[generators/scumv-sensor-adc/src/main/scala/sensoradc/DSPClockDomainWrapper.scala:101:36, :141:48]
      `endif // RANDOMIZE_REG_INIT
    end // initial
    `ifdef FIRRTL_AFTER_INITIAL
      `FIRRTL_AFTER_INITIAL
    `endif // FIRRTL_AFTER_INITIAL
  `endif // ENABLE_INITIAL_REG_
  ClockGen firstStageGen (	// @[generators/scumv-sensor-adc/src/main/scala/sensoradc/DSPClockDomainWrapper.scala:62:29]
    .clock        (clock),
    .reset        (reset),
    .io_divider   (firstStageDivider),	// @[generators/scumv-sensor-adc/src/main/scala/sensoradc/DSPClockDomainWrapper.scala:64:34]
    .io_clock_gen (_firstStageGen_io_clock_gen)
  );
  ClockGen secondStageGen (	// @[generators/scumv-sensor-adc/src/main/scala/sensoradc/DSPClockDomainWrapper.scala:76:30]
    .clock        (clock),
    .reset        (reset),
    .io_divider   (secondStageDivider),	// @[generators/scumv-sensor-adc/src/main/scala/sensoradc/DSPClockDomainWrapper.scala:78:35]
    .io_clock_gen (_secondStageGen_io_clock_gen)
  );
  Dechopper dechopper (	// @[generators/scumv-sensor-adc/src/main/scala/sensoradc/DSPClockDomainWrapper.scala:125:25]
    .clock                  (clock),
    .reset                  (reset),
    .io_input               (_adc_counter_diff_T_2),	// @[generators/scumv-sensor-adc/src/main/scala/sensoradc/DSPClockDomainWrapper.scala:121:52]
    .io_output              (_dechopper_io_output),
    .io_chopper_clock       (dsp_control_buf[1] ? _io_chopper_clock_2_output : _io_chopper_clock_1_output),	// @[generators/scumv-sensor-adc/src/main/scala/sensoradc/DSPClockDomainWrapper.scala:43:32, :48:41, :70:28, :84:28, :127:36]
    .io_chopper_clock_delay (dsp_control_buf[5:2])	// @[generators/scumv-sensor-adc/src/main/scala/sensoradc/DSPClockDomainWrapper.scala:43:32, :49:43]
  );
  CICDecimator cic_decim (	// @[generators/scumv-sensor-adc/src/main/scala/sensoradc/DSPClockDomainWrapper.scala:135:25]
    .clock           (clock),
    .reset           (reset),
    .io_input        (dsp_control_buf[0] ? _dechopper_io_output : _adc_counter_diff_T_2),	// @[generators/scumv-sensor-adc/src/main/scala/sensoradc/DSPClockDomainWrapper.scala:43:32, :47:34, :121:52, :125:25, :136:28]
    .io_output_valid (_cic_decim_io_output_valid),
    .io_output_bits  (_cic_decim_io_output_bits)
  );
  SensorOutFSM sensorOutFSM (	// @[generators/scumv-sensor-adc/src/main/scala/sensoradc/DSPClockDomainWrapper.scala:150:28]
    .clock                 (clock),
    .reset                 (reset),
    .io_adc_data_out_valid (cic_decim_output_valid),	// @[generators/scumv-sensor-adc/src/main/scala/sensoradc/DSPClockDomainWrapper.scala:141:48]
    .io_adc_data_out_bits  (cic_decim_output_bits[65:46]),	// @[generators/scumv-sensor-adc/src/main/scala/sensoradc/DSPClockDomainWrapper.scala:141:48, :147:{24,48}]
    .io_adc_sensor_out     (io_adc_sensor_out)
  );
  assign io_adc_data_out_valid = cic_decim_output_valid;	// @[generators/scumv-sensor-adc/src/main/scala/sensoradc/DSPClockDomainWrapper.scala:141:48]
  assign io_adc_data_out_bits = cic_decim_output_bits[65:46];	// @[generators/scumv-sensor-adc/src/main/scala/sensoradc/DSPClockDomainWrapper.scala:141:48, :147:{24,48}]
  assign io_chopper_clock_1 = _io_chopper_clock_1_output;	// @[generators/scumv-sensor-adc/src/main/scala/sensoradc/DSPClockDomainWrapper.scala:70:28]
  assign io_chopper_clock_2 = _io_chopper_clock_2_output;	// @[generators/scumv-sensor-adc/src/main/scala/sensoradc/DSPClockDomainWrapper.scala:84:28]
  assign io_input_mux_ctrl = {nMux, pMux};	// @[generators/scumv-sensor-adc/src/main/scala/sensoradc/DSPClockDomainWrapper.scala:29:21, :30:21, :39:27]
  assign io_adc_counter_diff = _adc_counter_diff_T_2;	// @[generators/scumv-sensor-adc/src/main/scala/sensoradc/DSPClockDomainWrapper.scala:121:52]
  assign io_adc_counter_p_diff = _adc_counter_p_sub_T;	// @[generators/scumv-sensor-adc/src/main/scala/sensoradc/DSPClockDomainWrapper.scala:105:45]
  assign io_adc_counter_n_diff = _adc_counter_n_sub_T;	// @[generators/scumv-sensor-adc/src/main/scala/sensoradc/DSPClockDomainWrapper.scala:106:45]
endmodule

