// Generated by CIRCT unknown git version
// Standard header to adapt well known macros for register randomization.
`ifndef RANDOMIZE
  `ifdef RANDOMIZE_MEM_INIT
    `define RANDOMIZE
  `endif // RANDOMIZE_MEM_INIT
`endif // not def RANDOMIZE
`ifndef RANDOMIZE
  `ifdef RANDOMIZE_REG_INIT
    `define RANDOMIZE
  `endif // RANDOMIZE_REG_INIT
`endif // not def RANDOMIZE

// RANDOM may be set to an expression that produces a 32-bit random unsigned value.
`ifndef RANDOM
  `define RANDOM $random
`endif // not def RANDOM

// Users can define INIT_RANDOM as general code that gets injected into the
// initializer block for modules with registers.
`ifndef INIT_RANDOM
  `define INIT_RANDOM
`endif // not def INIT_RANDOM

// If using random initialization, you can also define RANDOMIZE_DELAY to
// customize the delay used, otherwise 0.002 is used.
`ifndef RANDOMIZE_DELAY
  `define RANDOMIZE_DELAY 0.002
`endif // not def RANDOMIZE_DELAY

// Define INIT_RANDOM_PROLOG_ for use in our modules below.
`ifndef INIT_RANDOM_PROLOG_
  `ifdef RANDOMIZE
    `ifdef VERILATOR
      `define INIT_RANDOM_PROLOG_ `INIT_RANDOM
    `else  // VERILATOR
      `define INIT_RANDOM_PROLOG_ `INIT_RANDOM #`RANDOMIZE_DELAY begin end
    `endif // VERILATOR
  `else  // RANDOMIZE
    `define INIT_RANDOM_PROLOG_
  `endif // RANDOMIZE
`endif // not def INIT_RANDOM_PROLOG_

// Include register initializers in init blocks unless synthesis is set
`ifndef SYNTHESIS
  `ifndef ENABLE_INITIAL_REG_
    `define ENABLE_INITIAL_REG_
  `endif // not def ENABLE_INITIAL_REG_
`endif // not def SYNTHESIS

// Include rmemory initializers in init blocks unless synthesis is set
`ifndef SYNTHESIS
  `ifndef ENABLE_INITIAL_MEM_
    `define ENABLE_INITIAL_MEM_
  `endif // not def ENABLE_INITIAL_MEM_
`endif // not def SYNTHESIS

// Standard header to adapt well known macros for prints and assertions.

// Users can define 'PRINTF_COND' to add an extra gate to prints.
`ifndef PRINTF_COND_
  `ifdef PRINTF_COND
    `define PRINTF_COND_ (`PRINTF_COND)
  `else  // PRINTF_COND
    `define PRINTF_COND_ 1
  `endif // PRINTF_COND
`endif // not def PRINTF_COND_

// Users can define 'ASSERT_VERBOSE_COND' to add an extra gate to assert error printing.
`ifndef ASSERT_VERBOSE_COND_
  `ifdef ASSERT_VERBOSE_COND
    `define ASSERT_VERBOSE_COND_ (`ASSERT_VERBOSE_COND)
  `else  // ASSERT_VERBOSE_COND
    `define ASSERT_VERBOSE_COND_ 1
  `endif // ASSERT_VERBOSE_COND
`endif // not def ASSERT_VERBOSE_COND_

// Users can define 'STOP_COND' to add an extra gate to stop conditions.
`ifndef STOP_COND_
  `ifdef STOP_COND
    `define STOP_COND_ (`STOP_COND)
  `else  // STOP_COND
    `define STOP_COND_ 1
  `endif // STOP_COND
`endif // not def STOP_COND_

module AsyncQueueSource_17(
  input         clock,
                reset,
                io_enq_bits_restart,	// @[generators/rocket-chip/src/main/scala/util/AsyncQueue.scala:71:14]
                io_enq_bits_mode,	// @[generators/rocket-chip/src/main/scala/util/AsyncQueue.scala:71:14]
  input  [7:0]  io_enq_bits_duration,	// @[generators/rocket-chip/src/main/scala/util/AsyncQueue.scala:71:14]
  input  [31:0] io_enq_bits_k_p,	// @[generators/rocket-chip/src/main/scala/util/AsyncQueue.scala:71:14]
                io_enq_bits_k_i,	// @[generators/rocket-chip/src/main/scala/util/AsyncQueue.scala:71:14]
  input         io_enq_bits_p_control_only,	// @[generators/rocket-chip/src/main/scala/util/AsyncQueue.scala:71:14]
  input  [31:0] io_enq_bits_nominal_adc_clock_freq,	// @[generators/rocket-chip/src/main/scala/util/AsyncQueue.scala:71:14]
  output        io_async_mem_0_restart,	// @[generators/rocket-chip/src/main/scala/util/AsyncQueue.scala:71:14]
                io_async_mem_0_mode,	// @[generators/rocket-chip/src/main/scala/util/AsyncQueue.scala:71:14]
  output [7:0]  io_async_mem_0_duration,	// @[generators/rocket-chip/src/main/scala/util/AsyncQueue.scala:71:14]
  output [31:0] io_async_mem_0_k_p,	// @[generators/rocket-chip/src/main/scala/util/AsyncQueue.scala:71:14]
                io_async_mem_0_k_i,	// @[generators/rocket-chip/src/main/scala/util/AsyncQueue.scala:71:14]
  output        io_async_mem_0_p_control_only,	// @[generators/rocket-chip/src/main/scala/util/AsyncQueue.scala:71:14]
  output [31:0] io_async_mem_0_nominal_adc_clock_freq,	// @[generators/rocket-chip/src/main/scala/util/AsyncQueue.scala:71:14]
  output        io_async_mem_1_restart,	// @[generators/rocket-chip/src/main/scala/util/AsyncQueue.scala:71:14]
                io_async_mem_1_mode,	// @[generators/rocket-chip/src/main/scala/util/AsyncQueue.scala:71:14]
  output [7:0]  io_async_mem_1_duration,	// @[generators/rocket-chip/src/main/scala/util/AsyncQueue.scala:71:14]
  output [31:0] io_async_mem_1_k_p,	// @[generators/rocket-chip/src/main/scala/util/AsyncQueue.scala:71:14]
                io_async_mem_1_k_i,	// @[generators/rocket-chip/src/main/scala/util/AsyncQueue.scala:71:14]
  output        io_async_mem_1_p_control_only,	// @[generators/rocket-chip/src/main/scala/util/AsyncQueue.scala:71:14]
  output [31:0] io_async_mem_1_nominal_adc_clock_freq,	// @[generators/rocket-chip/src/main/scala/util/AsyncQueue.scala:71:14]
  output        io_async_mem_2_restart,	// @[generators/rocket-chip/src/main/scala/util/AsyncQueue.scala:71:14]
                io_async_mem_2_mode,	// @[generators/rocket-chip/src/main/scala/util/AsyncQueue.scala:71:14]
  output [7:0]  io_async_mem_2_duration,	// @[generators/rocket-chip/src/main/scala/util/AsyncQueue.scala:71:14]
  output [31:0] io_async_mem_2_k_p,	// @[generators/rocket-chip/src/main/scala/util/AsyncQueue.scala:71:14]
                io_async_mem_2_k_i,	// @[generators/rocket-chip/src/main/scala/util/AsyncQueue.scala:71:14]
  output        io_async_mem_2_p_control_only,	// @[generators/rocket-chip/src/main/scala/util/AsyncQueue.scala:71:14]
  output [31:0] io_async_mem_2_nominal_adc_clock_freq,	// @[generators/rocket-chip/src/main/scala/util/AsyncQueue.scala:71:14]
  output        io_async_mem_3_restart,	// @[generators/rocket-chip/src/main/scala/util/AsyncQueue.scala:71:14]
                io_async_mem_3_mode,	// @[generators/rocket-chip/src/main/scala/util/AsyncQueue.scala:71:14]
  output [7:0]  io_async_mem_3_duration,	// @[generators/rocket-chip/src/main/scala/util/AsyncQueue.scala:71:14]
  output [31:0] io_async_mem_3_k_p,	// @[generators/rocket-chip/src/main/scala/util/AsyncQueue.scala:71:14]
                io_async_mem_3_k_i,	// @[generators/rocket-chip/src/main/scala/util/AsyncQueue.scala:71:14]
  output        io_async_mem_3_p_control_only,	// @[generators/rocket-chip/src/main/scala/util/AsyncQueue.scala:71:14]
  output [31:0] io_async_mem_3_nominal_adc_clock_freq,	// @[generators/rocket-chip/src/main/scala/util/AsyncQueue.scala:71:14]
  input  [2:0]  io_async_ridx,	// @[generators/rocket-chip/src/main/scala/util/AsyncQueue.scala:71:14]
  output [2:0]  io_async_widx,	// @[generators/rocket-chip/src/main/scala/util/AsyncQueue.scala:71:14]
  input         io_async_safe_ridx_valid,	// @[generators/rocket-chip/src/main/scala/util/AsyncQueue.scala:71:14]
  output        io_async_safe_widx_valid,	// @[generators/rocket-chip/src/main/scala/util/AsyncQueue.scala:71:14]
                io_async_safe_source_reset_n,	// @[generators/rocket-chip/src/main/scala/util/AsyncQueue.scala:71:14]
  input         io_async_safe_sink_reset_n	// @[generators/rocket-chip/src/main/scala/util/AsyncQueue.scala:71:14]
);

  wire        _sink_valid_io_out;	// @[generators/rocket-chip/src/main/scala/util/AsyncQueue.scala:104:30]
  wire        _sink_extend_io_out;	// @[generators/rocket-chip/src/main/scala/util/AsyncQueue.scala:103:30]
  wire        _source_valid_0_io_out;	// @[generators/rocket-chip/src/main/scala/util/AsyncQueue.scala:100:32]
  wire [2:0]  _ridx_ridx_gray_io_q;	// @[generators/rocket-chip/src/main/scala/util/ShiftReg.scala:45:23]
  reg         mem_0_restart;	// @[generators/rocket-chip/src/main/scala/util/AsyncQueue.scala:80:16]
  reg         mem_0_mode;	// @[generators/rocket-chip/src/main/scala/util/AsyncQueue.scala:80:16]
  reg  [7:0]  mem_0_duration;	// @[generators/rocket-chip/src/main/scala/util/AsyncQueue.scala:80:16]
  reg  [31:0] mem_0_k_p;	// @[generators/rocket-chip/src/main/scala/util/AsyncQueue.scala:80:16]
  reg  [31:0] mem_0_k_i;	// @[generators/rocket-chip/src/main/scala/util/AsyncQueue.scala:80:16]
  reg         mem_0_p_control_only;	// @[generators/rocket-chip/src/main/scala/util/AsyncQueue.scala:80:16]
  reg  [31:0] mem_0_nominal_adc_clock_freq;	// @[generators/rocket-chip/src/main/scala/util/AsyncQueue.scala:80:16]
  reg         mem_1_restart;	// @[generators/rocket-chip/src/main/scala/util/AsyncQueue.scala:80:16]
  reg         mem_1_mode;	// @[generators/rocket-chip/src/main/scala/util/AsyncQueue.scala:80:16]
  reg  [7:0]  mem_1_duration;	// @[generators/rocket-chip/src/main/scala/util/AsyncQueue.scala:80:16]
  reg  [31:0] mem_1_k_p;	// @[generators/rocket-chip/src/main/scala/util/AsyncQueue.scala:80:16]
  reg  [31:0] mem_1_k_i;	// @[generators/rocket-chip/src/main/scala/util/AsyncQueue.scala:80:16]
  reg         mem_1_p_control_only;	// @[generators/rocket-chip/src/main/scala/util/AsyncQueue.scala:80:16]
  reg  [31:0] mem_1_nominal_adc_clock_freq;	// @[generators/rocket-chip/src/main/scala/util/AsyncQueue.scala:80:16]
  reg         mem_2_restart;	// @[generators/rocket-chip/src/main/scala/util/AsyncQueue.scala:80:16]
  reg         mem_2_mode;	// @[generators/rocket-chip/src/main/scala/util/AsyncQueue.scala:80:16]
  reg  [7:0]  mem_2_duration;	// @[generators/rocket-chip/src/main/scala/util/AsyncQueue.scala:80:16]
  reg  [31:0] mem_2_k_p;	// @[generators/rocket-chip/src/main/scala/util/AsyncQueue.scala:80:16]
  reg  [31:0] mem_2_k_i;	// @[generators/rocket-chip/src/main/scala/util/AsyncQueue.scala:80:16]
  reg         mem_2_p_control_only;	// @[generators/rocket-chip/src/main/scala/util/AsyncQueue.scala:80:16]
  reg  [31:0] mem_2_nominal_adc_clock_freq;	// @[generators/rocket-chip/src/main/scala/util/AsyncQueue.scala:80:16]
  reg         mem_3_restart;	// @[generators/rocket-chip/src/main/scala/util/AsyncQueue.scala:80:16]
  reg         mem_3_mode;	// @[generators/rocket-chip/src/main/scala/util/AsyncQueue.scala:80:16]
  reg  [7:0]  mem_3_duration;	// @[generators/rocket-chip/src/main/scala/util/AsyncQueue.scala:80:16]
  reg  [31:0] mem_3_k_p;	// @[generators/rocket-chip/src/main/scala/util/AsyncQueue.scala:80:16]
  reg  [31:0] mem_3_k_i;	// @[generators/rocket-chip/src/main/scala/util/AsyncQueue.scala:80:16]
  reg         mem_3_p_control_only;	// @[generators/rocket-chip/src/main/scala/util/AsyncQueue.scala:80:16]
  reg  [31:0] mem_3_nominal_adc_clock_freq;	// @[generators/rocket-chip/src/main/scala/util/AsyncQueue.scala:80:16]
  reg  [2:0]  widx_widx_bin;	// @[generators/rocket-chip/src/main/scala/util/AsyncQueue.scala:52:25]
  reg         ready_reg;	// @[generators/rocket-chip/src/main/scala/util/AsyncQueue.scala:88:56]
  wire        io_enq_ready = ready_reg & _sink_valid_io_out;	// @[generators/rocket-chip/src/main/scala/util/AsyncQueue.scala:88:56, :89:29, :104:30]
  reg  [2:0]  widx_gray;	// @[generators/rocket-chip/src/main/scala/util/AsyncQueue.scala:91:55]
  wire [1:0]  index = widx_gray[1:0] ^ {widx_gray[2], 1'h0};	// @[generators/rocket-chip/src/main/scala/util/AsyncQueue.scala:80:16, :85:{52,64,80,93}, :91:55]
  always @(posedge clock) begin
    if (io_enq_ready & index == 2'h0) begin	// @[generators/rocket-chip/src/main/scala/util/AsyncQueue.scala:52:25, :80:16, :85:64, :86:{22,35}, :89:29]
      mem_0_restart <= io_enq_bits_restart;	// @[generators/rocket-chip/src/main/scala/util/AsyncQueue.scala:80:16]
      mem_0_mode <= io_enq_bits_mode;	// @[generators/rocket-chip/src/main/scala/util/AsyncQueue.scala:80:16]
      mem_0_duration <= io_enq_bits_duration;	// @[generators/rocket-chip/src/main/scala/util/AsyncQueue.scala:80:16]
      mem_0_k_p <= io_enq_bits_k_p;	// @[generators/rocket-chip/src/main/scala/util/AsyncQueue.scala:80:16]
      mem_0_k_i <= io_enq_bits_k_i;	// @[generators/rocket-chip/src/main/scala/util/AsyncQueue.scala:80:16]
      mem_0_p_control_only <= io_enq_bits_p_control_only;	// @[generators/rocket-chip/src/main/scala/util/AsyncQueue.scala:80:16]
      mem_0_nominal_adc_clock_freq <= io_enq_bits_nominal_adc_clock_freq;	// @[generators/rocket-chip/src/main/scala/util/AsyncQueue.scala:80:16]
    end
    if (io_enq_ready & index == 2'h1) begin	// @[generators/rocket-chip/src/main/scala/util/AsyncQueue.scala:80:16, :85:64, :86:{22,35}, :89:29]
      mem_1_restart <= io_enq_bits_restart;	// @[generators/rocket-chip/src/main/scala/util/AsyncQueue.scala:80:16]
      mem_1_mode <= io_enq_bits_mode;	// @[generators/rocket-chip/src/main/scala/util/AsyncQueue.scala:80:16]
      mem_1_duration <= io_enq_bits_duration;	// @[generators/rocket-chip/src/main/scala/util/AsyncQueue.scala:80:16]
      mem_1_k_p <= io_enq_bits_k_p;	// @[generators/rocket-chip/src/main/scala/util/AsyncQueue.scala:80:16]
      mem_1_k_i <= io_enq_bits_k_i;	// @[generators/rocket-chip/src/main/scala/util/AsyncQueue.scala:80:16]
      mem_1_p_control_only <= io_enq_bits_p_control_only;	// @[generators/rocket-chip/src/main/scala/util/AsyncQueue.scala:80:16]
      mem_1_nominal_adc_clock_freq <= io_enq_bits_nominal_adc_clock_freq;	// @[generators/rocket-chip/src/main/scala/util/AsyncQueue.scala:80:16]
    end
    if (io_enq_ready & index == 2'h2) begin	// @[generators/rocket-chip/src/main/scala/util/AsyncQueue.scala:80:16, :85:64, :86:{22,35}, :89:29]
      mem_2_restart <= io_enq_bits_restart;	// @[generators/rocket-chip/src/main/scala/util/AsyncQueue.scala:80:16]
      mem_2_mode <= io_enq_bits_mode;	// @[generators/rocket-chip/src/main/scala/util/AsyncQueue.scala:80:16]
      mem_2_duration <= io_enq_bits_duration;	// @[generators/rocket-chip/src/main/scala/util/AsyncQueue.scala:80:16]
      mem_2_k_p <= io_enq_bits_k_p;	// @[generators/rocket-chip/src/main/scala/util/AsyncQueue.scala:80:16]
      mem_2_k_i <= io_enq_bits_k_i;	// @[generators/rocket-chip/src/main/scala/util/AsyncQueue.scala:80:16]
      mem_2_p_control_only <= io_enq_bits_p_control_only;	// @[generators/rocket-chip/src/main/scala/util/AsyncQueue.scala:80:16]
      mem_2_nominal_adc_clock_freq <= io_enq_bits_nominal_adc_clock_freq;	// @[generators/rocket-chip/src/main/scala/util/AsyncQueue.scala:80:16]
    end
    if (io_enq_ready & (&index)) begin	// @[generators/rocket-chip/src/main/scala/util/AsyncQueue.scala:80:16, :85:64, :86:{22,35}, :89:29]
      mem_3_restart <= io_enq_bits_restart;	// @[generators/rocket-chip/src/main/scala/util/AsyncQueue.scala:80:16]
      mem_3_mode <= io_enq_bits_mode;	// @[generators/rocket-chip/src/main/scala/util/AsyncQueue.scala:80:16]
      mem_3_duration <= io_enq_bits_duration;	// @[generators/rocket-chip/src/main/scala/util/AsyncQueue.scala:80:16]
      mem_3_k_p <= io_enq_bits_k_p;	// @[generators/rocket-chip/src/main/scala/util/AsyncQueue.scala:80:16]
      mem_3_k_i <= io_enq_bits_k_i;	// @[generators/rocket-chip/src/main/scala/util/AsyncQueue.scala:80:16]
      mem_3_p_control_only <= io_enq_bits_p_control_only;	// @[generators/rocket-chip/src/main/scala/util/AsyncQueue.scala:80:16]
      mem_3_nominal_adc_clock_freq <= io_enq_bits_nominal_adc_clock_freq;	// @[generators/rocket-chip/src/main/scala/util/AsyncQueue.scala:80:16]
    end
  end // always @(posedge)
  wire [2:0]  _widx_incremented_T = widx_widx_bin + {2'h0, io_enq_ready};	// @[generators/rocket-chip/src/main/scala/util/AsyncQueue.scala:52:25, :53:43, :89:29]
  wire [2:0]  widx_incremented = _sink_valid_io_out ? _widx_incremented_T : 3'h0;	// @[generators/rocket-chip/src/main/scala/util/AsyncQueue.scala:53:{23,43}, :104:30]
  wire [2:0]  widx = {widx_incremented[2], widx_incremented[1:0] ^ widx_incremented[2:1]};	// @[generators/rocket-chip/src/main/scala/util/AsyncQueue.scala:53:23, :54:{17,32}]
  always @(posedge clock or posedge reset) begin
    if (reset) begin
      widx_widx_bin <= 3'h0;	// @[generators/rocket-chip/src/main/scala/util/AsyncQueue.scala:52:25, :53:23]
      ready_reg <= 1'h0;	// @[generators/rocket-chip/src/main/scala/util/AsyncQueue.scala:80:16, :88:56]
      widx_gray <= 3'h0;	// @[generators/rocket-chip/src/main/scala/util/AsyncQueue.scala:53:23, :91:55]
    end
    else begin
      if (_sink_valid_io_out)	// @[generators/rocket-chip/src/main/scala/util/AsyncQueue.scala:104:30]
        widx_widx_bin <= _widx_incremented_T;	// @[generators/rocket-chip/src/main/scala/util/AsyncQueue.scala:52:25, :53:43]
      else	// @[generators/rocket-chip/src/main/scala/util/AsyncQueue.scala:104:30]
        widx_widx_bin <= 3'h0;	// @[generators/rocket-chip/src/main/scala/util/AsyncQueue.scala:52:25, :53:23]
      ready_reg <= _sink_valid_io_out & widx != (_ridx_ridx_gray_io_q ^ 3'h6);	// @[generators/rocket-chip/src/main/scala/util/AsyncQueue.scala:54:17, :83:{26,34,44}, :88:56, :104:30, generators/rocket-chip/src/main/scala/util/ShiftReg.scala:45:23]
      widx_gray <= widx;	// @[generators/rocket-chip/src/main/scala/util/AsyncQueue.scala:54:17, :91:55]
    end
  end // always @(posedge, posedge)
  `ifdef ENABLE_INITIAL_REG_
    `ifdef FIRRTL_BEFORE_INITIAL
      `FIRRTL_BEFORE_INITIAL
    `endif // FIRRTL_BEFORE_INITIAL
    logic [31:0] _RANDOM[0:13];
    initial begin
      `ifdef INIT_RANDOM_PROLOG_
        `INIT_RANDOM_PROLOG_
      `endif // INIT_RANDOM_PROLOG_
      `ifdef RANDOMIZE_REG_INIT
        for (logic [3:0] i = 4'h0; i < 4'hE; i += 4'h1) begin
          _RANDOM[i] = `RANDOM;
        end
        mem_0_restart = _RANDOM[4'h0][0];	// @[generators/rocket-chip/src/main/scala/util/AsyncQueue.scala:80:16]
        mem_0_mode = _RANDOM[4'h0][1];	// @[generators/rocket-chip/src/main/scala/util/AsyncQueue.scala:80:16]
        mem_0_duration = _RANDOM[4'h0][9:2];	// @[generators/rocket-chip/src/main/scala/util/AsyncQueue.scala:80:16]
        mem_0_k_p = {_RANDOM[4'h0][31:10], _RANDOM[4'h1][9:0]};	// @[generators/rocket-chip/src/main/scala/util/AsyncQueue.scala:80:16]
        mem_0_k_i = {_RANDOM[4'h1][31:10], _RANDOM[4'h2][9:0]};	// @[generators/rocket-chip/src/main/scala/util/AsyncQueue.scala:80:16]
        mem_0_p_control_only = _RANDOM[4'h2][10];	// @[generators/rocket-chip/src/main/scala/util/AsyncQueue.scala:80:16]
        mem_0_nominal_adc_clock_freq = {_RANDOM[4'h2][31:11], _RANDOM[4'h3][10:0]};	// @[generators/rocket-chip/src/main/scala/util/AsyncQueue.scala:80:16]
        mem_1_restart = _RANDOM[4'h3][11];	// @[generators/rocket-chip/src/main/scala/util/AsyncQueue.scala:80:16]
        mem_1_mode = _RANDOM[4'h3][12];	// @[generators/rocket-chip/src/main/scala/util/AsyncQueue.scala:80:16]
        mem_1_duration = _RANDOM[4'h3][20:13];	// @[generators/rocket-chip/src/main/scala/util/AsyncQueue.scala:80:16]
        mem_1_k_p = {_RANDOM[4'h3][31:21], _RANDOM[4'h4][20:0]};	// @[generators/rocket-chip/src/main/scala/util/AsyncQueue.scala:80:16]
        mem_1_k_i = {_RANDOM[4'h4][31:21], _RANDOM[4'h5][20:0]};	// @[generators/rocket-chip/src/main/scala/util/AsyncQueue.scala:80:16]
        mem_1_p_control_only = _RANDOM[4'h5][21];	// @[generators/rocket-chip/src/main/scala/util/AsyncQueue.scala:80:16]
        mem_1_nominal_adc_clock_freq = {_RANDOM[4'h5][31:22], _RANDOM[4'h6][21:0]};	// @[generators/rocket-chip/src/main/scala/util/AsyncQueue.scala:80:16]
        mem_2_restart = _RANDOM[4'h6][22];	// @[generators/rocket-chip/src/main/scala/util/AsyncQueue.scala:80:16]
        mem_2_mode = _RANDOM[4'h6][23];	// @[generators/rocket-chip/src/main/scala/util/AsyncQueue.scala:80:16]
        mem_2_duration = _RANDOM[4'h6][31:24];	// @[generators/rocket-chip/src/main/scala/util/AsyncQueue.scala:80:16]
        mem_2_k_p = _RANDOM[4'h7];	// @[generators/rocket-chip/src/main/scala/util/AsyncQueue.scala:80:16]
        mem_2_k_i = _RANDOM[4'h8];	// @[generators/rocket-chip/src/main/scala/util/AsyncQueue.scala:80:16]
        mem_2_p_control_only = _RANDOM[4'h9][0];	// @[generators/rocket-chip/src/main/scala/util/AsyncQueue.scala:80:16]
        mem_2_nominal_adc_clock_freq = {_RANDOM[4'h9][31:1], _RANDOM[4'hA][0]};	// @[generators/rocket-chip/src/main/scala/util/AsyncQueue.scala:80:16]
        mem_3_restart = _RANDOM[4'hA][1];	// @[generators/rocket-chip/src/main/scala/util/AsyncQueue.scala:80:16]
        mem_3_mode = _RANDOM[4'hA][2];	// @[generators/rocket-chip/src/main/scala/util/AsyncQueue.scala:80:16]
        mem_3_duration = _RANDOM[4'hA][10:3];	// @[generators/rocket-chip/src/main/scala/util/AsyncQueue.scala:80:16]
        mem_3_k_p = {_RANDOM[4'hA][31:11], _RANDOM[4'hB][10:0]};	// @[generators/rocket-chip/src/main/scala/util/AsyncQueue.scala:80:16]
        mem_3_k_i = {_RANDOM[4'hB][31:11], _RANDOM[4'hC][10:0]};	// @[generators/rocket-chip/src/main/scala/util/AsyncQueue.scala:80:16]
        mem_3_p_control_only = _RANDOM[4'hC][11];	// @[generators/rocket-chip/src/main/scala/util/AsyncQueue.scala:80:16]
        mem_3_nominal_adc_clock_freq = {_RANDOM[4'hC][31:12], _RANDOM[4'hD][11:0]};	// @[generators/rocket-chip/src/main/scala/util/AsyncQueue.scala:80:16]
        widx_widx_bin = _RANDOM[4'hD][14:12];	// @[generators/rocket-chip/src/main/scala/util/AsyncQueue.scala:52:25, :80:16]
        ready_reg = _RANDOM[4'hD][15];	// @[generators/rocket-chip/src/main/scala/util/AsyncQueue.scala:80:16, :88:56]
        widx_gray = _RANDOM[4'hD][18:16];	// @[generators/rocket-chip/src/main/scala/util/AsyncQueue.scala:80:16, :91:55]
      `endif // RANDOMIZE_REG_INIT
      if (reset) begin
        widx_widx_bin = 3'h0;	// @[generators/rocket-chip/src/main/scala/util/AsyncQueue.scala:52:25, :53:23]
        ready_reg = 1'h0;	// @[generators/rocket-chip/src/main/scala/util/AsyncQueue.scala:80:16, :88:56]
        widx_gray = 3'h0;	// @[generators/rocket-chip/src/main/scala/util/AsyncQueue.scala:53:23, :91:55]
      end
    end // initial
    `ifdef FIRRTL_AFTER_INITIAL
      `FIRRTL_AFTER_INITIAL
    `endif // FIRRTL_AFTER_INITIAL
  `endif // ENABLE_INITIAL_REG_
  AsyncResetSynchronizerShiftReg_w3_d3_i0 ridx_ridx_gray (	// @[generators/rocket-chip/src/main/scala/util/ShiftReg.scala:45:23]
    .clock (clock),
    .reset (reset),
    .io_d  (io_async_ridx),
    .io_q  (_ridx_ridx_gray_io_q)
  );
  AsyncValidSync source_valid_0 (	// @[generators/rocket-chip/src/main/scala/util/AsyncQueue.scala:100:32]
    .io_in  (1'h1),	// @[generators/rocket-chip/src/main/scala/util/AsyncQueue.scala:71:14, :100:32]
    .io_out (_source_valid_0_io_out),
    .clock  (clock),
    .reset  (reset | ~io_async_safe_sink_reset_n)	// @[generators/rocket-chip/src/main/scala/util/AsyncQueue.scala:105:{43,46}]
  );
  AsyncValidSync source_valid_1 (	// @[generators/rocket-chip/src/main/scala/util/AsyncQueue.scala:101:32]
    .io_in  (_source_valid_0_io_out),	// @[generators/rocket-chip/src/main/scala/util/AsyncQueue.scala:100:32]
    .io_out (io_async_safe_widx_valid),
    .clock  (clock),
    .reset  (reset | ~io_async_safe_sink_reset_n)	// @[generators/rocket-chip/src/main/scala/util/AsyncQueue.scala:105:46, :106:43]
  );
  AsyncValidSync sink_extend (	// @[generators/rocket-chip/src/main/scala/util/AsyncQueue.scala:103:30]
    .io_in  (io_async_safe_ridx_valid),
    .io_out (_sink_extend_io_out),
    .clock  (clock),
    .reset  (reset | ~io_async_safe_sink_reset_n)	// @[generators/rocket-chip/src/main/scala/util/AsyncQueue.scala:105:46, :107:43]
  );
  AsyncValidSync sink_valid (	// @[generators/rocket-chip/src/main/scala/util/AsyncQueue.scala:104:30]
    .io_in  (_sink_extend_io_out),	// @[generators/rocket-chip/src/main/scala/util/AsyncQueue.scala:103:30]
    .io_out (_sink_valid_io_out),
    .clock  (clock),
    .reset  (reset)
  );
  assign io_async_mem_0_restart = mem_0_restart;	// @[generators/rocket-chip/src/main/scala/util/AsyncQueue.scala:80:16]
  assign io_async_mem_0_mode = mem_0_mode;	// @[generators/rocket-chip/src/main/scala/util/AsyncQueue.scala:80:16]
  assign io_async_mem_0_duration = mem_0_duration;	// @[generators/rocket-chip/src/main/scala/util/AsyncQueue.scala:80:16]
  assign io_async_mem_0_k_p = mem_0_k_p;	// @[generators/rocket-chip/src/main/scala/util/AsyncQueue.scala:80:16]
  assign io_async_mem_0_k_i = mem_0_k_i;	// @[generators/rocket-chip/src/main/scala/util/AsyncQueue.scala:80:16]
  assign io_async_mem_0_p_control_only = mem_0_p_control_only;	// @[generators/rocket-chip/src/main/scala/util/AsyncQueue.scala:80:16]
  assign io_async_mem_0_nominal_adc_clock_freq = mem_0_nominal_adc_clock_freq;	// @[generators/rocket-chip/src/main/scala/util/AsyncQueue.scala:80:16]
  assign io_async_mem_1_restart = mem_1_restart;	// @[generators/rocket-chip/src/main/scala/util/AsyncQueue.scala:80:16]
  assign io_async_mem_1_mode = mem_1_mode;	// @[generators/rocket-chip/src/main/scala/util/AsyncQueue.scala:80:16]
  assign io_async_mem_1_duration = mem_1_duration;	// @[generators/rocket-chip/src/main/scala/util/AsyncQueue.scala:80:16]
  assign io_async_mem_1_k_p = mem_1_k_p;	// @[generators/rocket-chip/src/main/scala/util/AsyncQueue.scala:80:16]
  assign io_async_mem_1_k_i = mem_1_k_i;	// @[generators/rocket-chip/src/main/scala/util/AsyncQueue.scala:80:16]
  assign io_async_mem_1_p_control_only = mem_1_p_control_only;	// @[generators/rocket-chip/src/main/scala/util/AsyncQueue.scala:80:16]
  assign io_async_mem_1_nominal_adc_clock_freq = mem_1_nominal_adc_clock_freq;	// @[generators/rocket-chip/src/main/scala/util/AsyncQueue.scala:80:16]
  assign io_async_mem_2_restart = mem_2_restart;	// @[generators/rocket-chip/src/main/scala/util/AsyncQueue.scala:80:16]
  assign io_async_mem_2_mode = mem_2_mode;	// @[generators/rocket-chip/src/main/scala/util/AsyncQueue.scala:80:16]
  assign io_async_mem_2_duration = mem_2_duration;	// @[generators/rocket-chip/src/main/scala/util/AsyncQueue.scala:80:16]
  assign io_async_mem_2_k_p = mem_2_k_p;	// @[generators/rocket-chip/src/main/scala/util/AsyncQueue.scala:80:16]
  assign io_async_mem_2_k_i = mem_2_k_i;	// @[generators/rocket-chip/src/main/scala/util/AsyncQueue.scala:80:16]
  assign io_async_mem_2_p_control_only = mem_2_p_control_only;	// @[generators/rocket-chip/src/main/scala/util/AsyncQueue.scala:80:16]
  assign io_async_mem_2_nominal_adc_clock_freq = mem_2_nominal_adc_clock_freq;	// @[generators/rocket-chip/src/main/scala/util/AsyncQueue.scala:80:16]
  assign io_async_mem_3_restart = mem_3_restart;	// @[generators/rocket-chip/src/main/scala/util/AsyncQueue.scala:80:16]
  assign io_async_mem_3_mode = mem_3_mode;	// @[generators/rocket-chip/src/main/scala/util/AsyncQueue.scala:80:16]
  assign io_async_mem_3_duration = mem_3_duration;	// @[generators/rocket-chip/src/main/scala/util/AsyncQueue.scala:80:16]
  assign io_async_mem_3_k_p = mem_3_k_p;	// @[generators/rocket-chip/src/main/scala/util/AsyncQueue.scala:80:16]
  assign io_async_mem_3_k_i = mem_3_k_i;	// @[generators/rocket-chip/src/main/scala/util/AsyncQueue.scala:80:16]
  assign io_async_mem_3_p_control_only = mem_3_p_control_only;	// @[generators/rocket-chip/src/main/scala/util/AsyncQueue.scala:80:16]
  assign io_async_mem_3_nominal_adc_clock_freq = mem_3_nominal_adc_clock_freq;	// @[generators/rocket-chip/src/main/scala/util/AsyncQueue.scala:80:16]
  assign io_async_widx = widx_gray;	// @[generators/rocket-chip/src/main/scala/util/AsyncQueue.scala:91:55]
  assign io_async_safe_source_reset_n = ~reset;	// @[generators/rocket-chip/src/main/scala/util/AsyncQueue.scala:121:27]
endmodule

