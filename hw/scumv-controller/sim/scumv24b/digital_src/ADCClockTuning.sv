// Generated by CIRCT unknown git version
// Standard header to adapt well known macros for register randomization.
`ifndef RANDOMIZE
  `ifdef RANDOMIZE_MEM_INIT
    `define RANDOMIZE
  `endif // RANDOMIZE_MEM_INIT
`endif // not def RANDOMIZE
`ifndef RANDOMIZE
  `ifdef RANDOMIZE_REG_INIT
    `define RANDOMIZE
  `endif // RANDOMIZE_REG_INIT
`endif // not def RANDOMIZE

// RANDOM may be set to an expression that produces a 32-bit random unsigned value.
`ifndef RANDOM
  `define RANDOM $random
`endif // not def RANDOM

// Users can define INIT_RANDOM as general code that gets injected into the
// initializer block for modules with registers.
`ifndef INIT_RANDOM
  `define INIT_RANDOM
`endif // not def INIT_RANDOM

// If using random initialization, you can also define RANDOMIZE_DELAY to
// customize the delay used, otherwise 0.002 is used.
`ifndef RANDOMIZE_DELAY
  `define RANDOMIZE_DELAY 0.002
`endif // not def RANDOMIZE_DELAY

// Define INIT_RANDOM_PROLOG_ for use in our modules below.
`ifndef INIT_RANDOM_PROLOG_
  `ifdef RANDOMIZE
    `ifdef VERILATOR
      `define INIT_RANDOM_PROLOG_ `INIT_RANDOM
    `else  // VERILATOR
      `define INIT_RANDOM_PROLOG_ `INIT_RANDOM #`RANDOMIZE_DELAY begin end
    `endif // VERILATOR
  `else  // RANDOMIZE
    `define INIT_RANDOM_PROLOG_
  `endif // RANDOMIZE
`endif // not def INIT_RANDOM_PROLOG_

// Include register initializers in init blocks unless synthesis is set
`ifndef SYNTHESIS
  `ifndef ENABLE_INITIAL_REG_
    `define ENABLE_INITIAL_REG_
  `endif // not def ENABLE_INITIAL_REG_
`endif // not def SYNTHESIS

// Include rmemory initializers in init blocks unless synthesis is set
`ifndef SYNTHESIS
  `ifndef ENABLE_INITIAL_MEM_
    `define ENABLE_INITIAL_MEM_
  `endif // not def ENABLE_INITIAL_MEM_
`endif // not def SYNTHESIS

// Standard header to adapt well known macros for prints and assertions.

// Users can define 'PRINTF_COND' to add an extra gate to prints.
`ifndef PRINTF_COND_
  `ifdef PRINTF_COND
    `define PRINTF_COND_ (`PRINTF_COND)
  `else  // PRINTF_COND
    `define PRINTF_COND_ 1
  `endif // PRINTF_COND
`endif // not def PRINTF_COND_

// Users can define 'ASSERT_VERBOSE_COND' to add an extra gate to assert error printing.
`ifndef ASSERT_VERBOSE_COND_
  `ifdef ASSERT_VERBOSE_COND
    `define ASSERT_VERBOSE_COND_ (`ASSERT_VERBOSE_COND)
  `else  // ASSERT_VERBOSE_COND
    `define ASSERT_VERBOSE_COND_ 1
  `endif // ASSERT_VERBOSE_COND
`endif // not def ASSERT_VERBOSE_COND_

// Users can define 'STOP_COND' to add an extra gate to stop conditions.
`ifndef STOP_COND_
  `ifdef STOP_COND
    `define STOP_COND_ (`STOP_COND)
  `else  // STOP_COND
    `define STOP_COND_ 1
  `endif // STOP_COND
`endif // not def STOP_COND_

module ADCClockTuning(
  input         clock,
                reset,
                io_sop,	// @[generators/baseband/src/main/scala/modem/ADCClockTuning.scala:58:14]
                io_eop,	// @[generators/baseband/src/main/scala/modem/ADCClockTuning.scala:58:14]
  input  [63:0] io_lo_counter,	// @[generators/baseband/src/main/scala/modem/ADCClockTuning.scala:58:14]
  input         io_state_input_restart,	// @[generators/baseband/src/main/scala/modem/ADCClockTuning.scala:58:14]
                io_state_input_mode,	// @[generators/baseband/src/main/scala/modem/ADCClockTuning.scala:58:14]
  input  [7:0]  io_state_input_duration,	// @[generators/baseband/src/main/scala/modem/ADCClockTuning.scala:58:14]
  input  [31:0] io_state_input_k_p,	// @[generators/baseband/src/main/scala/modem/ADCClockTuning.scala:58:14]
                io_state_input_k_i,	// @[generators/baseband/src/main/scala/modem/ADCClockTuning.scala:58:14]
  input         io_state_input_p_control_only,	// @[generators/baseband/src/main/scala/modem/ADCClockTuning.scala:58:14]
  input  [31:0] io_state_input_nominal_adc_clock_freq,	// @[generators/baseband/src/main/scala/modem/ADCClockTuning.scala:58:14]
  output [7:0]  io_state_output_control_word,	// @[generators/baseband/src/main/scala/modem/ADCClockTuning.scala:58:14]
  output [1:0]  io_state_output_sop_eop_debug,	// @[generators/baseband/src/main/scala/modem/ADCClockTuning.scala:58:14]
  output [31:0] io_state_output_curr_calc_adc_clock_freq_debug,	// @[generators/baseband/src/main/scala/modem/ADCClockTuning.scala:58:14]
  output [63:0] io_state_output_lo_start_debug,	// @[generators/baseband/src/main/scala/modem/ADCClockTuning.scala:58:14]
                io_state_output_lo_stop_debug,	// @[generators/baseband/src/main/scala/modem/ADCClockTuning.scala:58:14]
  output [31:0] io_state_output_adc_ticks_counter,	// @[generators/baseband/src/main/scala/modem/ADCClockTuning.scala:58:14]
                io_state_output_f_err,	// @[generators/baseband/src/main/scala/modem/ADCClockTuning.scala:58:14]
                io_state_output_accumulated_err,	// @[generators/baseband/src/main/scala/modem/ADCClockTuning.scala:58:14]
  output        io_state_output_controller_active,	// @[generators/baseband/src/main/scala/modem/ADCClockTuning.scala:58:14]
                io_state_output_trigger_controller,	// @[generators/baseband/src/main/scala/modem/ADCClockTuning.scala:58:14]
  output [9:0]  io_state_output_p_term_trunc,	// @[generators/baseband/src/main/scala/modem/ADCClockTuning.scala:58:14]
                io_state_output_i_term_trunc,	// @[generators/baseband/src/main/scala/modem/ADCClockTuning.scala:58:14]
  output        io_state_output_controller_state	// @[generators/baseband/src/main/scala/modem/ADCClockTuning.scala:58:14]
);

  reg  [31:0] adc_ticks_counter;	// @[generators/baseband/src/main/scala/modem/ADCClockTuning.scala:65:34]
  reg  [31:0] adc_ticks_threshold;	// @[generators/baseband/src/main/scala/modem/ADCClockTuning.scala:66:36]
  reg  [9:0]  control_word;	// @[generators/baseband/src/main/scala/modem/ADCClockTuning.scala:69:29]
  reg  [9:0]  control_word_prev;	// @[generators/baseband/src/main/scala/modem/ADCClockTuning.scala:70:34]
  reg  [63:0] lo_start;	// @[generators/baseband/src/main/scala/modem/ADCClockTuning.scala:72:25]
  reg  [63:0] lo_stop;	// @[generators/baseband/src/main/scala/modem/ADCClockTuning.scala:73:24]
  reg  [31:0] accumulated_err;	// @[generators/baseband/src/main/scala/modem/ADCClockTuning.scala:78:32]
  reg         controller_active;	// @[generators/baseband/src/main/scala/modem/ADCClockTuning.scala:80:34]
  reg         trigger_controller;	// @[generators/baseband/src/main/scala/modem/ADCClockTuning.scala:81:35]
  reg         prev_mode;	// @[generators/baseband/src/main/scala/modem/ADCClockTuning.scala:82:26]
  reg         controller_state;	// @[generators/baseband/src/main/scala/modem/ADCClockTuning.scala:87:33]
  wire [63:0] _curr_calc_adc_clock_freq_T_3 = {32'h0, adc_ticks_threshold} * 64'h11E1A300 / (lo_stop - lo_start);	// @[generators/baseband/src/main/scala/modem/ADCClockTuning.scala:65:34, :66:36, :72:25, :73:24, :90:{38,60,71}]
  wire [31:0] _f_err_fixed_new_WIRE = io_state_input_nominal_adc_clock_freq - _curr_calc_adc_clock_freq_T_3[31:0];	// @[generators/baseband/src/main/scala/modem/ADCClockTuning.scala:90:{28,60}, :91:57]
  wire [91:0] _p_term_new_WIRE = {{60{io_state_input_k_p[31]}}, io_state_input_k_p} * {{30{_f_err_fixed_new_WIRE[31]}}, _f_err_fixed_new_WIRE, 30'h0};	// @[generators/baseband/src/main/scala/modem/ADCClockTuning.scala:91:57, :92:15, :162:32]
  wire [9:0]  p_term_trunc = $signed(_p_term_new_WIRE[91:30]) < 62'sh0 ? _p_term_new_WIRE[69:60] + 10'h1 : _p_term_new_WIRE[69:60];	// @[generators/baseband/src/main/scala/modem/ADCClockTuning.scala:162:{10,32}, :163:{16,36}, :164:{18,43}, :166:18, tools/fixedpoint/src/main/scala/fixedpoint/FixedPoint.scala:208:79, :390:47]
  wire [91:0] _i_term_new_WIRE = {{60{io_state_input_k_i[31]}}, io_state_input_k_i} * {{30{accumulated_err[31]}}, accumulated_err, 30'h0};	// @[generators/baseband/src/main/scala/modem/ADCClockTuning.scala:78:32, :92:15, :169:32]
  wire [9:0]  i_term_trunc = $signed(_i_term_new_WIRE[91:30]) < 62'sh0 ? _i_term_new_WIRE[69:60] + 10'h1 : _i_term_new_WIRE[69:60];	// @[generators/baseband/src/main/scala/modem/ADCClockTuning.scala:164:43, :169:{10,32}, :170:{16,36}, :171:{18,43}, :173:18, tools/fixedpoint/src/main/scala/fixedpoint/FixedPoint.scala:208:79, :390:47]
  wire [9:0]  control_word_pos = io_state_input_p_control_only ? control_word_prev + p_term_trunc : p_term_trunc + i_term_trunc;	// @[generators/baseband/src/main/scala/modem/ADCClockTuning.scala:70:34, :163:36, :164:18, :166:18, :170:36, :171:18, :173:18, :176:40, :177:{22,43}, :179:{22,38}]
  wire        _GEN = io_state_input_restart | io_state_input_mode != prev_mode;	// @[generators/baseband/src/main/scala/modem/ADCClockTuning.scala:82:26, :122:{32,55}]
  wire        _GEN_0 = _GEN | ~(~io_state_input_mode | io_sop | ~io_eop);	// @[generators/baseband/src/main/scala/modem/ADCClockTuning.scala:65:34, :122:{32,70}, :123:23, :129:40, :130:21, :132:27]
  wire        _GEN_1 = controller_active & ~io_state_input_restart & io_state_input_mode == prev_mode & ~io_eop;	// @[generators/baseband/src/main/scala/modem/ADCClockTuning.scala:80:34, :82:26, :144:{30,77,91,94}]
  wire        _GEN_2 = adc_ticks_counter == 32'h0 & ~trigger_controller;	// @[generators/baseband/src/main/scala/modem/ADCClockTuning.scala:65:34, :81:35, :145:{29,37,40}]
  wire        _GEN_3 = adc_ticks_counter >= adc_ticks_threshold;	// @[generators/baseband/src/main/scala/modem/ADCClockTuning.scala:65:34, :66:36, :148:35]
  wire        _GEN_4 = ~_GEN_1 | _GEN_2 | ~_GEN_3;	// @[generators/baseband/src/main/scala/modem/ADCClockTuning.scala:122:70, :144:{91,103}, :145:{37,61}, :148:{35,59}]
  always @(posedge clock) begin
    if (reset) begin
      adc_ticks_counter <= 32'h0;	// @[generators/baseband/src/main/scala/modem/ADCClockTuning.scala:65:34]
      adc_ticks_threshold <= 32'h0;	// @[generators/baseband/src/main/scala/modem/ADCClockTuning.scala:65:34, :66:36]
      control_word <= 10'h20;	// @[generators/baseband/src/main/scala/modem/ADCClockTuning.scala:69:29]
      control_word_prev <= 10'h20;	// @[generators/baseband/src/main/scala/modem/ADCClockTuning.scala:69:29, :70:34]
      lo_start <= 64'h0;	// @[generators/baseband/src/main/scala/modem/ADCClockTuning.scala:72:25]
      lo_stop <= 64'h0;	// @[generators/baseband/src/main/scala/modem/ADCClockTuning.scala:72:25, :73:24]
      accumulated_err <= 32'h0;	// @[generators/baseband/src/main/scala/modem/ADCClockTuning.scala:65:34, :78:32]
      controller_active <= 1'h0;	// @[generators/baseband/src/main/scala/modem/ADCClockTuning.scala:80:34, :187:30]
      trigger_controller <= 1'h0;	// @[generators/baseband/src/main/scala/modem/ADCClockTuning.scala:81:35, :187:30]
      controller_state <= 1'h0;	// @[generators/baseband/src/main/scala/modem/ADCClockTuning.scala:87:33, :187:30]
    end
    else begin
      if (_GEN_1) begin	// @[generators/baseband/src/main/scala/modem/ADCClockTuning.scala:144:91]
        if (_GEN_2)	// @[generators/baseband/src/main/scala/modem/ADCClockTuning.scala:145:37]
          adc_ticks_counter <= adc_ticks_counter + 32'h1;	// @[generators/baseband/src/main/scala/modem/ADCClockTuning.scala:65:34, :147:46]
        else if (_GEN_3 | trigger_controller)	// @[generators/baseband/src/main/scala/modem/ADCClockTuning.scala:81:35, :148:{35,59}, :150:25, :154:37, :155:25, :157:25]
          adc_ticks_counter <= 32'h0;	// @[generators/baseband/src/main/scala/modem/ADCClockTuning.scala:65:34]
        else	// @[generators/baseband/src/main/scala/modem/ADCClockTuning.scala:148:59, :150:25, :154:37, :155:25, :157:25]
          adc_ticks_counter <= adc_ticks_counter + 32'h1;	// @[generators/baseband/src/main/scala/modem/ADCClockTuning.scala:65:34, :147:46, :157:46]
      end
      else if (_GEN_0)	// @[generators/baseband/src/main/scala/modem/ADCClockTuning.scala:122:70, :123:23, :129:40]
        adc_ticks_counter <= 32'h0;	// @[generators/baseband/src/main/scala/modem/ADCClockTuning.scala:65:34]
      adc_ticks_threshold <= {19'h0, io_state_input_duration, 5'h0};	// @[generators/baseband/src/main/scala/modem/ADCClockTuning.scala:66:36, :88:{23,50}]
      if (trigger_controller & controller_state)	// @[generators/baseband/src/main/scala/modem/ADCClockTuning.scala:69:29, :81:35, :87:33, :182:29, :183:37]
        control_word <= $signed(control_word_pos) < 10'sh0 ? 10'h0 : $signed(control_word_pos) > 10'shFF ? 10'hFF : control_word_pos;	// @[generators/baseband/src/main/scala/modem/ADCClockTuning.scala:69:29, :176:40, :177:22, :179:22, :187:{30,37}, :188:22, :189:{36,45}, :190:22, :192:22]
      if (_GEN_4) begin	// @[generators/baseband/src/main/scala/modem/ADCClockTuning.scala:70:34, :122:70, :144:103, :145:61]
      end
      else	// @[generators/baseband/src/main/scala/modem/ADCClockTuning.scala:70:34, :144:103, :145:61]
        control_word_prev <= control_word;	// @[generators/baseband/src/main/scala/modem/ADCClockTuning.scala:69:29, :70:34]
      if (_GEN_1 & _GEN_2)	// @[generators/baseband/src/main/scala/modem/ADCClockTuning.scala:122:70, :144:{91,103}, :145:{37,61}, :146:16]
        lo_start <= io_lo_counter;	// @[generators/baseband/src/main/scala/modem/ADCClockTuning.scala:72:25]
      else if (_GEN_0)	// @[generators/baseband/src/main/scala/modem/ADCClockTuning.scala:122:70, :123:23, :124:14, :129:40]
        lo_start <= 64'h0;	// @[generators/baseband/src/main/scala/modem/ADCClockTuning.scala:72:25]
      if (_GEN_4) begin	// @[generators/baseband/src/main/scala/modem/ADCClockTuning.scala:122:70, :144:103, :145:61]
        if (_GEN_0)	// @[generators/baseband/src/main/scala/modem/ADCClockTuning.scala:122:70, :123:23, :125:13, :129:40]
          lo_stop <= 64'h0;	// @[generators/baseband/src/main/scala/modem/ADCClockTuning.scala:72:25, :73:24]
      end
      else	// @[generators/baseband/src/main/scala/modem/ADCClockTuning.scala:122:70, :144:103, :145:61]
        lo_stop <= io_lo_counter;	// @[generators/baseband/src/main/scala/modem/ADCClockTuning.scala:73:24]
      if (trigger_controller & ~controller_state)	// @[generators/baseband/src/main/scala/modem/ADCClockTuning.scala:81:35, :87:33, :122:70, :182:29, :183:{28,37}, :184:23]
        accumulated_err <= accumulated_err + _f_err_fixed_new_WIRE;	// @[generators/baseband/src/main/scala/modem/ADCClockTuning.scala:78:32, :91:57, :184:42]
      else if (_GEN_0)	// @[generators/baseband/src/main/scala/modem/ADCClockTuning.scala:122:70, :123:23, :126:21, :129:40]
        accumulated_err <= 32'h0;	// @[generators/baseband/src/main/scala/modem/ADCClockTuning.scala:65:34, :78:32]
      controller_active <= ~_GEN & (~io_state_input_mode | io_sop | ~io_eop & controller_active);	// @[generators/baseband/src/main/scala/modem/ADCClockTuning.scala:65:34, :80:34, :122:{32,70}, :127:23, :129:40, :130:21, :132:27, :137:27, :140:25]
      trigger_controller <= (~trigger_controller | ~controller_state) & (_GEN_1 & ~_GEN_2 & _GEN_3 | trigger_controller);	// @[generators/baseband/src/main/scala/modem/ADCClockTuning.scala:81:35, :87:33, :144:{91,103}, :145:{37,61}, :148:{35,59}, :182:29, :183:{28,37}]
      controller_state <= trigger_controller ^ controller_state;	// @[generators/baseband/src/main/scala/modem/ADCClockTuning.scala:81:35, :87:33, :182:29, :183:37]
    end
    prev_mode <= io_state_input_mode;	// @[generators/baseband/src/main/scala/modem/ADCClockTuning.scala:82:26]
  end // always @(posedge)
  `ifdef ENABLE_INITIAL_REG_
    `ifdef FIRRTL_BEFORE_INITIAL
      `FIRRTL_BEFORE_INITIAL
    `endif // FIRRTL_BEFORE_INITIAL
    logic [31:0] _RANDOM[0:9];
    initial begin
      `ifdef INIT_RANDOM_PROLOG_
        `INIT_RANDOM_PROLOG_
      `endif // INIT_RANDOM_PROLOG_
      `ifdef RANDOMIZE_REG_INIT
        for (logic [3:0] i = 4'h0; i < 4'hA; i += 4'h1) begin
          _RANDOM[i] = `RANDOM;
        end
        adc_ticks_counter = _RANDOM[4'h0];	// @[generators/baseband/src/main/scala/modem/ADCClockTuning.scala:65:34]
        adc_ticks_threshold = _RANDOM[4'h1];	// @[generators/baseband/src/main/scala/modem/ADCClockTuning.scala:66:36]
        control_word = _RANDOM[4'h2][9:0];	// @[generators/baseband/src/main/scala/modem/ADCClockTuning.scala:69:29]
        control_word_prev = _RANDOM[4'h2][19:10];	// @[generators/baseband/src/main/scala/modem/ADCClockTuning.scala:69:29, :70:34]
        lo_start = {_RANDOM[4'h2][31:20], _RANDOM[4'h3], _RANDOM[4'h4][19:0]};	// @[generators/baseband/src/main/scala/modem/ADCClockTuning.scala:69:29, :72:25]
        lo_stop = {_RANDOM[4'h4][31:20], _RANDOM[4'h5], _RANDOM[4'h6][19:0]};	// @[generators/baseband/src/main/scala/modem/ADCClockTuning.scala:72:25, :73:24]
        accumulated_err = {_RANDOM[4'h8][31:20], _RANDOM[4'h9][19:0]};	// @[generators/baseband/src/main/scala/modem/ADCClockTuning.scala:78:32]
        controller_active = _RANDOM[4'h9][20];	// @[generators/baseband/src/main/scala/modem/ADCClockTuning.scala:78:32, :80:34]
        trigger_controller = _RANDOM[4'h9][21];	// @[generators/baseband/src/main/scala/modem/ADCClockTuning.scala:78:32, :81:35]
        prev_mode = _RANDOM[4'h9][22];	// @[generators/baseband/src/main/scala/modem/ADCClockTuning.scala:78:32, :82:26]
        controller_state = _RANDOM[4'h9][23];	// @[generators/baseband/src/main/scala/modem/ADCClockTuning.scala:78:32, :87:33]
      `endif // RANDOMIZE_REG_INIT
    end // initial
    `ifdef FIRRTL_AFTER_INITIAL
      `FIRRTL_AFTER_INITIAL
    `endif // FIRRTL_AFTER_INITIAL
  `endif // ENABLE_INITIAL_REG_
  assign io_state_output_control_word = control_word[7:0];	// @[generators/baseband/src/main/scala/modem/ADCClockTuning.scala:69:29, :95:47]
  assign io_state_output_sop_eop_debug = {io_sop, io_eop};	// @[generators/baseband/src/main/scala/modem/ADCClockTuning.scala:96:39]
  assign io_state_output_curr_calc_adc_clock_freq_debug = _curr_calc_adc_clock_freq_T_3[31:0];	// @[generators/baseband/src/main/scala/modem/ADCClockTuning.scala:90:{28,60}]
  assign io_state_output_lo_start_debug = lo_start;	// @[generators/baseband/src/main/scala/modem/ADCClockTuning.scala:72:25]
  assign io_state_output_lo_stop_debug = lo_stop;	// @[generators/baseband/src/main/scala/modem/ADCClockTuning.scala:73:24]
  assign io_state_output_adc_ticks_counter = adc_ticks_counter;	// @[generators/baseband/src/main/scala/modem/ADCClockTuning.scala:65:34]
  assign io_state_output_f_err = _f_err_fixed_new_WIRE;	// @[generators/baseband/src/main/scala/modem/ADCClockTuning.scala:91:57]
  assign io_state_output_accumulated_err = accumulated_err;	// @[generators/baseband/src/main/scala/modem/ADCClockTuning.scala:78:32]
  assign io_state_output_controller_active = controller_active;	// @[generators/baseband/src/main/scala/modem/ADCClockTuning.scala:80:34]
  assign io_state_output_trigger_controller = trigger_controller;	// @[generators/baseband/src/main/scala/modem/ADCClockTuning.scala:81:35]
  assign io_state_output_p_term_trunc = p_term_trunc;	// @[generators/baseband/src/main/scala/modem/ADCClockTuning.scala:163:36, :164:18, :166:18]
  assign io_state_output_i_term_trunc = i_term_trunc;	// @[generators/baseband/src/main/scala/modem/ADCClockTuning.scala:170:36, :171:18, :173:18]
  assign io_state_output_controller_state = controller_state;	// @[generators/baseband/src/main/scala/modem/ADCClockTuning.scala:87:33]
endmodule

