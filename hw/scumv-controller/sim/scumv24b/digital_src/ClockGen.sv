// Generated by CIRCT unknown git version
// Standard header to adapt well known macros for register randomization.
`ifndef RANDOMIZE
  `ifdef RANDOMIZE_MEM_INIT
    `define RANDOMIZE
  `endif // RANDOMIZE_MEM_INIT
`endif // not def RANDOMIZE
`ifndef RANDOMIZE
  `ifdef RANDOMIZE_REG_INIT
    `define RANDOMIZE
  `endif // RANDOMIZE_REG_INIT
`endif // not def RANDOMIZE

// RANDOM may be set to an expression that produces a 32-bit random unsigned value.
`ifndef RANDOM
  `define RANDOM $random
`endif // not def RANDOM

// Users can define INIT_RANDOM as general code that gets injected into the
// initializer block for modules with registers.
`ifndef INIT_RANDOM
  `define INIT_RANDOM
`endif // not def INIT_RANDOM

// If using random initialization, you can also define RANDOMIZE_DELAY to
// customize the delay used, otherwise 0.002 is used.
`ifndef RANDOMIZE_DELAY
  `define RANDOMIZE_DELAY 0.002
`endif // not def RANDOMIZE_DELAY

// Define INIT_RANDOM_PROLOG_ for use in our modules below.
`ifndef INIT_RANDOM_PROLOG_
  `ifdef RANDOMIZE
    `ifdef VERILATOR
      `define INIT_RANDOM_PROLOG_ `INIT_RANDOM
    `else  // VERILATOR
      `define INIT_RANDOM_PROLOG_ `INIT_RANDOM #`RANDOMIZE_DELAY begin end
    `endif // VERILATOR
  `else  // RANDOMIZE
    `define INIT_RANDOM_PROLOG_
  `endif // RANDOMIZE
`endif // not def INIT_RANDOM_PROLOG_

// Include register initializers in init blocks unless synthesis is set
`ifndef SYNTHESIS
  `ifndef ENABLE_INITIAL_REG_
    `define ENABLE_INITIAL_REG_
  `endif // not def ENABLE_INITIAL_REG_
`endif // not def SYNTHESIS

// Include rmemory initializers in init blocks unless synthesis is set
`ifndef SYNTHESIS
  `ifndef ENABLE_INITIAL_MEM_
    `define ENABLE_INITIAL_MEM_
  `endif // not def ENABLE_INITIAL_MEM_
`endif // not def SYNTHESIS

// Standard header to adapt well known macros for prints and assertions.

// Users can define 'PRINTF_COND' to add an extra gate to prints.
`ifndef PRINTF_COND_
  `ifdef PRINTF_COND
    `define PRINTF_COND_ (`PRINTF_COND)
  `else  // PRINTF_COND
    `define PRINTF_COND_ 1
  `endif // PRINTF_COND
`endif // not def PRINTF_COND_

// Users can define 'ASSERT_VERBOSE_COND' to add an extra gate to assert error printing.
`ifndef ASSERT_VERBOSE_COND_
  `ifdef ASSERT_VERBOSE_COND
    `define ASSERT_VERBOSE_COND_ (`ASSERT_VERBOSE_COND)
  `else  // ASSERT_VERBOSE_COND
    `define ASSERT_VERBOSE_COND_ 1
  `endif // ASSERT_VERBOSE_COND
`endif // not def ASSERT_VERBOSE_COND_

// Users can define 'STOP_COND' to add an extra gate to stop conditions.
`ifndef STOP_COND_
  `ifdef STOP_COND
    `define STOP_COND_ (`STOP_COND)
  `else  // STOP_COND
    `define STOP_COND_ 1
  `endif // STOP_COND
`endif // not def STOP_COND_

module ClockGen(
  input         clock,
                reset,
  input  [24:0] io_divider,	// @[generators/afe/src/main/scala/ClockGen.scala:8:14, generators/scumv-sensor-adc/src/main/scala/sensoradc/ClockGen.scala:7:14]
  output        io_clock_gen	// @[generators/afe/src/main/scala/ClockGen.scala:8:14, generators/scumv-sensor-adc/src/main/scala/sensoradc/ClockGen.scala:7:14]
);

  reg [25:0] counter;	// @[generators/afe/src/main/scala/ClockGen.scala:13:24, generators/scumv-sensor-adc/src/main/scala/sensoradc/ClockGen.scala:12:24]
  always @(posedge clock) begin
    if (reset)
      counter <= 26'h0;	// @[generators/afe/src/main/scala/ClockGen.scala:13:24, generators/scumv-sensor-adc/src/main/scala/sensoradc/ClockGen.scala:12:24]
    else if (counter == {1'h0, io_divider})	// @[generators/afe/src/main/scala/ClockGen.scala:13:24, :18:17, generators/scumv-sensor-adc/src/main/scala/sensoradc/ClockGen.scala:12:24, :17:17]
      counter <= 26'h0;	// @[generators/afe/src/main/scala/ClockGen.scala:13:24, generators/scumv-sensor-adc/src/main/scala/sensoradc/ClockGen.scala:12:24]
    else	// @[generators/afe/src/main/scala/ClockGen.scala:18:17, generators/scumv-sensor-adc/src/main/scala/sensoradc/ClockGen.scala:17:17]
      counter <= counter + 26'h1;	// @[generators/afe/src/main/scala/ClockGen.scala:13:24, :21:24, generators/scumv-sensor-adc/src/main/scala/sensoradc/ClockGen.scala:12:24, :20:24]
  end // always @(posedge)
  `ifdef ENABLE_INITIAL_REG_
    `ifdef FIRRTL_BEFORE_INITIAL
      `FIRRTL_BEFORE_INITIAL
    `endif // FIRRTL_BEFORE_INITIAL
    logic [31:0] _RANDOM[0:0];
    initial begin
      `ifdef INIT_RANDOM_PROLOG_
        `INIT_RANDOM_PROLOG_
      `endif // INIT_RANDOM_PROLOG_
      `ifdef RANDOMIZE_REG_INIT
        _RANDOM[/*Zero width*/ 1'b0] = `RANDOM;
        counter = _RANDOM[/*Zero width*/ 1'b0][25:0];	// @[generators/afe/src/main/scala/ClockGen.scala:13:24, generators/scumv-sensor-adc/src/main/scala/sensoradc/ClockGen.scala:12:24]
      `endif // RANDOMIZE_REG_INIT
    end // initial
    `ifdef FIRRTL_AFTER_INITIAL
      `FIRRTL_AFTER_INITIAL
    `endif // FIRRTL_AFTER_INITIAL
  `endif // ENABLE_INITIAL_REG_
  assign io_clock_gen = counter <= {2'h0, io_divider[24:1]};	// @[generators/afe/src/main/scala/ClockGen.scala:13:24, :17:30, :24:16, generators/scumv-sensor-adc/src/main/scala/sensoradc/ClockGen.scala:12:24, :16:30, :23:16]
endmodule

