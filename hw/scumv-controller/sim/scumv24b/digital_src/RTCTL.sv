// Generated by CIRCT unknown git version
// Standard header to adapt well known macros for register randomization.
`ifndef RANDOMIZE
  `ifdef RANDOMIZE_MEM_INIT
    `define RANDOMIZE
  `endif // RANDOMIZE_MEM_INIT
`endif // not def RANDOMIZE
`ifndef RANDOMIZE
  `ifdef RANDOMIZE_REG_INIT
    `define RANDOMIZE
  `endif // RANDOMIZE_REG_INIT
`endif // not def RANDOMIZE

// RANDOM may be set to an expression that produces a 32-bit random unsigned value.
`ifndef RANDOM
  `define RANDOM $random
`endif // not def RANDOM

// Users can define INIT_RANDOM as general code that gets injected into the
// initializer block for modules with registers.
`ifndef INIT_RANDOM
  `define INIT_RANDOM
`endif // not def INIT_RANDOM

// If using random initialization, you can also define RANDOMIZE_DELAY to
// customize the delay used, otherwise 0.002 is used.
`ifndef RANDOMIZE_DELAY
  `define RANDOMIZE_DELAY 0.002
`endif // not def RANDOMIZE_DELAY

// Define INIT_RANDOM_PROLOG_ for use in our modules below.
`ifndef INIT_RANDOM_PROLOG_
  `ifdef RANDOMIZE
    `ifdef VERILATOR
      `define INIT_RANDOM_PROLOG_ `INIT_RANDOM
    `else  // VERILATOR
      `define INIT_RANDOM_PROLOG_ `INIT_RANDOM #`RANDOMIZE_DELAY begin end
    `endif // VERILATOR
  `else  // RANDOMIZE
    `define INIT_RANDOM_PROLOG_
  `endif // RANDOMIZE
`endif // not def INIT_RANDOM_PROLOG_

// Include register initializers in init blocks unless synthesis is set
`ifndef SYNTHESIS
  `ifndef ENABLE_INITIAL_REG_
    `define ENABLE_INITIAL_REG_
  `endif // not def ENABLE_INITIAL_REG_
`endif // not def SYNTHESIS

// Include rmemory initializers in init blocks unless synthesis is set
`ifndef SYNTHESIS
  `ifndef ENABLE_INITIAL_MEM_
    `define ENABLE_INITIAL_MEM_
  `endif // not def ENABLE_INITIAL_MEM_
`endif // not def SYNTHESIS

// Standard header to adapt well known macros for prints and assertions.

// Users can define 'PRINTF_COND' to add an extra gate to prints.
`ifndef PRINTF_COND_
  `ifdef PRINTF_COND
    `define PRINTF_COND_ (`PRINTF_COND)
  `else  // PRINTF_COND
    `define PRINTF_COND_ 1
  `endif // PRINTF_COND
`endif // not def PRINTF_COND_

// Users can define 'ASSERT_VERBOSE_COND' to add an extra gate to assert error printing.
`ifndef ASSERT_VERBOSE_COND_
  `ifdef ASSERT_VERBOSE_COND
    `define ASSERT_VERBOSE_COND_ (`ASSERT_VERBOSE_COND)
  `else  // ASSERT_VERBOSE_COND
    `define ASSERT_VERBOSE_COND_ 1
  `endif // ASSERT_VERBOSE_COND
`endif // not def ASSERT_VERBOSE_COND_

// Users can define 'STOP_COND' to add an extra gate to stop conditions.
`ifndef STOP_COND_
  `ifdef STOP_COND
    `define STOP_COND_ (`STOP_COND)
  `else  // STOP_COND
    `define STOP_COND_ 1
  `endif // STOP_COND
`endif // not def STOP_COND_

module RTCTL(
  input         clock,
                reset,
  output        auto_int_xing_out_sync_0,	// @[generators/rocket-chip/src/main/scala/diplomacy/LazyModule.scala:366:18]
                auto_int_xing_out_sync_1,	// @[generators/rocket-chip/src/main/scala/diplomacy/LazyModule.scala:366:18]
                auto_int_xing_out_sync_2,	// @[generators/rocket-chip/src/main/scala/diplomacy/LazyModule.scala:366:18]
                auto_int_xing_out_sync_3,	// @[generators/rocket-chip/src/main/scala/diplomacy/LazyModule.scala:366:18]
                auto_int_xing_out_sync_4,	// @[generators/rocket-chip/src/main/scala/diplomacy/LazyModule.scala:366:18]
                auto_int_xing_out_sync_5,	// @[generators/rocket-chip/src/main/scala/diplomacy/LazyModule.scala:366:18]
                auto_control_xing_in_a_ready,	// @[generators/rocket-chip/src/main/scala/diplomacy/LazyModule.scala:366:18]
  input         auto_control_xing_in_a_valid,	// @[generators/rocket-chip/src/main/scala/diplomacy/LazyModule.scala:366:18]
  input  [2:0]  auto_control_xing_in_a_bits_opcode,	// @[generators/rocket-chip/src/main/scala/diplomacy/LazyModule.scala:366:18]
                auto_control_xing_in_a_bits_param,	// @[generators/rocket-chip/src/main/scala/diplomacy/LazyModule.scala:366:18]
  input  [1:0]  auto_control_xing_in_a_bits_size,	// @[generators/rocket-chip/src/main/scala/diplomacy/LazyModule.scala:366:18]
  input  [15:0] auto_control_xing_in_a_bits_source,	// @[generators/rocket-chip/src/main/scala/diplomacy/LazyModule.scala:366:18]
  input  [14:0] auto_control_xing_in_a_bits_address,	// @[generators/rocket-chip/src/main/scala/diplomacy/LazyModule.scala:366:18]
  input  [3:0]  auto_control_xing_in_a_bits_mask,	// @[generators/rocket-chip/src/main/scala/diplomacy/LazyModule.scala:366:18]
  input  [31:0] auto_control_xing_in_a_bits_data,	// @[generators/rocket-chip/src/main/scala/diplomacy/LazyModule.scala:366:18]
  input         auto_control_xing_in_a_bits_corrupt,	// @[generators/rocket-chip/src/main/scala/diplomacy/LazyModule.scala:366:18]
                auto_control_xing_in_d_ready,	// @[generators/rocket-chip/src/main/scala/diplomacy/LazyModule.scala:366:18]
  output        auto_control_xing_in_d_valid,	// @[generators/rocket-chip/src/main/scala/diplomacy/LazyModule.scala:366:18]
  output [2:0]  auto_control_xing_in_d_bits_opcode,	// @[generators/rocket-chip/src/main/scala/diplomacy/LazyModule.scala:366:18]
  output [1:0]  auto_control_xing_in_d_bits_size,	// @[generators/rocket-chip/src/main/scala/diplomacy/LazyModule.scala:366:18]
  output [15:0] auto_control_xing_in_d_bits_source,	// @[generators/rocket-chip/src/main/scala/diplomacy/LazyModule.scala:366:18]
  output [31:0] auto_control_xing_in_d_bits_data,	// @[generators/rocket-chip/src/main/scala/diplomacy/LazyModule.scala:366:18]
  input         io_rtc_clock	// @[generators/rtc-timer/src/main/scala/RTCTimer.scala:71:14]
);

  wire [11:0]       _prescaler_async_io_deq_bits;	// @[generators/rtc-timer/src/main/scala/RTCTimer.scala:127:31]
  wire              _task_trigovrflw_async_io_deq_bits;	// @[generators/rtc-timer/src/main/scala/RTCTimer.scala:117:37]
  wire              _task_clear_async_io_deq_bits;	// @[generators/rtc-timer/src/main/scala/RTCTimer.scala:107:32]
  wire              _task_start_async_io_deq_bits;	// @[generators/rtc-timer/src/main/scala/RTCTimer.scala:97:32]
  wire              _reset_sync_io_out;	// @[generators/rtc-timer/src/main/scala/RTCTimer.scala:91:26]
  wire [31:0]       _timerCounter_io_counter;	// @[generators/rtc-timer/src/main/scala/RTCTimer.scala:87:28]
  reg               task_start;	// @[generators/rtc-timer/src/main/scala/RTCTimer.scala:73:27]
  reg               task_clear;	// @[generators/rtc-timer/src/main/scala/RTCTimer.scala:74:27]
  reg               task_trigovrflw;	// @[generators/rtc-timer/src/main/scala/RTCTimer.scala:75:32]
  reg  [5:0]        interrupt_set;	// @[generators/rtc-timer/src/main/scala/RTCTimer.scala:76:30]
  reg  [31:0]       counter;	// @[generators/rtc-timer/src/main/scala/RTCTimer.scala:77:24]
  reg  [11:0]       prescaler;	// @[generators/rtc-timer/src/main/scala/RTCTimer.scala:78:26]
  reg  [31:0]       cc0;	// @[generators/rtc-timer/src/main/scala/RTCTimer.scala:79:20]
  reg  [31:0]       cc1;	// @[generators/rtc-timer/src/main/scala/RTCTimer.scala:80:20]
  reg  [31:0]       cc2;	// @[generators/rtc-timer/src/main/scala/RTCTimer.scala:81:20]
  reg  [31:0]       cc3;	// @[generators/rtc-timer/src/main/scala/RTCTimer.scala:82:20]
  reg               tick_interrupt_reg;	// @[generators/rtc-timer/src/main/scala/RTCTimer.scala:155:35]
  reg               overflow_interrupt_reg;	// @[generators/rtc-timer/src/main/scala/RTCTimer.scala:156:39]
  reg               overflow_inter_prior_trigger;	// @[generators/rtc-timer/src/main/scala/RTCTimer.scala:157:45]
  reg               compare0_interrupt_reg;	// @[generators/rtc-timer/src/main/scala/RTCTimer.scala:158:39]
  reg               compare0_inter_prior_trigger;	// @[generators/rtc-timer/src/main/scala/RTCTimer.scala:159:45]
  reg               compare1_interrupt_reg;	// @[generators/rtc-timer/src/main/scala/RTCTimer.scala:160:39]
  reg               compare1_inter_prior_trigger;	// @[generators/rtc-timer/src/main/scala/RTCTimer.scala:161:45]
  reg               compare2_interrupt_reg;	// @[generators/rtc-timer/src/main/scala/RTCTimer.scala:162:39]
  reg               compare2_inter_prior_trigger;	// @[generators/rtc-timer/src/main/scala/RTCTimer.scala:163:45]
  reg               compare3_interrupt_reg;	// @[generators/rtc-timer/src/main/scala/RTCTimer.scala:164:39]
  reg               compare3_inter_prior_trigger;	// @[generators/rtc-timer/src/main/scala/RTCTimer.scala:165:45]
  wire [5:0]        interrupt_wire = interrupt_set & {tick_interrupt_reg, overflow_interrupt_reg, compare0_interrupt_reg, compare1_interrupt_reg, compare2_interrupt_reg, compare3_interrupt_reg};	// @[generators/rtc-timer/src/main/scala/RTCTimer.scala:76:30, :155:35, :156:39, :158:39, :160:39, :162:39, :164:39, :227:{35,40}]
  wire              out_front_bits_read = auto_control_xing_in_a_bits_opcode == 3'h4;	// @[generators/rocket-chip/src/main/scala/tilelink/RegisterRouter.scala:69:36]
  wire              _out_out_bits_data_WIRE_9 = auto_control_xing_in_a_bits_address[11:6] == 6'h0;	// @[generators/rocket-chip/src/main/scala/tilelink/Edges.scala:192:34, generators/rocket-chip/src/main/scala/tilelink/RegisterRouter.scala:70:19, :82:24, generators/rtc-timer/src/main/scala/RTCTimer.scala:76:30]
  wire              _out_wofireMux_T_2 = auto_control_xing_in_a_valid & auto_control_xing_in_d_ready & ~out_front_bits_read;	// @[generators/rocket-chip/src/main/scala/tilelink/RegisterRouter.scala:69:36, :82:24]
  wire [15:0]       _GEN = {{1'h1}, {1'h1}, {1'h1}, {1'h1}, {1'h1}, {1'h1}, {_out_out_bits_data_WIRE_9}, {_out_out_bits_data_WIRE_9}, {_out_out_bits_data_WIRE_9}, {_out_out_bits_data_WIRE_9}, {_out_out_bits_data_WIRE_9}, {_out_out_bits_data_WIRE_9}, {_out_out_bits_data_WIRE_9}, {_out_out_bits_data_WIRE_9}, {_out_out_bits_data_WIRE_9}, {_out_out_bits_data_WIRE_9}};	// @[generators/rocket-chip/src/main/scala/tilelink/Buffer.scala:47:20, generators/rocket-chip/src/main/scala/tilelink/RegisterRouter.scala:82:24, generators/rocket-chip/src/main/scala/util/MuxLiteral.scala:49:10]
  wire [15:0][31:0] _GEN_0 = {{32'h0}, {32'h0}, {32'h0}, {32'h0}, {32'h0}, {32'h0}, {32'h0}, {32'h0}, {32'h0}, {32'h0}, {32'h0}, {counter}, {32'h0}, {32'h0}, {32'h0}, {32'h0}};	// @[generators/rocket-chip/src/main/scala/tilelink/Bundles.scala:259:74, generators/rocket-chip/src/main/scala/util/MuxLiteral.scala:49:10, generators/rtc-timer/src/main/scala/RTCTimer.scala:77:24]
  wire [2:0]        controlXingIn_d_bits_opcode = {2'h0, out_front_bits_read};	// @[generators/rocket-chip/src/main/scala/tilelink/RegisterRouter.scala:69:36, :100:19]
  wire              _GEN_1 = (&counter) & ~overflow_interrupt_reg & ~overflow_inter_prior_trigger;	// @[generators/rtc-timer/src/main/scala/RTCTimer.scala:77:24, :156:39, :157:45, :176:{17,61,73,105}]
  wire              _GEN_2 = counter == cc0;	// @[generators/rtc-timer/src/main/scala/RTCTimer.scala:77:24, :79:20, :187:17]
  wire              _GEN_3 = _GEN_2 & ~compare0_interrupt_reg & ~compare0_inter_prior_trigger;	// @[generators/rtc-timer/src/main/scala/RTCTimer.scala:158:39, :159:45, :187:{17,51,63,95}]
  wire              _GEN_4 = counter == cc1;	// @[generators/rtc-timer/src/main/scala/RTCTimer.scala:77:24, :80:20, :196:17]
  wire              _GEN_5 = _GEN_4 & ~compare1_interrupt_reg & ~compare1_inter_prior_trigger;	// @[generators/rtc-timer/src/main/scala/RTCTimer.scala:160:39, :161:45, :196:{17,51,63,95}]
  wire              _GEN_6 = counter == cc2;	// @[generators/rtc-timer/src/main/scala/RTCTimer.scala:77:24, :81:20, :205:17]
  wire              _GEN_7 = _GEN_6 & ~compare2_interrupt_reg & ~compare2_inter_prior_trigger;	// @[generators/rtc-timer/src/main/scala/RTCTimer.scala:162:39, :163:45, :205:{17,51,63,95}]
  wire              _GEN_8 = counter == cc3;	// @[generators/rtc-timer/src/main/scala/RTCTimer.scala:77:24, :82:20, :214:17]
  wire              _GEN_9 = _GEN_8 & ~compare3_interrupt_reg & ~compare3_inter_prior_trigger;	// @[generators/rtc-timer/src/main/scala/RTCTimer.scala:164:39, :165:45, :214:{17,51,63,95}]
  wire [7:0]        _out_backMask_T_5 = {8{auto_control_xing_in_a_bits_mask[0]}};	// @[generators/rocket-chip/src/main/scala/tilelink/RegisterRouter.scala:82:24]
  wire [31:0]       out_backMask = {{8{auto_control_xing_in_a_bits_mask[3]}}, {8{auto_control_xing_in_a_bits_mask[2]}}, {8{auto_control_xing_in_a_bits_mask[1]}}, _out_backMask_T_5};	// @[generators/rocket-chip/src/main/scala/tilelink/RegisterRouter.scala:82:24]
  always @(posedge clock) begin
    if (reset) begin
      task_start <= 1'h0;	// @[generators/rocket-chip/src/main/scala/tilelink/Bundles.scala:259:74, generators/rtc-timer/src/main/scala/RTCTimer.scala:73:27]
      task_clear <= 1'h0;	// @[generators/rocket-chip/src/main/scala/tilelink/Bundles.scala:259:74, generators/rtc-timer/src/main/scala/RTCTimer.scala:74:27]
      task_trigovrflw <= 1'h0;	// @[generators/rocket-chip/src/main/scala/tilelink/Bundles.scala:259:74, generators/rtc-timer/src/main/scala/RTCTimer.scala:75:32]
      interrupt_set <= 6'h0;	// @[generators/rtc-timer/src/main/scala/RTCTimer.scala:76:30]
      counter <= 32'h0;	// @[generators/rocket-chip/src/main/scala/tilelink/Bundles.scala:259:74, generators/rtc-timer/src/main/scala/RTCTimer.scala:77:24]
      prescaler <= 12'h0;	// @[generators/rtc-timer/src/main/scala/RTCTimer.scala:78:26]
      cc0 <= 32'h0;	// @[generators/rocket-chip/src/main/scala/tilelink/Bundles.scala:259:74, generators/rtc-timer/src/main/scala/RTCTimer.scala:79:20]
      cc1 <= 32'h0;	// @[generators/rocket-chip/src/main/scala/tilelink/Bundles.scala:259:74, generators/rtc-timer/src/main/scala/RTCTimer.scala:80:20]
      cc2 <= 32'h0;	// @[generators/rocket-chip/src/main/scala/tilelink/Bundles.scala:259:74, generators/rtc-timer/src/main/scala/RTCTimer.scala:81:20]
      cc3 <= 32'h0;	// @[generators/rocket-chip/src/main/scala/tilelink/Bundles.scala:259:74, generators/rtc-timer/src/main/scala/RTCTimer.scala:82:20]
      tick_interrupt_reg <= 1'h0;	// @[generators/rocket-chip/src/main/scala/tilelink/Bundles.scala:259:74, generators/rtc-timer/src/main/scala/RTCTimer.scala:155:35]
      overflow_interrupt_reg <= 1'h0;	// @[generators/rocket-chip/src/main/scala/tilelink/Bundles.scala:259:74, generators/rtc-timer/src/main/scala/RTCTimer.scala:156:39]
      overflow_inter_prior_trigger <= 1'h0;	// @[generators/rocket-chip/src/main/scala/tilelink/Bundles.scala:259:74, generators/rtc-timer/src/main/scala/RTCTimer.scala:157:45]
      compare0_interrupt_reg <= 1'h0;	// @[generators/rocket-chip/src/main/scala/tilelink/Bundles.scala:259:74, generators/rtc-timer/src/main/scala/RTCTimer.scala:158:39]
      compare0_inter_prior_trigger <= 1'h0;	// @[generators/rocket-chip/src/main/scala/tilelink/Bundles.scala:259:74, generators/rtc-timer/src/main/scala/RTCTimer.scala:159:45]
      compare1_interrupt_reg <= 1'h0;	// @[generators/rocket-chip/src/main/scala/tilelink/Bundles.scala:259:74, generators/rtc-timer/src/main/scala/RTCTimer.scala:160:39]
      compare1_inter_prior_trigger <= 1'h0;	// @[generators/rocket-chip/src/main/scala/tilelink/Bundles.scala:259:74, generators/rtc-timer/src/main/scala/RTCTimer.scala:161:45]
      compare2_interrupt_reg <= 1'h0;	// @[generators/rocket-chip/src/main/scala/tilelink/Bundles.scala:259:74, generators/rtc-timer/src/main/scala/RTCTimer.scala:162:39]
      compare2_inter_prior_trigger <= 1'h0;	// @[generators/rocket-chip/src/main/scala/tilelink/Bundles.scala:259:74, generators/rtc-timer/src/main/scala/RTCTimer.scala:163:45]
      compare3_interrupt_reg <= 1'h0;	// @[generators/rocket-chip/src/main/scala/tilelink/Bundles.scala:259:74, generators/rtc-timer/src/main/scala/RTCTimer.scala:164:39]
      compare3_inter_prior_trigger <= 1'h0;	// @[generators/rocket-chip/src/main/scala/tilelink/Bundles.scala:259:74, generators/rtc-timer/src/main/scala/RTCTimer.scala:165:45]
    end
    else begin
      if (_out_wofireMux_T_2 & auto_control_xing_in_a_bits_address[5:2] == 4'h0 & _out_out_bits_data_WIRE_9 & auto_control_xing_in_a_bits_mask[0])	// @[generators/rocket-chip/src/main/scala/tilelink/RegisterRouter.scala:82:24, src/main/scala/chisel3/util/OneHot.scala:58:35]
        task_start <= auto_control_xing_in_a_bits_data[0];	// @[generators/rocket-chip/src/main/scala/tilelink/RegisterRouter.scala:82:24, generators/rtc-timer/src/main/scala/RTCTimer.scala:73:27]
      if (_out_wofireMux_T_2 & auto_control_xing_in_a_bits_address[5:2] == 4'h1 & _out_out_bits_data_WIRE_9 & auto_control_xing_in_a_bits_mask[0])	// @[generators/rocket-chip/src/main/scala/tilelink/RegisterRouter.scala:82:24, src/main/scala/chisel3/util/OneHot.scala:58:35]
        task_clear <= auto_control_xing_in_a_bits_data[0];	// @[generators/rocket-chip/src/main/scala/tilelink/RegisterRouter.scala:82:24, generators/rtc-timer/src/main/scala/RTCTimer.scala:74:27]
      if (_out_wofireMux_T_2 & auto_control_xing_in_a_bits_address[5:2] == 4'h2 & _out_out_bits_data_WIRE_9 & auto_control_xing_in_a_bits_mask[0])	// @[generators/rocket-chip/src/main/scala/tilelink/RegisterRouter.scala:82:24, src/main/scala/chisel3/util/OneHot.scala:58:35]
        task_trigovrflw <= auto_control_xing_in_a_bits_data[0];	// @[generators/rocket-chip/src/main/scala/tilelink/RegisterRouter.scala:82:24, generators/rtc-timer/src/main/scala/RTCTimer.scala:75:32]
      if (_out_wofireMux_T_2 & auto_control_xing_in_a_bits_address[5:2] == 4'h3 & _out_out_bits_data_WIRE_9 & auto_control_xing_in_a_bits_mask[0])	// @[generators/rocket-chip/src/main/scala/tilelink/RegisterRouter.scala:82:24, src/main/scala/chisel3/util/OneHot.scala:58:35]
        interrupt_set <= auto_control_xing_in_a_bits_data[5:0];	// @[generators/rocket-chip/src/main/scala/tilelink/RegisterRouter.scala:82:24, generators/rtc-timer/src/main/scala/RTCTimer.scala:76:30]
      counter <= _timerCounter_io_counter;	// @[generators/rtc-timer/src/main/scala/RTCTimer.scala:77:24, :87:28]
      if (_out_wofireMux_T_2 & auto_control_xing_in_a_bits_address[5:2] == 4'h5 & _out_out_bits_data_WIRE_9 & (&{{4{auto_control_xing_in_a_bits_mask[1]}}, _out_backMask_T_5}))	// @[generators/rocket-chip/src/main/scala/tilelink/RegisterRouter.scala:82:24, src/main/scala/chisel3/util/OneHot.scala:58:35]
        prescaler <= auto_control_xing_in_a_bits_data[11:0];	// @[generators/rocket-chip/src/main/scala/tilelink/RegisterRouter.scala:82:24, generators/rtc-timer/src/main/scala/RTCTimer.scala:78:26]
      if (_out_wofireMux_T_2 & auto_control_xing_in_a_bits_address[5:2] == 4'h6 & _out_out_bits_data_WIRE_9 & (&out_backMask))	// @[generators/rocket-chip/src/main/scala/tilelink/RegisterRouter.scala:82:24, src/main/scala/chisel3/util/OneHot.scala:58:35]
        cc0 <= auto_control_xing_in_a_bits_data;	// @[generators/rtc-timer/src/main/scala/RTCTimer.scala:79:20]
      if (_out_wofireMux_T_2 & auto_control_xing_in_a_bits_address[5:2] == 4'h7 & _out_out_bits_data_WIRE_9 & (&out_backMask))	// @[generators/rocket-chip/src/main/scala/tilelink/RegisterRouter.scala:82:24, src/main/scala/chisel3/util/OneHot.scala:58:35]
        cc1 <= auto_control_xing_in_a_bits_data;	// @[generators/rtc-timer/src/main/scala/RTCTimer.scala:80:20]
      if (_out_wofireMux_T_2 & auto_control_xing_in_a_bits_address[5:2] == 4'h8 & _out_out_bits_data_WIRE_9 & (&out_backMask))	// @[generators/rocket-chip/src/main/scala/tilelink/RegisterRouter.scala:82:24, src/main/scala/chisel3/util/OneHot.scala:58:35]
        cc2 <= auto_control_xing_in_a_bits_data;	// @[generators/rtc-timer/src/main/scala/RTCTimer.scala:81:20]
      if (_out_wofireMux_T_2 & auto_control_xing_in_a_bits_address[5:2] == 4'h9 & _out_out_bits_data_WIRE_9 & (&out_backMask))	// @[generators/rocket-chip/src/main/scala/tilelink/RegisterRouter.scala:82:24, src/main/scala/chisel3/util/OneHot.scala:58:35]
        cc3 <= auto_control_xing_in_a_bits_data;	// @[generators/rtc-timer/src/main/scala/RTCTimer.scala:82:20]
      tick_interrupt_reg <= _timerCounter_io_counter != counter;	// @[generators/rtc-timer/src/main/scala/RTCTimer.scala:77:24, :87:28, :155:35, :168:33]
      overflow_interrupt_reg <= _GEN_1;	// @[generators/rtc-timer/src/main/scala/RTCTimer.scala:156:39, :176:73]
      overflow_inter_prior_trigger <= _GEN_1 | (&counter) & overflow_inter_prior_trigger;	// @[generators/rtc-timer/src/main/scala/RTCTimer.scala:77:24, :157:45, :176:{17,73,118}, :178:34, :181:38, :182:36]
      compare0_interrupt_reg <= _GEN_3;	// @[generators/rtc-timer/src/main/scala/RTCTimer.scala:158:39, :187:63]
      compare0_inter_prior_trigger <= _GEN_3 | _GEN_2 & compare0_inter_prior_trigger;	// @[generators/rtc-timer/src/main/scala/RTCTimer.scala:159:45, :187:{17,63,108}, :189:34, :192:{19,28}, :193:36]
      compare1_interrupt_reg <= _GEN_5;	// @[generators/rtc-timer/src/main/scala/RTCTimer.scala:160:39, :196:63]
      compare1_inter_prior_trigger <= _GEN_5 | _GEN_4 & compare1_inter_prior_trigger;	// @[generators/rtc-timer/src/main/scala/RTCTimer.scala:161:45, :196:{17,63,108}, :198:34, :201:{19,28}, :202:36]
      compare2_interrupt_reg <= _GEN_7;	// @[generators/rtc-timer/src/main/scala/RTCTimer.scala:162:39, :205:63]
      compare2_inter_prior_trigger <= _GEN_7 | _GEN_6 & compare2_inter_prior_trigger;	// @[generators/rtc-timer/src/main/scala/RTCTimer.scala:163:45, :205:{17,63,108}, :207:34, :210:{19,28}, :211:36]
      compare3_interrupt_reg <= _GEN_9;	// @[generators/rtc-timer/src/main/scala/RTCTimer.scala:164:39, :214:63]
      compare3_inter_prior_trigger <= _GEN_9 | _GEN_8 & compare3_inter_prior_trigger;	// @[generators/rtc-timer/src/main/scala/RTCTimer.scala:165:45, :214:{17,63,108}, :216:34, :219:{19,28}, :220:36]
    end
  end // always @(posedge)
  `ifdef ENABLE_INITIAL_REG_
    `ifdef FIRRTL_BEFORE_INITIAL
      `FIRRTL_BEFORE_INITIAL
    `endif // FIRRTL_BEFORE_INITIAL
    logic [31:0] _RANDOM[0:5];
    initial begin
      `ifdef INIT_RANDOM_PROLOG_
        `INIT_RANDOM_PROLOG_
      `endif // INIT_RANDOM_PROLOG_
      `ifdef RANDOMIZE_REG_INIT
        for (logic [2:0] i = 3'h0; i < 3'h6; i += 3'h1) begin
          _RANDOM[i] = `RANDOM;
        end
        task_start = _RANDOM[3'h0][0];	// @[generators/rtc-timer/src/main/scala/RTCTimer.scala:73:27]
        task_clear = _RANDOM[3'h0][1];	// @[generators/rtc-timer/src/main/scala/RTCTimer.scala:73:27, :74:27]
        task_trigovrflw = _RANDOM[3'h0][2];	// @[generators/rtc-timer/src/main/scala/RTCTimer.scala:73:27, :75:32]
        interrupt_set = _RANDOM[3'h0][8:3];	// @[generators/rtc-timer/src/main/scala/RTCTimer.scala:73:27, :76:30]
        counter = {_RANDOM[3'h0][31:9], _RANDOM[3'h1][8:0]};	// @[generators/rtc-timer/src/main/scala/RTCTimer.scala:73:27, :77:24]
        prescaler = _RANDOM[3'h1][20:9];	// @[generators/rtc-timer/src/main/scala/RTCTimer.scala:77:24, :78:26]
        cc0 = {_RANDOM[3'h1][31:21], _RANDOM[3'h2][20:0]};	// @[generators/rtc-timer/src/main/scala/RTCTimer.scala:77:24, :79:20]
        cc1 = {_RANDOM[3'h2][31:21], _RANDOM[3'h3][20:0]};	// @[generators/rtc-timer/src/main/scala/RTCTimer.scala:79:20, :80:20]
        cc2 = {_RANDOM[3'h3][31:21], _RANDOM[3'h4][20:0]};	// @[generators/rtc-timer/src/main/scala/RTCTimer.scala:80:20, :81:20]
        cc3 = {_RANDOM[3'h4][31:21], _RANDOM[3'h5][20:0]};	// @[generators/rtc-timer/src/main/scala/RTCTimer.scala:81:20, :82:20]
        tick_interrupt_reg = _RANDOM[3'h5][21];	// @[generators/rtc-timer/src/main/scala/RTCTimer.scala:82:20, :155:35]
        overflow_interrupt_reg = _RANDOM[3'h5][22];	// @[generators/rtc-timer/src/main/scala/RTCTimer.scala:82:20, :156:39]
        overflow_inter_prior_trigger = _RANDOM[3'h5][23];	// @[generators/rtc-timer/src/main/scala/RTCTimer.scala:82:20, :157:45]
        compare0_interrupt_reg = _RANDOM[3'h5][24];	// @[generators/rtc-timer/src/main/scala/RTCTimer.scala:82:20, :158:39]
        compare0_inter_prior_trigger = _RANDOM[3'h5][25];	// @[generators/rtc-timer/src/main/scala/RTCTimer.scala:82:20, :159:45]
        compare1_interrupt_reg = _RANDOM[3'h5][26];	// @[generators/rtc-timer/src/main/scala/RTCTimer.scala:82:20, :160:39]
        compare1_inter_prior_trigger = _RANDOM[3'h5][27];	// @[generators/rtc-timer/src/main/scala/RTCTimer.scala:82:20, :161:45]
        compare2_interrupt_reg = _RANDOM[3'h5][28];	// @[generators/rtc-timer/src/main/scala/RTCTimer.scala:82:20, :162:39]
        compare2_inter_prior_trigger = _RANDOM[3'h5][29];	// @[generators/rtc-timer/src/main/scala/RTCTimer.scala:82:20, :163:45]
        compare3_interrupt_reg = _RANDOM[3'h5][30];	// @[generators/rtc-timer/src/main/scala/RTCTimer.scala:82:20, :164:39]
        compare3_inter_prior_trigger = _RANDOM[3'h5][31];	// @[generators/rtc-timer/src/main/scala/RTCTimer.scala:82:20, :165:45]
      `endif // RANDOMIZE_REG_INIT
    end // initial
    `ifdef FIRRTL_AFTER_INITIAL
      `FIRRTL_AFTER_INITIAL
    `endif // FIRRTL_AFTER_INITIAL
  `endif // ENABLE_INITIAL_REG_
  IntSyncCrossingSource_9 intsource (	// @[generators/rocket-chip/src/main/scala/interrupts/Crossing.scala:28:31]
    .clock           (clock),
    .reset           (reset),
    .auto_in_0       (interrupt_wire[0]),	// @[generators/rtc-timer/src/main/scala/RTCTimer.scala:227:35, :233:40]
    .auto_in_1       (interrupt_wire[1]),	// @[generators/rtc-timer/src/main/scala/RTCTimer.scala:227:35, :234:40]
    .auto_in_2       (interrupt_wire[2]),	// @[generators/rtc-timer/src/main/scala/RTCTimer.scala:227:35, :235:40]
    .auto_in_3       (interrupt_wire[3]),	// @[generators/rtc-timer/src/main/scala/RTCTimer.scala:227:35, :236:40]
    .auto_in_4       (interrupt_wire[4]),	// @[generators/rtc-timer/src/main/scala/RTCTimer.scala:227:35, :237:40]
    .auto_in_5       (interrupt_wire[5]),	// @[generators/rtc-timer/src/main/scala/RTCTimer.scala:227:35, :238:40]
    .auto_out_sync_0 (auto_int_xing_out_sync_0),
    .auto_out_sync_1 (auto_int_xing_out_sync_1),
    .auto_out_sync_2 (auto_int_xing_out_sync_2),
    .auto_out_sync_3 (auto_int_xing_out_sync_3),
    .auto_out_sync_4 (auto_int_xing_out_sync_4),
    .auto_out_sync_5 (auto_int_xing_out_sync_5)
  );
  TLMonitor_70 monitor (	// @[generators/rocket-chip/src/main/scala/tilelink/Nodes.scala:24:25]
    .clock                (clock),
    .reset                (reset),
    .io_in_a_ready        (auto_control_xing_in_d_ready),
    .io_in_a_valid        (auto_control_xing_in_a_valid),
    .io_in_a_bits_opcode  (auto_control_xing_in_a_bits_opcode),
    .io_in_a_bits_param   (auto_control_xing_in_a_bits_param),
    .io_in_a_bits_size    (auto_control_xing_in_a_bits_size),
    .io_in_a_bits_source  (auto_control_xing_in_a_bits_source),
    .io_in_a_bits_address (auto_control_xing_in_a_bits_address),
    .io_in_a_bits_mask    (auto_control_xing_in_a_bits_mask),
    .io_in_a_bits_corrupt (auto_control_xing_in_a_bits_corrupt),
    .io_in_d_ready        (auto_control_xing_in_d_ready),
    .io_in_d_valid        (auto_control_xing_in_a_valid),
    .io_in_d_bits_opcode  (controlXingIn_d_bits_opcode),	// @[generators/rocket-chip/src/main/scala/tilelink/RegisterRouter.scala:100:19]
    .io_in_d_bits_size    (auto_control_xing_in_a_bits_size),
    .io_in_d_bits_source  (auto_control_xing_in_a_bits_source)
  );
  TimerCounter timerCounter (	// @[generators/rtc-timer/src/main/scala/RTCTimer.scala:87:28]
    .clock              (io_rtc_clock),
    .reset              (_reset_sync_io_out),	// @[generators/rtc-timer/src/main/scala/RTCTimer.scala:91:26]
    .io_task_start      (_task_start_async_io_deq_bits),	// @[generators/rtc-timer/src/main/scala/RTCTimer.scala:97:32]
    .io_task_clear      (_task_clear_async_io_deq_bits),	// @[generators/rtc-timer/src/main/scala/RTCTimer.scala:107:32]
    .io_task_trigovrflw (_task_trigovrflw_async_io_deq_bits),	// @[generators/rtc-timer/src/main/scala/RTCTimer.scala:117:37]
    .io_prescaler       (_prescaler_async_io_deq_bits),	// @[generators/rtc-timer/src/main/scala/RTCTimer.scala:127:31]
    .io_counter         (_timerCounter_io_counter)
  );
  Synchronizer reset_sync (	// @[generators/rtc-timer/src/main/scala/RTCTimer.scala:91:26]
    .reset         (reset),
    .io_in         (reset),
    .io_out        (_reset_sync_io_out),
    .io_dest_clock (io_rtc_clock)
  );
  AsyncQueue_31 task_start_async (	// @[generators/rtc-timer/src/main/scala/RTCTimer.scala:97:32]
    .io_enq_clock (clock),
    .io_enq_reset (reset),
    .io_enq_bits  (task_start),	// @[generators/rtc-timer/src/main/scala/RTCTimer.scala:73:27]
    .io_deq_clock (io_rtc_clock),
    .io_deq_reset (reset),
    .io_deq_bits  (_task_start_async_io_deq_bits)
  );
  AsyncQueue_31 task_clear_async (	// @[generators/rtc-timer/src/main/scala/RTCTimer.scala:107:32]
    .io_enq_clock (clock),
    .io_enq_reset (reset),
    .io_enq_bits  (task_clear),	// @[generators/rtc-timer/src/main/scala/RTCTimer.scala:74:27]
    .io_deq_clock (io_rtc_clock),
    .io_deq_reset (reset),
    .io_deq_bits  (_task_clear_async_io_deq_bits)
  );
  AsyncQueue_31 task_trigovrflw_async (	// @[generators/rtc-timer/src/main/scala/RTCTimer.scala:117:37]
    .io_enq_clock (clock),
    .io_enq_reset (reset),
    .io_enq_bits  (task_trigovrflw),	// @[generators/rtc-timer/src/main/scala/RTCTimer.scala:75:32]
    .io_deq_clock (io_rtc_clock),
    .io_deq_reset (reset),
    .io_deq_bits  (_task_trigovrflw_async_io_deq_bits)
  );
  AsyncQueue_34 prescaler_async (	// @[generators/rtc-timer/src/main/scala/RTCTimer.scala:127:31]
    .io_enq_clock (clock),
    .io_enq_reset (reset),
    .io_enq_valid (~task_start),	// @[generators/rtc-timer/src/main/scala/RTCTimer.scala:73:27, :131:35]
    .io_enq_bits  (prescaler),	// @[generators/rtc-timer/src/main/scala/RTCTimer.scala:78:26]
    .io_deq_clock (io_rtc_clock),
    .io_deq_reset (reset),
    .io_deq_bits  (_prescaler_async_io_deq_bits)
  );
  assign auto_control_xing_in_a_ready = auto_control_xing_in_d_ready;
  assign auto_control_xing_in_d_valid = auto_control_xing_in_a_valid;
  assign auto_control_xing_in_d_bits_opcode = controlXingIn_d_bits_opcode;	// @[generators/rocket-chip/src/main/scala/tilelink/RegisterRouter.scala:100:19]
  assign auto_control_xing_in_d_bits_size = auto_control_xing_in_a_bits_size;
  assign auto_control_xing_in_d_bits_source = auto_control_xing_in_a_bits_source;
  assign auto_control_xing_in_d_bits_data = _GEN[auto_control_xing_in_a_bits_address[5:2]] ? _GEN_0[auto_control_xing_in_a_bits_address[5:2]] : 32'h0;	// @[generators/rocket-chip/src/main/scala/tilelink/Bundles.scala:259:74, generators/rocket-chip/src/main/scala/tilelink/RegisterRouter.scala:82:24, generators/rocket-chip/src/main/scala/util/MuxLiteral.scala:49:10]
endmodule

