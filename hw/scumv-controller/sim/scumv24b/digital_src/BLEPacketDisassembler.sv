// Generated by CIRCT unknown git version
// Standard header to adapt well known macros for register randomization.
`ifndef RANDOMIZE
  `ifdef RANDOMIZE_MEM_INIT
    `define RANDOMIZE
  `endif // RANDOMIZE_MEM_INIT
`endif // not def RANDOMIZE
`ifndef RANDOMIZE
  `ifdef RANDOMIZE_REG_INIT
    `define RANDOMIZE
  `endif // RANDOMIZE_REG_INIT
`endif // not def RANDOMIZE

// RANDOM may be set to an expression that produces a 32-bit random unsigned value.
`ifndef RANDOM
  `define RANDOM $random
`endif // not def RANDOM

// Users can define INIT_RANDOM as general code that gets injected into the
// initializer block for modules with registers.
`ifndef INIT_RANDOM
  `define INIT_RANDOM
`endif // not def INIT_RANDOM

// If using random initialization, you can also define RANDOMIZE_DELAY to
// customize the delay used, otherwise 0.002 is used.
`ifndef RANDOMIZE_DELAY
  `define RANDOMIZE_DELAY 0.002
`endif // not def RANDOMIZE_DELAY

// Define INIT_RANDOM_PROLOG_ for use in our modules below.
`ifndef INIT_RANDOM_PROLOG_
  `ifdef RANDOMIZE
    `ifdef VERILATOR
      `define INIT_RANDOM_PROLOG_ `INIT_RANDOM
    `else  // VERILATOR
      `define INIT_RANDOM_PROLOG_ `INIT_RANDOM #`RANDOMIZE_DELAY begin end
    `endif // VERILATOR
  `else  // RANDOMIZE
    `define INIT_RANDOM_PROLOG_
  `endif // RANDOMIZE
`endif // not def INIT_RANDOM_PROLOG_

// Include register initializers in init blocks unless synthesis is set
`ifndef SYNTHESIS
  `ifndef ENABLE_INITIAL_REG_
    `define ENABLE_INITIAL_REG_
  `endif // not def ENABLE_INITIAL_REG_
`endif // not def SYNTHESIS

// Include rmemory initializers in init blocks unless synthesis is set
`ifndef SYNTHESIS
  `ifndef ENABLE_INITIAL_MEM_
    `define ENABLE_INITIAL_MEM_
  `endif // not def ENABLE_INITIAL_MEM_
`endif // not def SYNTHESIS

// Standard header to adapt well known macros for prints and assertions.

// Users can define 'PRINTF_COND' to add an extra gate to prints.
`ifndef PRINTF_COND_
  `ifdef PRINTF_COND
    `define PRINTF_COND_ (`PRINTF_COND)
  `else  // PRINTF_COND
    `define PRINTF_COND_ 1
  `endif // PRINTF_COND
`endif // not def PRINTF_COND_

// Users can define 'ASSERT_VERBOSE_COND' to add an extra gate to assert error printing.
`ifndef ASSERT_VERBOSE_COND_
  `ifdef ASSERT_VERBOSE_COND
    `define ASSERT_VERBOSE_COND_ (`ASSERT_VERBOSE_COND)
  `else  // ASSERT_VERBOSE_COND
    `define ASSERT_VERBOSE_COND_ 1
  `endif // ASSERT_VERBOSE_COND
`endif // not def ASSERT_VERBOSE_COND_

// Users can define 'STOP_COND' to add an extra gate to stop conditions.
`ifndef STOP_COND_
  `ifdef STOP_COND
    `define STOP_COND_ (`STOP_COND)
  `else  // STOP_COND
    `define STOP_COND_ 1
  `endif // STOP_COND
`endif // not def STOP_COND_

module BLEPacketDisassembler(
  input         clock,
                reset,
                io_in_control_valid,	// @[generators/baseband/src/main/scala/baseband/BLEPacketDisassembler.scala:44:14]
  input  [1:0]  io_in_control_bits_command,	// @[generators/baseband/src/main/scala/baseband/BLEPacketDisassembler.scala:44:14]
  input         io_in_data_sop,	// @[generators/baseband/src/main/scala/baseband/BLEPacketDisassembler.scala:44:14]
  output        io_in_data_eop,	// @[generators/baseband/src/main/scala/baseband/BLEPacketDisassembler.scala:44:14]
  input         io_in_data_data_valid,	// @[generators/baseband/src/main/scala/baseband/BLEPacketDisassembler.scala:44:14]
  input  [7:0]  io_in_data_data_bits,	// @[generators/baseband/src/main/scala/baseband/BLEPacketDisassembler.scala:44:14]
  output [7:0]  io_out_control_length,	// @[generators/baseband/src/main/scala/baseband/BLEPacketDisassembler.scala:44:14]
  output        io_out_control_flag_crc,	// @[generators/baseband/src/main/scala/baseband/BLEPacketDisassembler.scala:44:14]
                io_out_control_done,	// @[generators/baseband/src/main/scala/baseband/BLEPacketDisassembler.scala:44:14]
                io_out_control_busy,	// @[generators/baseband/src/main/scala/baseband/BLEPacketDisassembler.scala:44:14]
  input         io_out_data_ready,	// @[generators/baseband/src/main/scala/baseband/BLEPacketDisassembler.scala:44:14]
  output        io_out_data_valid,	// @[generators/baseband/src/main/scala/baseband/BLEPacketDisassembler.scala:44:14]
  output [7:0]  io_out_data_bits,	// @[generators/baseband/src/main/scala/baseband/BLEPacketDisassembler.scala:44:14]
  input  [5:0]  io_constants_bleChannelIndex,	// @[generators/baseband/src/main/scala/baseband/BLEPacketDisassembler.scala:44:14]
  input  [23:0] io_constants_crcSeed,	// @[generators/baseband/src/main/scala/baseband/BLEPacketDisassembler.scala:44:14]
  output [2:0]  io_state	// @[generators/baseband/src/main/scala/baseband/BLEPacketDisassembler.scala:44:14]
);

  wire [8:0]  _queue_io_count;	// @[generators/baseband/src/main/scala/baseband/BLEPacketDisassembler.scala:81:11]
  wire        _crc_io_out_valid;	// @[generators/baseband/src/main/scala/baseband/BLEPacketDisassembler.scala:73:19]
  wire [23:0] _crc_io_out_bits;	// @[generators/baseband/src/main/scala/baseband/BLEPacketDisassembler.scala:73:19]
  wire        _white_io_out_valid;	// @[generators/baseband/src/main/scala/baseband/BLEPacketDisassembler.scala:67:21]
  wire [7:0]  _white_io_out_bits;	// @[generators/baseband/src/main/scala/baseband/BLEPacketDisassembler.scala:67:21]
  reg  [2:0]  state;	// @[generators/baseband/src/main/scala/baseband/BLEPacketDisassembler.scala:55:24]
  reg  [7:0]  counter;	// @[generators/baseband/src/main/scala/baseband/BLEPacketDisassembler.scala:56:24]
  reg         eop;	// @[generators/baseband/src/main/scala/baseband/BLEPacketDisassembler.scala:61:20]
  reg  [7:0]  length;	// @[generators/baseband/src/main/scala/baseband/BLEPacketDisassembler.scala:88:25]
  reg         flag_crc;	// @[generators/baseband/src/main/scala/baseband/BLEPacketDisassembler.scala:89:25]
  reg         done;	// @[generators/baseband/src/main/scala/baseband/BLEPacketDisassembler.scala:90:25]
  reg         busy;	// @[generators/baseband/src/main/scala/baseband/BLEPacketDisassembler.scala:91:25]
  wire        _GEN = state == 3'h0;	// @[generators/baseband/src/main/scala/baseband/BLEPacketDisassembler.scala:55:24, :105:14, :113:14]
  wire        _GEN_0 = io_in_control_valid & io_in_control_bits_command == 2'h2;	// @[generators/baseband/src/main/scala/baseband/BLEPacketDisassembler.scala:112:{35,66}]
  wire        _GEN_1 = state == 3'h1;	// @[generators/baseband/src/main/scala/baseband/BLEPacketDisassembler.scala:55:24, :110:13, :118:20]
  wire        _GEN_2 = state == 3'h2;	// @[generators/baseband/src/main/scala/baseband/BLEPacketDisassembler.scala:55:24, :120:16, :128:19]
  wire        _GEN_3 = state == 3'h3;	// @[generators/baseband/src/main/scala/baseband/BLEPacketDisassembler.scala:55:24, :128:19, :138:21]
  wire        _GEN_4 = state == 3'h4;	// @[generators/baseband/src/main/scala/baseband/BLEPacketDisassembler.scala:55:24, :128:19, :135:21]
  wire        _GEN_5 = _GEN_2 | _GEN_3;	// @[generators/baseband/src/main/scala/baseband/BLEPacketDisassembler.scala:128:19, :130:25, :145:25]
  wire        _GEN_6 = _GEN_0 | _GEN_1;	// @[generators/baseband/src/main/scala/baseband/BLEPacketDisassembler.scala:102:19, :112:{35,105}, :118:{20,38}, :125:35]
  wire [7:0]  _counter_T = counter - 8'h1;	// @[generators/baseband/src/main/scala/baseband/BLEPacketDisassembler.scala:56:24, :126:24]
  wire        _GEN_7 = counter == 8'h0;	// @[generators/baseband/src/main/scala/baseband/BLEPacketDisassembler.scala:56:24, :131:22]
  wire        _GEN_8 = _white_io_out_bits == 8'h0;	// @[generators/baseband/src/main/scala/baseband/BLEPacketDisassembler.scala:56:24, :67:21, :134:34]
  wire        _GEN_9 = state == 3'h5;	// @[generators/baseband/src/main/scala/baseband/BLEPacketDisassembler.scala:55:24, :155:19, :160:20]
  wire        _GEN_10 = _GEN_9 & io_in_data_sop;	// @[generators/baseband/src/main/scala/baseband/BLEPacketDisassembler.scala:56:24, :160:{20,38}, :161:37, :163:16]
  wire        _GEN_11 = _crc_io_out_valid & _queue_io_count == 9'h0;	// @[generators/baseband/src/main/scala/baseband/BLEPacketDisassembler.scala:73:19, :81:11, :168:{44,62}]
  wire        _GEN_12 = _white_io_out_valid | ~_GEN_9;	// @[generators/baseband/src/main/scala/baseband/BLEPacketDisassembler.scala:67:21, :89:25, :125:35, :160:{20,38}]
  always @(posedge clock) begin
    if (reset) begin
      state <= 3'h0;	// @[generators/baseband/src/main/scala/baseband/BLEPacketDisassembler.scala:55:24, :113:14]
      counter <= 8'h0;	// @[generators/baseband/src/main/scala/baseband/BLEPacketDisassembler.scala:56:24]
      eop <= 1'h0;	// @[generators/baseband/src/main/scala/baseband/BLEPacketDisassembler.scala:61:20]
      length <= 8'h0;	// @[generators/baseband/src/main/scala/baseband/BLEPacketDisassembler.scala:56:24, :88:25]
      flag_crc <= 1'h0;	// @[generators/baseband/src/main/scala/baseband/BLEPacketDisassembler.scala:89:25]
      done <= 1'h0;	// @[generators/baseband/src/main/scala/baseband/BLEPacketDisassembler.scala:90:25]
      busy <= 1'h0;	// @[generators/baseband/src/main/scala/baseband/BLEPacketDisassembler.scala:91:25]
    end
    else begin
      if (_GEN) begin	// @[generators/baseband/src/main/scala/baseband/BLEPacketDisassembler.scala:105:14]
        if (io_in_control_valid & (io_in_control_bits_command == 2'h0 | io_in_control_bits_command == 2'h1))	// @[generators/baseband/src/main/scala/baseband/BLEPacketDisassembler.scala:55:24, :108:{31,62,100}, :109:62]
          state <= 3'h1;	// @[generators/baseband/src/main/scala/baseband/BLEPacketDisassembler.scala:55:24, :110:13]
      end
      else begin	// @[generators/baseband/src/main/scala/baseband/BLEPacketDisassembler.scala:105:14]
        if (_GEN_0) begin	// @[generators/baseband/src/main/scala/baseband/BLEPacketDisassembler.scala:112:35]
          state <= 3'h0;	// @[generators/baseband/src/main/scala/baseband/BLEPacketDisassembler.scala:55:24, :113:14]
          length <= 8'h0;	// @[generators/baseband/src/main/scala/baseband/BLEPacketDisassembler.scala:56:24, :88:25]
        end
        else if (_GEN_1) begin	// @[generators/baseband/src/main/scala/baseband/BLEPacketDisassembler.scala:118:20]
          if (io_in_data_sop)	// @[generators/baseband/src/main/scala/baseband/BLEPacketDisassembler.scala:44:14]
            state <= 3'h2;	// @[generators/baseband/src/main/scala/baseband/BLEPacketDisassembler.scala:55:24, :120:16]
        end
        else if (_white_io_out_valid) begin	// @[generators/baseband/src/main/scala/baseband/BLEPacketDisassembler.scala:67:21]
          if (_GEN_2) begin	// @[generators/baseband/src/main/scala/baseband/BLEPacketDisassembler.scala:128:19]
            if (_GEN_7)	// @[generators/baseband/src/main/scala/baseband/BLEPacketDisassembler.scala:131:22]
              state <= _GEN_8 ? 3'h4 : 3'h3;	// @[generators/baseband/src/main/scala/baseband/BLEPacketDisassembler.scala:55:24, :134:{34,43}, :135:21, :138:21]
          end
          else if (_GEN_3) begin	// @[generators/baseband/src/main/scala/baseband/BLEPacketDisassembler.scala:128:19]
            if (_GEN_7)	// @[generators/baseband/src/main/scala/baseband/BLEPacketDisassembler.scala:131:22]
              state <= 3'h4;	// @[generators/baseband/src/main/scala/baseband/BLEPacketDisassembler.scala:55:24, :135:21]
          end
          else if (_GEN_4 & _GEN_7)	// @[generators/baseband/src/main/scala/baseband/BLEPacketDisassembler.scala:55:24, :128:19, :131:22, :154:31, :155:19]
            state <= 3'h5;	// @[generators/baseband/src/main/scala/baseband/BLEPacketDisassembler.scala:55:24, :155:19]
          if (_GEN_2 & _GEN_7)	// @[generators/baseband/src/main/scala/baseband/BLEPacketDisassembler.scala:88:25, :128:19, :131:{22,31}, :132:19]
            length <= _white_io_out_bits;	// @[generators/baseband/src/main/scala/baseband/BLEPacketDisassembler.scala:67:21, :88:25]
        end
        else begin	// @[generators/baseband/src/main/scala/baseband/BLEPacketDisassembler.scala:67:21]
          if (_GEN_9) begin	// @[generators/baseband/src/main/scala/baseband/BLEPacketDisassembler.scala:160:20]
            if (io_in_data_sop)	// @[generators/baseband/src/main/scala/baseband/BLEPacketDisassembler.scala:44:14]
              state <= 3'h2;	// @[generators/baseband/src/main/scala/baseband/BLEPacketDisassembler.scala:55:24, :120:16]
            else if (_GEN_11)	// @[generators/baseband/src/main/scala/baseband/BLEPacketDisassembler.scala:168:44]
              state <= 3'h1;	// @[generators/baseband/src/main/scala/baseband/BLEPacketDisassembler.scala:55:24, :110:13]
          end
          if (_GEN_10)	// @[generators/baseband/src/main/scala/baseband/BLEPacketDisassembler.scala:56:24, :160:38, :161:37, :163:16]
            length <= 8'h0;	// @[generators/baseband/src/main/scala/baseband/BLEPacketDisassembler.scala:56:24, :88:25]
        end
        flag_crc <= ~_GEN_0 & (_GEN_1 ? ~io_in_data_sop & flag_crc : _GEN_12 ? flag_crc : ~io_in_data_sop & (_GEN_11 ? (|_crc_io_out_bits) : flag_crc));	// @[generators/baseband/src/main/scala/baseband/BLEPacketDisassembler.scala:73:19, :89:25, :112:{35,105}, :115:14, :118:{20,38}, :119:37, :122:16, :125:35, :160:38, :161:37, :165:16, :168:{44,71}, :170:{16,35}]
        busy <= ~_GEN_0 & (_GEN_1 ? io_in_data_sop | busy : _GEN_12 ? busy : io_in_data_sop | ~_GEN_11 & busy);	// @[generators/baseband/src/main/scala/baseband/BLEPacketDisassembler.scala:89:25, :91:25, :112:{35,105}, :115:14, :117:14, :118:{20,38}, :119:37, :123:16, :125:35, :160:38, :161:37, :167:16, :168:{44,71}, :172:16]
      end
      if (~(_GEN | _GEN_0)) begin	// @[generators/baseband/src/main/scala/baseband/BLEPacketDisassembler.scala:56:24, :105:{14,36}, :112:{35,105}, :118:38]
        if (_GEN_1) begin	// @[generators/baseband/src/main/scala/baseband/BLEPacketDisassembler.scala:118:20]
          if (io_in_data_sop)	// @[generators/baseband/src/main/scala/baseband/BLEPacketDisassembler.scala:44:14]
            counter <= 8'h1;	// @[generators/baseband/src/main/scala/baseband/BLEPacketDisassembler.scala:56:24, :121:16]
        end
        else if (_white_io_out_valid) begin	// @[generators/baseband/src/main/scala/baseband/BLEPacketDisassembler.scala:67:21]
          if (_GEN_2) begin	// @[generators/baseband/src/main/scala/baseband/BLEPacketDisassembler.scala:128:19]
            if (_GEN_7)	// @[generators/baseband/src/main/scala/baseband/BLEPacketDisassembler.scala:131:22]
              counter <= _GEN_8 ? 8'h2 : _white_io_out_bits - 8'h1;	// @[generators/baseband/src/main/scala/baseband/BLEPacketDisassembler.scala:56:24, :67:21, :134:{34,43}, :136:21, :139:{21,42}]
            else	// @[generators/baseband/src/main/scala/baseband/BLEPacketDisassembler.scala:131:22]
              counter <= _counter_T;	// @[generators/baseband/src/main/scala/baseband/BLEPacketDisassembler.scala:56:24, :126:24]
          end
          else if (_GEN_3 & _GEN_7)	// @[generators/baseband/src/main/scala/baseband/BLEPacketDisassembler.scala:126:13, :128:19, :131:22, :146:31, :148:19]
            counter <= 8'h2;	// @[generators/baseband/src/main/scala/baseband/BLEPacketDisassembler.scala:56:24, :136:21]
          else	// @[generators/baseband/src/main/scala/baseband/BLEPacketDisassembler.scala:126:13, :128:19, :146:31, :148:19]
            counter <= _counter_T;	// @[generators/baseband/src/main/scala/baseband/BLEPacketDisassembler.scala:56:24, :126:24]
        end
        else if (_GEN_10)	// @[generators/baseband/src/main/scala/baseband/BLEPacketDisassembler.scala:56:24, :160:38, :161:37, :163:16]
          counter <= 8'h1;	// @[generators/baseband/src/main/scala/baseband/BLEPacketDisassembler.scala:56:24, :121:16]
      end
      eop <= _GEN | ~_GEN_6 & _white_io_out_valid & ~_GEN_5 & _GEN_4 & _GEN_7;	// @[generators/baseband/src/main/scala/baseband/BLEPacketDisassembler.scala:61:20, :67:21, :100:8, :102:19, :105:{14,36}, :106:9, :112:105, :118:38, :125:35, :128:19, :130:25, :131:22, :145:25]
      done <= ~_GEN & (_GEN_0 | ~(_GEN_1 | _white_io_out_valid) & _GEN_9 & (io_in_data_sop | _GEN_11));	// @[generators/baseband/src/main/scala/baseband/BLEPacketDisassembler.scala:67:21, :90:25, :101:8, :105:{14,36}, :112:{35,105}, :116:14, :118:{20,38}, :125:35, :160:{20,38}, :161:37, :166:16, :168:{44,71}]
    end
  end // always @(posedge)
  `ifdef ENABLE_INITIAL_REG_
    `ifdef FIRRTL_BEFORE_INITIAL
      `FIRRTL_BEFORE_INITIAL
    `endif // FIRRTL_BEFORE_INITIAL
    logic [31:0] _RANDOM[0:0];
    initial begin
      `ifdef INIT_RANDOM_PROLOG_
        `INIT_RANDOM_PROLOG_
      `endif // INIT_RANDOM_PROLOG_
      `ifdef RANDOMIZE_REG_INIT
        _RANDOM[/*Zero width*/ 1'b0] = `RANDOM;
        state = _RANDOM[/*Zero width*/ 1'b0][2:0];	// @[generators/baseband/src/main/scala/baseband/BLEPacketDisassembler.scala:55:24]
        counter = _RANDOM[/*Zero width*/ 1'b0][10:3];	// @[generators/baseband/src/main/scala/baseband/BLEPacketDisassembler.scala:55:24, :56:24]
        eop = _RANDOM[/*Zero width*/ 1'b0][11];	// @[generators/baseband/src/main/scala/baseband/BLEPacketDisassembler.scala:55:24, :61:20]
        length = _RANDOM[/*Zero width*/ 1'b0][19:12];	// @[generators/baseband/src/main/scala/baseband/BLEPacketDisassembler.scala:55:24, :88:25]
        flag_crc = _RANDOM[/*Zero width*/ 1'b0][20];	// @[generators/baseband/src/main/scala/baseband/BLEPacketDisassembler.scala:55:24, :89:25]
        done = _RANDOM[/*Zero width*/ 1'b0][21];	// @[generators/baseband/src/main/scala/baseband/BLEPacketDisassembler.scala:55:24, :90:25]
        busy = _RANDOM[/*Zero width*/ 1'b0][22];	// @[generators/baseband/src/main/scala/baseband/BLEPacketDisassembler.scala:55:24, :91:25]
      `endif // RANDOMIZE_REG_INIT
    end // initial
    `ifdef FIRRTL_AFTER_INITIAL
      `FIRRTL_AFTER_INITIAL
    `endif // FIRRTL_AFTER_INITIAL
  `endif // ENABLE_INITIAL_REG_
  WhiteningBytes white (	// @[generators/baseband/src/main/scala/baseband/BLEPacketDisassembler.scala:67:21]
    .clock         (clock),
    .reset         (reset),
    .io_in_valid   (io_in_data_data_valid),
    .io_in_bits    (io_in_data_data_bits),
    .io_out_valid  (_white_io_out_valid),
    .io_out_bits   (_white_io_out_bits),
    .io_seed_valid (io_in_data_sop),
    .io_seed_bits  ({io_constants_bleChannelIndex[0], io_constants_bleChannelIndex[1], io_constants_bleChannelIndex[2], io_constants_bleChannelIndex[3], io_constants_bleChannelIndex[4], io_constants_bleChannelIndex[5], 1'h1})	// @[generators/baseband/src/main/scala/baseband/BLEPacketDisassembler.scala:69:{29,37}]
  );
  CRCBytes crc (	// @[generators/baseband/src/main/scala/baseband/BLEPacketDisassembler.scala:73:19]
    .clock         (clock),
    .reset         (reset),
    .io_in_valid   (~(_GEN | _GEN_6) & _white_io_out_valid & (_GEN_5 | _GEN_4)),	// @[generators/baseband/src/main/scala/baseband/BLEPacketDisassembler.scala:67:21, :102:19, :105:{14,36}, :112:105, :118:38, :125:35, :128:19, :130:25, :145:25]
    .io_in_bits    (_white_io_out_bits),	// @[generators/baseband/src/main/scala/baseband/BLEPacketDisassembler.scala:67:21]
    .io_out_valid  (_crc_io_out_valid),
    .io_out_bits   (_crc_io_out_bits),
    .io_seed_valid (io_in_data_sop),
    .io_seed_bits  (io_constants_crcSeed)
  );
  Queue_23 queue (	// @[generators/baseband/src/main/scala/baseband/BLEPacketDisassembler.scala:81:11]
    .clock        (clock),
    .reset        (reset | io_in_data_sop),	// @[generators/baseband/src/main/scala/baseband/BLEPacketDisassembler.scala:80:38]
    .io_enq_ready (/* unused */),
    .io_enq_valid (_white_io_out_valid),	// @[generators/baseband/src/main/scala/baseband/BLEPacketDisassembler.scala:67:21]
    .io_enq_bits  (_white_io_out_bits),	// @[generators/baseband/src/main/scala/baseband/BLEPacketDisassembler.scala:67:21]
    .io_deq_ready (io_out_data_ready),
    .io_deq_valid (io_out_data_valid),
    .io_deq_bits  (io_out_data_bits),
    .io_count     (_queue_io_count)
  );
  assign io_in_data_eop = eop;	// @[generators/baseband/src/main/scala/baseband/BLEPacketDisassembler.scala:61:20]
  assign io_out_control_length = length;	// @[generators/baseband/src/main/scala/baseband/BLEPacketDisassembler.scala:88:25]
  assign io_out_control_flag_crc = flag_crc;	// @[generators/baseband/src/main/scala/baseband/BLEPacketDisassembler.scala:89:25]
  assign io_out_control_done = done;	// @[generators/baseband/src/main/scala/baseband/BLEPacketDisassembler.scala:90:25]
  assign io_out_control_busy = busy;	// @[generators/baseband/src/main/scala/baseband/BLEPacketDisassembler.scala:91:25]
  assign io_state = state;	// @[generators/baseband/src/main/scala/baseband/BLEPacketDisassembler.scala:55:24]
endmodule

