// Generated by CIRCT unknown git version
// Standard header to adapt well known macros for register randomization.
`ifndef RANDOMIZE
  `ifdef RANDOMIZE_MEM_INIT
    `define RANDOMIZE
  `endif // RANDOMIZE_MEM_INIT
`endif // not def RANDOMIZE
`ifndef RANDOMIZE
  `ifdef RANDOMIZE_REG_INIT
    `define RANDOMIZE
  `endif // RANDOMIZE_REG_INIT
`endif // not def RANDOMIZE

// RANDOM may be set to an expression that produces a 32-bit random unsigned value.
`ifndef RANDOM
  `define RANDOM $random
`endif // not def RANDOM

// Users can define INIT_RANDOM as general code that gets injected into the
// initializer block for modules with registers.
`ifndef INIT_RANDOM
  `define INIT_RANDOM
`endif // not def INIT_RANDOM

// If using random initialization, you can also define RANDOMIZE_DELAY to
// customize the delay used, otherwise 0.002 is used.
`ifndef RANDOMIZE_DELAY
  `define RANDOMIZE_DELAY 0.002
`endif // not def RANDOMIZE_DELAY

// Define INIT_RANDOM_PROLOG_ for use in our modules below.
`ifndef INIT_RANDOM_PROLOG_
  `ifdef RANDOMIZE
    `ifdef VERILATOR
      `define INIT_RANDOM_PROLOG_ `INIT_RANDOM
    `else  // VERILATOR
      `define INIT_RANDOM_PROLOG_ `INIT_RANDOM #`RANDOMIZE_DELAY begin end
    `endif // VERILATOR
  `else  // RANDOMIZE
    `define INIT_RANDOM_PROLOG_
  `endif // RANDOMIZE
`endif // not def INIT_RANDOM_PROLOG_

// Include register initializers in init blocks unless synthesis is set
`ifndef SYNTHESIS
  `ifndef ENABLE_INITIAL_REG_
    `define ENABLE_INITIAL_REG_
  `endif // not def ENABLE_INITIAL_REG_
`endif // not def SYNTHESIS

// Include rmemory initializers in init blocks unless synthesis is set
`ifndef SYNTHESIS
  `ifndef ENABLE_INITIAL_MEM_
    `define ENABLE_INITIAL_MEM_
  `endif // not def ENABLE_INITIAL_MEM_
`endif // not def SYNTHESIS

// Standard header to adapt well known macros for prints and assertions.

// Users can define 'PRINTF_COND' to add an extra gate to prints.
`ifndef PRINTF_COND_
  `ifdef PRINTF_COND
    `define PRINTF_COND_ (`PRINTF_COND)
  `else  // PRINTF_COND
    `define PRINTF_COND_ 1
  `endif // PRINTF_COND
`endif // not def PRINTF_COND_

// Users can define 'ASSERT_VERBOSE_COND' to add an extra gate to assert error printing.
`ifndef ASSERT_VERBOSE_COND_
  `ifdef ASSERT_VERBOSE_COND
    `define ASSERT_VERBOSE_COND_ (`ASSERT_VERBOSE_COND)
  `else  // ASSERT_VERBOSE_COND
    `define ASSERT_VERBOSE_COND_ 1
  `endif // ASSERT_VERBOSE_COND
`endif // not def ASSERT_VERBOSE_COND_

// Users can define 'STOP_COND' to add an extra gate to stop conditions.
`ifndef STOP_COND_
  `ifdef STOP_COND
    `define STOP_COND_ (`STOP_COND)
  `else  // STOP_COND
    `define STOP_COND_ 1
  `endif // STOP_COND
`endif // not def STOP_COND_

module MSKTX(
  input        clock,
               reset,
  output       io_digital_in_ready,	// @[generators/baseband/src/main/scala/modem/FSKTX.scala:131:14]
  input        io_digital_in_valid,	// @[generators/baseband/src/main/scala/modem/FSKTX.scala:131:14]
               io_digital_in_bits,	// @[generators/baseband/src/main/scala/modem/FSKTX.scala:131:14]
  output       io_control_ready,	// @[generators/baseband/src/main/scala/modem/FSKTX.scala:131:14]
  input        io_control_valid,	// @[generators/baseband/src/main/scala/modem/FSKTX.scala:131:14]
  input  [8:0] io_control_bits_totalBytes,	// @[generators/baseband/src/main/scala/modem/FSKTX.scala:131:14]
  output [1:0] io_out_state,	// @[generators/baseband/src/main/scala/modem/FSKTX.scala:131:14]
  output       io_out_done,	// @[generators/baseband/src/main/scala/modem/FSKTX.scala:131:14]
  output [5:0] io_modIndex	// @[generators/baseband/src/main/scala/modem/FSKTX.scala:131:14]
);

  reg        state;	// @[generators/baseband/src/main/scala/modem/FSKTX.scala:152:22]
  reg  [5:0] outModIndex;	// @[generators/baseband/src/main/scala/modem/FSKTX.scala:155:28]
  reg        prevChip;	// @[generators/baseband/src/main/scala/modem/FSKTX.scala:156:25]
  reg        evenChip;	// @[generators/baseband/src/main/scala/modem/FSKTX.scala:157:25]
  reg  [7:0] chipHoldCounter;	// @[generators/baseband/src/main/scala/modem/FSKTX.scala:159:32]
  reg  [7:0] counterByte;	// @[generators/baseband/src/main/scala/modem/FSKTX.scala:160:28]
  reg  [8:0] bytesLeft;	// @[generators/baseband/src/main/scala/modem/FSKTX.scala:162:26]
  reg        done;	// @[generators/baseband/src/main/scala/modem/FSKTX.scala:164:21]
  wire       _GEN = chipHoldCounter == 8'h0;	// @[generators/baseband/src/main/scala/modem/FSKTX.scala:159:32, :190:29]
  wire       io_digital_in_ready_0 = state & _GEN;	// @[generators/baseband/src/main/scala/modem/FSKTX.scala:152:22, :168:23, :173:17, :190:29]
  wire       _GEN_0 = io_digital_in_ready_0 & io_digital_in_valid;	// @[generators/baseband/src/main/scala/modem/FSKTX.scala:168:23, :173:17, src/main/scala/chisel3/util/Decoupled.scala:52:35]
  wire       _GEN_1 = state & _GEN & _GEN_0;	// @[generators/baseband/src/main/scala/modem/FSKTX.scala:152:22, :156:25, :173:17, :190:{29,38}, :195:37, :201:20, src/main/scala/chisel3/util/Decoupled.scala:52:35]
  wire       _GEN_2 = counterByte == 8'h0;	// @[generators/baseband/src/main/scala/modem/FSKTX.scala:159:32, :160:28, :208:27]
  wire       _GEN_3 = ~state & io_control_valid;	// @[generators/baseband/src/main/scala/modem/FSKTX.scala:152:22, :173:17, src/main/scala/chisel3/util/Decoupled.scala:52:35]
  wire       _GEN_4 = state & _GEN;	// @[generators/baseband/src/main/scala/modem/FSKTX.scala:152:22, :170:19, :173:17, :190:{29,38}, :192:25]
  wire       _GEN_5 = bytesLeft == 9'h0;	// @[generators/baseband/src/main/scala/modem/FSKTX.scala:162:26, :213:25]
  always @(posedge clock) begin
    if (reset) begin
      state <= 1'h0;	// @[generators/baseband/src/main/scala/modem/FSKTX.scala:152:22]
      outModIndex <= 6'h1F;	// @[generators/baseband/src/main/scala/modem/FSKTX.scala:155:28]
      prevChip <= 1'h0;	// @[generators/baseband/src/main/scala/modem/FSKTX.scala:156:25]
      evenChip <= 1'h0;	// @[generators/baseband/src/main/scala/modem/FSKTX.scala:157:25]
      chipHoldCounter <= 8'h0;	// @[generators/baseband/src/main/scala/modem/FSKTX.scala:159:32]
      counterByte <= 8'h0;	// @[generators/baseband/src/main/scala/modem/FSKTX.scala:159:32, :160:28]
      bytesLeft <= 9'h0;	// @[generators/baseband/src/main/scala/modem/FSKTX.scala:162:26]
      done <= 1'h0;	// @[generators/baseband/src/main/scala/modem/FSKTX.scala:164:21]
    end
    else begin
      if (state) begin	// @[generators/baseband/src/main/scala/modem/FSKTX.scala:152:22]
        state <= ~(state & _GEN & _GEN_5) & state;	// @[generators/baseband/src/main/scala/modem/FSKTX.scala:152:22, :173:17, :190:{29,38}, :213:{25,34}, :214:17]
        if (_GEN_4) begin	// @[generators/baseband/src/main/scala/modem/FSKTX.scala:170:19, :173:17, :190:38, :192:25]
          outModIndex <= _GEN_5 | ~_GEN_0 ? 6'h1F : evenChip ? {6{prevChip ^ ~io_digital_in_bits}} : prevChip ^ ~io_digital_in_bits ? 6'h0 : 6'h3F;	// @[generators/baseband/src/main/scala/modem/FSKTX.scala:155:28, :156:25, :157:25, :195:37, :196:26, :197:{25,31,64}, :199:{25,31,64}, :213:{25,34}, :215:23, src/main/scala/chisel3/util/Decoupled.scala:52:35]
          if (_GEN_2)	// @[generators/baseband/src/main/scala/modem/FSKTX.scala:208:27]
            counterByte <= 8'h3F;	// @[generators/baseband/src/main/scala/modem/FSKTX.scala:160:28, :210:23]
          else	// @[generators/baseband/src/main/scala/modem/FSKTX.scala:208:27]
            counterByte <= counterByte - 8'h1;	// @[generators/baseband/src/main/scala/modem/FSKTX.scala:160:28, :193:36]
        end
        if (_GEN_1)	// @[generators/baseband/src/main/scala/modem/FSKTX.scala:156:25, :173:17, :190:38, :195:37, :201:20]
          prevChip <= io_digital_in_bits;	// @[generators/baseband/src/main/scala/modem/FSKTX.scala:156:25]
        evenChip <= _GEN_1 ^ evenChip;	// @[generators/baseband/src/main/scala/modem/FSKTX.scala:156:25, :157:25, :173:17, :190:38, :195:37, :201:20, :202:20]
        if (state & _GEN & _GEN_2)	// @[generators/baseband/src/main/scala/modem/FSKTX.scala:152:22, :162:26, :173:17, :190:{29,38}, :208:{27,36}, :209:21]
          bytesLeft <= bytesLeft - 9'h1;	// @[generators/baseband/src/main/scala/modem/FSKTX.scala:162:26, :209:34]
      end
      else begin	// @[generators/baseband/src/main/scala/modem/FSKTX.scala:152:22]
        state <= _GEN_3 | state;	// @[generators/baseband/src/main/scala/modem/FSKTX.scala:152:22, :178:32, :179:15, src/main/scala/chisel3/util/Decoupled.scala:52:35]
        outModIndex <= 6'h1F;	// @[generators/baseband/src/main/scala/modem/FSKTX.scala:155:28]
        prevChip <= ~_GEN_3 & prevChip;	// @[generators/baseband/src/main/scala/modem/FSKTX.scala:156:25, :178:32, :181:18, src/main/scala/chisel3/util/Decoupled.scala:52:35]
        evenChip <= _GEN_3 | evenChip;	// @[generators/baseband/src/main/scala/modem/FSKTX.scala:157:25, :178:32, :180:18, src/main/scala/chisel3/util/Decoupled.scala:52:35]
        if (_GEN_3) begin	// @[src/main/scala/chisel3/util/Decoupled.scala:52:35]
          counterByte <= 8'h40;	// @[generators/baseband/src/main/scala/modem/FSKTX.scala:160:28, :183:21]
          bytesLeft <= io_control_bits_totalBytes + 9'h8;	// @[generators/baseband/src/main/scala/modem/FSKTX.scala:162:26, :184:49]
        end
      end
      if (state ? _GEN_4 : _GEN_3)	// @[generators/baseband/src/main/scala/modem/FSKTX.scala:152:22, :170:19, :173:17, :178:32, :182:25, :190:38, :192:25, src/main/scala/chisel3/util/Decoupled.scala:52:35]
        chipHoldCounter <= 8'hF;	// @[generators/baseband/src/main/scala/modem/FSKTX.scala:159:32, :182:25]
      else	// @[generators/baseband/src/main/scala/modem/FSKTX.scala:170:19, :173:17, :178:32, :182:25, :190:38, :192:25]
        chipHoldCounter <= chipHoldCounter - 8'h1;	// @[generators/baseband/src/main/scala/modem/FSKTX.scala:159:32, :170:38]
      done <= state & _GEN_4 & _GEN_5;	// @[generators/baseband/src/main/scala/modem/FSKTX.scala:152:22, :164:21, :170:19, :171:8, :173:17, :190:38, :192:25, :213:25]
    end
  end // always @(posedge)
  `ifdef ENABLE_INITIAL_REG_
    `ifdef FIRRTL_BEFORE_INITIAL
      `FIRRTL_BEFORE_INITIAL
    `endif // FIRRTL_BEFORE_INITIAL
    logic [31:0] _RANDOM[0:1];
    initial begin
      `ifdef INIT_RANDOM_PROLOG_
        `INIT_RANDOM_PROLOG_
      `endif // INIT_RANDOM_PROLOG_
      `ifdef RANDOMIZE_REG_INIT
        for (logic [1:0] i = 2'h0; i < 2'h2; i += 2'h1) begin
          _RANDOM[i[0]] = `RANDOM;
        end
        state = _RANDOM[1'h0][0];	// @[generators/baseband/src/main/scala/modem/FSKTX.scala:152:22]
        outModIndex = _RANDOM[1'h0][6:1];	// @[generators/baseband/src/main/scala/modem/FSKTX.scala:152:22, :155:28]
        prevChip = _RANDOM[1'h0][7];	// @[generators/baseband/src/main/scala/modem/FSKTX.scala:152:22, :156:25]
        evenChip = _RANDOM[1'h0][8];	// @[generators/baseband/src/main/scala/modem/FSKTX.scala:152:22, :157:25]
        chipHoldCounter = _RANDOM[1'h0][16:9];	// @[generators/baseband/src/main/scala/modem/FSKTX.scala:152:22, :159:32]
        counterByte = _RANDOM[1'h0][24:17];	// @[generators/baseband/src/main/scala/modem/FSKTX.scala:152:22, :160:28]
        bytesLeft = {_RANDOM[1'h0][31:25], _RANDOM[1'h1][1:0]};	// @[generators/baseband/src/main/scala/modem/FSKTX.scala:152:22, :162:26]
        done = _RANDOM[1'h1][2];	// @[generators/baseband/src/main/scala/modem/FSKTX.scala:162:26, :164:21]
      `endif // RANDOMIZE_REG_INIT
    end // initial
    `ifdef FIRRTL_AFTER_INITIAL
      `FIRRTL_AFTER_INITIAL
    `endif // FIRRTL_AFTER_INITIAL
  `endif // ENABLE_INITIAL_REG_
  assign io_digital_in_ready = io_digital_in_ready_0;	// @[generators/baseband/src/main/scala/modem/FSKTX.scala:168:23, :173:17]
  assign io_control_ready = ~state;	// @[generators/baseband/src/main/scala/modem/FSKTX.scala:152:22, :173:17]
  assign io_out_state = {1'h0, state};	// @[generators/baseband/src/main/scala/modem/FSKTX.scala:152:22, :153:16]
  assign io_out_done = done;	// @[generators/baseband/src/main/scala/modem/FSKTX.scala:164:21]
  assign io_modIndex = state ? outModIndex : 6'h1F;	// @[generators/baseband/src/main/scala/modem/FSKTX.scala:152:22, :155:28, :222:21]
endmodule

