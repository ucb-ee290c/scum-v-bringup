// Generated by CIRCT unknown git version
// Standard header to adapt well known macros for register randomization.
`ifndef RANDOMIZE
  `ifdef RANDOMIZE_MEM_INIT
    `define RANDOMIZE
  `endif // RANDOMIZE_MEM_INIT
`endif // not def RANDOMIZE
`ifndef RANDOMIZE
  `ifdef RANDOMIZE_REG_INIT
    `define RANDOMIZE
  `endif // RANDOMIZE_REG_INIT
`endif // not def RANDOMIZE

// RANDOM may be set to an expression that produces a 32-bit random unsigned value.
`ifndef RANDOM
  `define RANDOM $random
`endif // not def RANDOM

// Users can define INIT_RANDOM as general code that gets injected into the
// initializer block for modules with registers.
`ifndef INIT_RANDOM
  `define INIT_RANDOM
`endif // not def INIT_RANDOM

// If using random initialization, you can also define RANDOMIZE_DELAY to
// customize the delay used, otherwise 0.002 is used.
`ifndef RANDOMIZE_DELAY
  `define RANDOMIZE_DELAY 0.002
`endif // not def RANDOMIZE_DELAY

// Define INIT_RANDOM_PROLOG_ for use in our modules below.
`ifndef INIT_RANDOM_PROLOG_
  `ifdef RANDOMIZE
    `ifdef VERILATOR
      `define INIT_RANDOM_PROLOG_ `INIT_RANDOM
    `else  // VERILATOR
      `define INIT_RANDOM_PROLOG_ `INIT_RANDOM #`RANDOMIZE_DELAY begin end
    `endif // VERILATOR
  `else  // RANDOMIZE
    `define INIT_RANDOM_PROLOG_
  `endif // RANDOMIZE
`endif // not def INIT_RANDOM_PROLOG_

// Include register initializers in init blocks unless synthesis is set
`ifndef SYNTHESIS
  `ifndef ENABLE_INITIAL_REG_
    `define ENABLE_INITIAL_REG_
  `endif // not def ENABLE_INITIAL_REG_
`endif // not def SYNTHESIS

// Include rmemory initializers in init blocks unless synthesis is set
`ifndef SYNTHESIS
  `ifndef ENABLE_INITIAL_MEM_
    `define ENABLE_INITIAL_MEM_
  `endif // not def ENABLE_INITIAL_MEM_
`endif // not def SYNTHESIS

// Standard header to adapt well known macros for prints and assertions.

// Users can define 'PRINTF_COND' to add an extra gate to prints.
`ifndef PRINTF_COND_
  `ifdef PRINTF_COND
    `define PRINTF_COND_ (`PRINTF_COND)
  `else  // PRINTF_COND
    `define PRINTF_COND_ 1
  `endif // PRINTF_COND
`endif // not def PRINTF_COND_

// Users can define 'ASSERT_VERBOSE_COND' to add an extra gate to assert error printing.
`ifndef ASSERT_VERBOSE_COND_
  `ifdef ASSERT_VERBOSE_COND
    `define ASSERT_VERBOSE_COND_ (`ASSERT_VERBOSE_COND)
  `else  // ASSERT_VERBOSE_COND
    `define ASSERT_VERBOSE_COND_ 1
  `endif // ASSERT_VERBOSE_COND
`endif // not def ASSERT_VERBOSE_COND_

// Users can define 'STOP_COND' to add an extra gate to stop conditions.
`ifndef STOP_COND_
  `ifdef STOP_COND
    `define STOP_COND_ (`STOP_COND)
  `else  // STOP_COND
    `define STOP_COND_ 1
  `endif // STOP_COND
`endif // not def STOP_COND_

module CRC_2(
  input         clock,
                reset,
                io_in_valid,	// @[generators/baseband/src/main/scala/baseband/CRC.scala:27:14]
                io_in_bits,	// @[generators/baseband/src/main/scala/baseband/CRC.scala:27:14]
  output [15:0] io_out,	// @[generators/baseband/src/main/scala/baseband/CRC.scala:27:14]
  input         io_seed_valid,	// @[generators/baseband/src/main/scala/baseband/CRC.scala:27:14]
  input  [15:0] io_seed_bits	// @[generators/baseband/src/main/scala/baseband/CRC.scala:27:14]
);

  reg  [15:0] lfsr;	// @[generators/baseband/src/main/scala/baseband/CRC.scala:33:21]
  wire        inv = lfsr[15] ^ io_in_bits;	// @[generators/baseband/src/main/scala/baseband/CRC.scala:33:21, :34:{18,24}]
  wire [15:0] new_lfsr = {(inv ? 15'h810 : 15'h0) ^ lfsr[14:0], inv};	// @[generators/baseband/src/main/scala/baseband/CRC.scala:33:21, :34:24, :36:{21,25,42,62,68}]
  wire [15:0] _io_out_T = io_in_valid ? new_lfsr : lfsr;	// @[generators/baseband/src/main/scala/baseband/CRC.scala:33:21, :36:21, :47:24]
  always @(posedge clock) begin
    if (reset)
      lfsr <= 16'h0;	// @[generators/baseband/src/main/scala/baseband/CRC.scala:33:21]
    else if (io_seed_valid)	// @[generators/baseband/src/main/scala/baseband/CRC.scala:27:14]
      lfsr <= io_seed_bits;	// @[generators/baseband/src/main/scala/baseband/CRC.scala:33:21]
    else if (io_in_valid)	// @[generators/baseband/src/main/scala/baseband/CRC.scala:27:14]
      lfsr <= new_lfsr;	// @[generators/baseband/src/main/scala/baseband/CRC.scala:33:21, :36:21]
  end // always @(posedge)
  `ifdef ENABLE_INITIAL_REG_
    `ifdef FIRRTL_BEFORE_INITIAL
      `FIRRTL_BEFORE_INITIAL
    `endif // FIRRTL_BEFORE_INITIAL
    logic [31:0] _RANDOM[0:0];
    initial begin
      `ifdef INIT_RANDOM_PROLOG_
        `INIT_RANDOM_PROLOG_
      `endif // INIT_RANDOM_PROLOG_
      `ifdef RANDOMIZE_REG_INIT
        _RANDOM[/*Zero width*/ 1'b0] = `RANDOM;
        lfsr = _RANDOM[/*Zero width*/ 1'b0][15:0];	// @[generators/baseband/src/main/scala/baseband/CRC.scala:33:21]
      `endif // RANDOMIZE_REG_INIT
    end // initial
    `ifdef FIRRTL_AFTER_INITIAL
      `FIRRTL_AFTER_INITIAL
    `endif // FIRRTL_AFTER_INITIAL
  `endif // ENABLE_INITIAL_REG_
  assign io_out = {_io_out_T[0], _io_out_T[1], _io_out_T[2], _io_out_T[3], _io_out_T[4], {{_io_out_T[5:4], _io_out_T[7]} & 3'h5, 1'h0} | {_io_out_T[7:6], _io_out_T[9:8]} & 4'h5, _io_out_T[9], _io_out_T[10], _io_out_T[11], _io_out_T[12], _io_out_T[13], _io_out_T[14], _io_out_T[15]};	// @[generators/baseband/src/main/scala/baseband/CRC.scala:47:{20,24}]
endmodule

