// Generated by CIRCT unknown git version
// Standard header to adapt well known macros for register randomization.
`ifndef RANDOMIZE
  `ifdef RANDOMIZE_MEM_INIT
    `define RANDOMIZE
  `endif // RANDOMIZE_MEM_INIT
`endif // not def RANDOMIZE
`ifndef RANDOMIZE
  `ifdef RANDOMIZE_REG_INIT
    `define RANDOMIZE
  `endif // RANDOMIZE_REG_INIT
`endif // not def RANDOMIZE

// RANDOM may be set to an expression that produces a 32-bit random unsigned value.
`ifndef RANDOM
  `define RANDOM $random
`endif // not def RANDOM

// Users can define INIT_RANDOM as general code that gets injected into the
// initializer block for modules with registers.
`ifndef INIT_RANDOM
  `define INIT_RANDOM
`endif // not def INIT_RANDOM

// If using random initialization, you can also define RANDOMIZE_DELAY to
// customize the delay used, otherwise 0.002 is used.
`ifndef RANDOMIZE_DELAY
  `define RANDOMIZE_DELAY 0.002
`endif // not def RANDOMIZE_DELAY

// Define INIT_RANDOM_PROLOG_ for use in our modules below.
`ifndef INIT_RANDOM_PROLOG_
  `ifdef RANDOMIZE
    `ifdef VERILATOR
      `define INIT_RANDOM_PROLOG_ `INIT_RANDOM
    `else  // VERILATOR
      `define INIT_RANDOM_PROLOG_ `INIT_RANDOM #`RANDOMIZE_DELAY begin end
    `endif // VERILATOR
  `else  // RANDOMIZE
    `define INIT_RANDOM_PROLOG_
  `endif // RANDOMIZE
`endif // not def INIT_RANDOM_PROLOG_

// Include register initializers in init blocks unless synthesis is set
`ifndef SYNTHESIS
  `ifndef ENABLE_INITIAL_REG_
    `define ENABLE_INITIAL_REG_
  `endif // not def ENABLE_INITIAL_REG_
`endif // not def SYNTHESIS

// Include rmemory initializers in init blocks unless synthesis is set
`ifndef SYNTHESIS
  `ifndef ENABLE_INITIAL_MEM_
    `define ENABLE_INITIAL_MEM_
  `endif // not def ENABLE_INITIAL_MEM_
`endif // not def SYNTHESIS

// Standard header to adapt well known macros for prints and assertions.

// Users can define 'PRINTF_COND' to add an extra gate to prints.
`ifndef PRINTF_COND_
  `ifdef PRINTF_COND
    `define PRINTF_COND_ (`PRINTF_COND)
  `else  // PRINTF_COND
    `define PRINTF_COND_ 1
  `endif // PRINTF_COND
`endif // not def PRINTF_COND_

// Users can define 'ASSERT_VERBOSE_COND' to add an extra gate to assert error printing.
`ifndef ASSERT_VERBOSE_COND_
  `ifdef ASSERT_VERBOSE_COND
    `define ASSERT_VERBOSE_COND_ (`ASSERT_VERBOSE_COND)
  `else  // ASSERT_VERBOSE_COND
    `define ASSERT_VERBOSE_COND_ 1
  `endif // ASSERT_VERBOSE_COND
`endif // not def ASSERT_VERBOSE_COND_

// Users can define 'STOP_COND' to add an extra gate to stop conditions.
`ifndef STOP_COND_
  `ifdef STOP_COND
    `define STOP_COND_ (`STOP_COND)
  `else  // STOP_COND
    `define STOP_COND_ 1
  `endif // STOP_COND
`endif // not def STOP_COND_

module TLWidthWidget_3(
  input         clock,
                reset,
  output        auto_in_a_ready,	// @[generators/rocket-chip/src/main/scala/diplomacy/LazyModule.scala:366:18]
  input         auto_in_a_valid,	// @[generators/rocket-chip/src/main/scala/diplomacy/LazyModule.scala:366:18]
  input  [2:0]  auto_in_a_bits_opcode,	// @[generators/rocket-chip/src/main/scala/diplomacy/LazyModule.scala:366:18]
                auto_in_a_bits_param,	// @[generators/rocket-chip/src/main/scala/diplomacy/LazyModule.scala:366:18]
                auto_in_a_bits_size,	// @[generators/rocket-chip/src/main/scala/diplomacy/LazyModule.scala:366:18]
  input  [10:0] auto_in_a_bits_source,	// @[generators/rocket-chip/src/main/scala/diplomacy/LazyModule.scala:366:18]
  input  [29:0] auto_in_a_bits_address,	// @[generators/rocket-chip/src/main/scala/diplomacy/LazyModule.scala:366:18]
  input  [3:0]  auto_in_a_bits_mask,	// @[generators/rocket-chip/src/main/scala/diplomacy/LazyModule.scala:366:18]
  input         auto_in_a_bits_corrupt,	// @[generators/rocket-chip/src/main/scala/diplomacy/LazyModule.scala:366:18]
                auto_in_d_ready,	// @[generators/rocket-chip/src/main/scala/diplomacy/LazyModule.scala:366:18]
  output        auto_in_d_valid,	// @[generators/rocket-chip/src/main/scala/diplomacy/LazyModule.scala:366:18]
  output [2:0]  auto_in_d_bits_size,	// @[generators/rocket-chip/src/main/scala/diplomacy/LazyModule.scala:366:18]
  output [10:0] auto_in_d_bits_source,	// @[generators/rocket-chip/src/main/scala/diplomacy/LazyModule.scala:366:18]
  output [31:0] auto_in_d_bits_data,	// @[generators/rocket-chip/src/main/scala/diplomacy/LazyModule.scala:366:18]
  input         auto_out_a_ready,	// @[generators/rocket-chip/src/main/scala/diplomacy/LazyModule.scala:366:18]
  output        auto_out_a_valid,	// @[generators/rocket-chip/src/main/scala/diplomacy/LazyModule.scala:366:18]
  output [2:0]  auto_out_a_bits_opcode,	// @[generators/rocket-chip/src/main/scala/diplomacy/LazyModule.scala:366:18]
                auto_out_a_bits_param,	// @[generators/rocket-chip/src/main/scala/diplomacy/LazyModule.scala:366:18]
                auto_out_a_bits_size,	// @[generators/rocket-chip/src/main/scala/diplomacy/LazyModule.scala:366:18]
  output [10:0] auto_out_a_bits_source,	// @[generators/rocket-chip/src/main/scala/diplomacy/LazyModule.scala:366:18]
  output [29:0] auto_out_a_bits_address,	// @[generators/rocket-chip/src/main/scala/diplomacy/LazyModule.scala:366:18]
  output        auto_out_a_bits_mask,	// @[generators/rocket-chip/src/main/scala/diplomacy/LazyModule.scala:366:18]
                auto_out_a_bits_corrupt,	// @[generators/rocket-chip/src/main/scala/diplomacy/LazyModule.scala:366:18]
                auto_out_d_ready,	// @[generators/rocket-chip/src/main/scala/diplomacy/LazyModule.scala:366:18]
  input         auto_out_d_valid,	// @[generators/rocket-chip/src/main/scala/diplomacy/LazyModule.scala:366:18]
  input  [2:0]  auto_out_d_bits_size,	// @[generators/rocket-chip/src/main/scala/diplomacy/LazyModule.scala:366:18]
  input  [10:0] auto_out_d_bits_source,	// @[generators/rocket-chip/src/main/scala/diplomacy/LazyModule.scala:366:18]
  input  [7:0]  auto_out_d_bits_data	// @[generators/rocket-chip/src/main/scala/diplomacy/LazyModule.scala:366:18]
);

  wire        _repeated_repeater_io_enq_ready;	// @[generators/rocket-chip/src/main/scala/util/Repeater.scala:35:26]
  wire [29:0] _repeated_repeater_io_deq_bits_address;	// @[generators/rocket-chip/src/main/scala/util/Repeater.scala:35:26]
  wire [3:0]  _repeated_repeater_io_deq_bits_mask;	// @[generators/rocket-chip/src/main/scala/util/Repeater.scala:35:26]
  wire [3:0]  _GEN = {{_repeated_repeater_io_deq_bits_mask[3]}, {_repeated_repeater_io_deq_bits_mask[2]}, {_repeated_repeater_io_deq_bits_mask[1]}, {_repeated_repeater_io_deq_bits_mask[0]}};	// @[generators/rocket-chip/src/main/scala/tilelink/WidthWidget.scala:123:55, :135:53, generators/rocket-chip/src/main/scala/util/Repeater.scala:35:26]
  wire [8:0]  _limit_T_1 = 9'h3 << auto_out_d_bits_size;	// @[generators/rocket-chip/src/main/scala/util/package.scala:235:71]
  reg  [1:0]  count;	// @[generators/rocket-chip/src/main/scala/tilelink/WidthWidget.scala:35:27]
  wire        last = count == ~(_limit_T_1[1:0]);	// @[generators/rocket-chip/src/main/scala/tilelink/WidthWidget.scala:35:27, :37:26, generators/rocket-chip/src/main/scala/util/package.scala:235:{46,71,76}]
  wire        nodeOut_d_ready = auto_in_d_ready | ~last;	// @[generators/rocket-chip/src/main/scala/tilelink/WidthWidget.scala:37:26, :71:{29,32}]
  wire        nodeIn_d_valid = auto_out_d_valid & last;	// @[generators/rocket-chip/src/main/scala/tilelink/WidthWidget.scala:37:26, :72:29]
  reg         nodeIn_d_bits_data_rdata_written_once;	// @[generators/rocket-chip/src/main/scala/tilelink/WidthWidget.scala:57:41]
  wire        nodeIn_d_bits_data_masked_enable_0 = (count & ~(_limit_T_1[1:0])) == 2'h0 | ~nodeIn_d_bits_data_rdata_written_once;	// @[generators/rocket-chip/src/main/scala/tilelink/WidthWidget.scala:35:27, :38:{63,72}, :57:41, :58:{42,45}, :100:26, generators/rocket-chip/src/main/scala/util/package.scala:235:{46,71,76}]
  wire        nodeIn_d_bits_data_masked_enable_1 = ({count[1], ~(count[0])} & ~(_limit_T_1[1:0])) == 2'h0 | ~nodeIn_d_bits_data_rdata_written_once;	// @[generators/rocket-chip/src/main/scala/tilelink/WidthWidget.scala:35:27, :38:{56,63,72}, :57:41, :58:{42,45}, :100:26, generators/rocket-chip/src/main/scala/util/package.scala:235:{46,71,76}]
  wire        nodeIn_d_bits_data_masked_enable_2 = ((count ^ 2'h2) & ~(_limit_T_1[1:0])) == 2'h0 | ~nodeIn_d_bits_data_rdata_written_once;	// @[generators/rocket-chip/src/main/scala/tilelink/WidthWidget.scala:35:27, :38:{56,63,72}, :57:41, :58:{42,45}, :100:26, generators/rocket-chip/src/main/scala/util/package.scala:235:{46,71,76}]
  reg  [7:0]  nodeIn_d_bits_data_rdata_0;	// @[generators/rocket-chip/src/main/scala/tilelink/WidthWidget.scala:61:24]
  reg  [7:0]  nodeIn_d_bits_data_rdata_1;	// @[generators/rocket-chip/src/main/scala/tilelink/WidthWidget.scala:61:24]
  reg  [7:0]  nodeIn_d_bits_data_rdata_2;	// @[generators/rocket-chip/src/main/scala/tilelink/WidthWidget.scala:61:24]
  wire        _nodeIn_d_bits_data_T = nodeOut_d_ready & auto_out_d_valid;	// @[generators/rocket-chip/src/main/scala/tilelink/WidthWidget.scala:71:29, src/main/scala/chisel3/util/Decoupled.scala:52:35]
  wire        _nodeIn_d_bits_data_T_2 = _nodeIn_d_bits_data_T & ~last;	// @[generators/rocket-chip/src/main/scala/tilelink/WidthWidget.scala:37:26, :64:23, :71:32, src/main/scala/chisel3/util/Decoupled.scala:52:35]
  always @(posedge clock) begin
    if (reset) begin
      count <= 2'h0;	// @[generators/rocket-chip/src/main/scala/tilelink/WidthWidget.scala:35:27, :100:26]
      nodeIn_d_bits_data_rdata_written_once <= 1'h0;	// @[generators/rocket-chip/src/main/scala/tilelink/WidthWidget.scala:57:41]
    end
    else begin
      if (_nodeIn_d_bits_data_T) begin	// @[src/main/scala/chisel3/util/Decoupled.scala:52:35]
        if (last)	// @[generators/rocket-chip/src/main/scala/tilelink/WidthWidget.scala:37:26]
          count <= 2'h0;	// @[generators/rocket-chip/src/main/scala/tilelink/WidthWidget.scala:35:27, :100:26]
        else	// @[generators/rocket-chip/src/main/scala/tilelink/WidthWidget.scala:37:26]
          count <= count + 2'h1;	// @[generators/rocket-chip/src/main/scala/tilelink/WidthWidget.scala:35:27, :45:24]
      end
      nodeIn_d_bits_data_rdata_written_once <= _nodeIn_d_bits_data_T_2 | nodeIn_d_bits_data_rdata_written_once;	// @[generators/rocket-chip/src/main/scala/tilelink/WidthWidget.scala:57:41, :64:{23,33}, :65:30]
    end
    if (_nodeIn_d_bits_data_T_2 & nodeIn_d_bits_data_masked_enable_0)	// @[generators/rocket-chip/src/main/scala/tilelink/WidthWidget.scala:58:42, :61:24, :63:88, :64:{23,33}, :66:56]
      nodeIn_d_bits_data_rdata_0 <= auto_out_d_bits_data;	// @[generators/rocket-chip/src/main/scala/tilelink/WidthWidget.scala:61:24]
    if (_nodeIn_d_bits_data_T_2 & nodeIn_d_bits_data_masked_enable_1)	// @[generators/rocket-chip/src/main/scala/tilelink/WidthWidget.scala:58:42, :61:24, :63:88, :64:{23,33}, :66:56]
      nodeIn_d_bits_data_rdata_1 <= auto_out_d_bits_data;	// @[generators/rocket-chip/src/main/scala/tilelink/WidthWidget.scala:61:24]
    if (_nodeIn_d_bits_data_T_2 & nodeIn_d_bits_data_masked_enable_2)	// @[generators/rocket-chip/src/main/scala/tilelink/WidthWidget.scala:58:42, :61:24, :63:88, :64:{23,33}, :66:56]
      nodeIn_d_bits_data_rdata_2 <= auto_out_d_bits_data;	// @[generators/rocket-chip/src/main/scala/tilelink/WidthWidget.scala:61:24]
  end // always @(posedge)
  `ifdef ENABLE_INITIAL_REG_
    `ifdef FIRRTL_BEFORE_INITIAL
      `FIRRTL_BEFORE_INITIAL
    `endif // FIRRTL_BEFORE_INITIAL
    logic [31:0] _RANDOM[0:0];
    initial begin
      `ifdef INIT_RANDOM_PROLOG_
        `INIT_RANDOM_PROLOG_
      `endif // INIT_RANDOM_PROLOG_
      `ifdef RANDOMIZE_REG_INIT
        _RANDOM[/*Zero width*/ 1'b0] = `RANDOM;
        count = _RANDOM[/*Zero width*/ 1'b0][3:2];	// @[generators/rocket-chip/src/main/scala/tilelink/WidthWidget.scala:35:27]
        nodeIn_d_bits_data_rdata_written_once = _RANDOM[/*Zero width*/ 1'b0][5];	// @[generators/rocket-chip/src/main/scala/tilelink/WidthWidget.scala:35:27, :57:41]
        nodeIn_d_bits_data_rdata_0 = _RANDOM[/*Zero width*/ 1'b0][13:6];	// @[generators/rocket-chip/src/main/scala/tilelink/WidthWidget.scala:35:27, :61:24]
        nodeIn_d_bits_data_rdata_1 = _RANDOM[/*Zero width*/ 1'b0][21:14];	// @[generators/rocket-chip/src/main/scala/tilelink/WidthWidget.scala:35:27, :61:24]
        nodeIn_d_bits_data_rdata_2 = _RANDOM[/*Zero width*/ 1'b0][29:22];	// @[generators/rocket-chip/src/main/scala/tilelink/WidthWidget.scala:35:27, :61:24]
      `endif // RANDOMIZE_REG_INIT
    end // initial
    `ifdef FIRRTL_AFTER_INITIAL
      `FIRRTL_AFTER_INITIAL
    `endif // FIRRTL_AFTER_INITIAL
  `endif // ENABLE_INITIAL_REG_
  TLMonitor_15 monitor (	// @[generators/rocket-chip/src/main/scala/tilelink/Nodes.scala:24:25]
    .clock                (clock),
    .reset                (reset),
    .io_in_a_ready        (_repeated_repeater_io_enq_ready),	// @[generators/rocket-chip/src/main/scala/util/Repeater.scala:35:26]
    .io_in_a_valid        (auto_in_a_valid),
    .io_in_a_bits_opcode  (auto_in_a_bits_opcode),
    .io_in_a_bits_param   (auto_in_a_bits_param),
    .io_in_a_bits_size    (auto_in_a_bits_size),
    .io_in_a_bits_source  (auto_in_a_bits_source),
    .io_in_a_bits_address (auto_in_a_bits_address),
    .io_in_a_bits_mask    (auto_in_a_bits_mask),
    .io_in_a_bits_corrupt (auto_in_a_bits_corrupt),
    .io_in_d_ready        (auto_in_d_ready),
    .io_in_d_valid        (nodeIn_d_valid),	// @[generators/rocket-chip/src/main/scala/tilelink/WidthWidget.scala:72:29]
    .io_in_d_bits_size    (auto_out_d_bits_size),
    .io_in_d_bits_source  (auto_out_d_bits_source)
  );
  Repeater_5 repeated_repeater (	// @[generators/rocket-chip/src/main/scala/util/Repeater.scala:35:26]
    .io_enq_ready        (_repeated_repeater_io_enq_ready),
    .io_enq_valid        (auto_in_a_valid),
    .io_enq_bits_opcode  (auto_in_a_bits_opcode),
    .io_enq_bits_param   (auto_in_a_bits_param),
    .io_enq_bits_size    (auto_in_a_bits_size),
    .io_enq_bits_source  (auto_in_a_bits_source),
    .io_enq_bits_address (auto_in_a_bits_address),
    .io_enq_bits_mask    (auto_in_a_bits_mask),
    .io_enq_bits_corrupt (auto_in_a_bits_corrupt),
    .io_deq_ready        (auto_out_a_ready),
    .io_deq_valid        (auto_out_a_valid),
    .io_deq_bits_opcode  (auto_out_a_bits_opcode),
    .io_deq_bits_param   (auto_out_a_bits_param),
    .io_deq_bits_size    (auto_out_a_bits_size),
    .io_deq_bits_source  (auto_out_a_bits_source),
    .io_deq_bits_address (_repeated_repeater_io_deq_bits_address),
    .io_deq_bits_mask    (_repeated_repeater_io_deq_bits_mask),
    .io_deq_bits_corrupt (auto_out_a_bits_corrupt)
  );
  assign auto_in_a_ready = _repeated_repeater_io_enq_ready;	// @[generators/rocket-chip/src/main/scala/util/Repeater.scala:35:26]
  assign auto_in_d_valid = nodeIn_d_valid;	// @[generators/rocket-chip/src/main/scala/tilelink/WidthWidget.scala:72:29]
  assign auto_in_d_bits_size = auto_out_d_bits_size;
  assign auto_in_d_bits_source = auto_out_d_bits_source;
  assign auto_in_d_bits_data = {auto_out_d_bits_data, nodeIn_d_bits_data_masked_enable_2 ? auto_out_d_bits_data : nodeIn_d_bits_data_rdata_2, nodeIn_d_bits_data_masked_enable_1 ? auto_out_d_bits_data : nodeIn_d_bits_data_rdata_1, nodeIn_d_bits_data_masked_enable_0 ? auto_out_d_bits_data : nodeIn_d_bits_data_rdata_0};	// @[generators/rocket-chip/src/main/scala/tilelink/WidthWidget.scala:58:42, :61:24, :63:88, :68:12]
  assign auto_out_a_bits_address = _repeated_repeater_io_deq_bits_address;	// @[generators/rocket-chip/src/main/scala/util/Repeater.scala:35:26]
  assign auto_out_a_bits_mask = _GEN[_repeated_repeater_io_deq_bits_address[1:0]];	// @[generators/rocket-chip/src/main/scala/tilelink/WidthWidget.scala:111:39, :135:53, generators/rocket-chip/src/main/scala/util/Repeater.scala:35:26]
  assign auto_out_d_ready = nodeOut_d_ready;	// @[generators/rocket-chip/src/main/scala/tilelink/WidthWidget.scala:71:29]
endmodule

