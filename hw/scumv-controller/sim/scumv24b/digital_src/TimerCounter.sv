// Generated by CIRCT unknown git version
// Standard header to adapt well known macros for register randomization.
`ifndef RANDOMIZE
  `ifdef RANDOMIZE_MEM_INIT
    `define RANDOMIZE
  `endif // RANDOMIZE_MEM_INIT
`endif // not def RANDOMIZE
`ifndef RANDOMIZE
  `ifdef RANDOMIZE_REG_INIT
    `define RANDOMIZE
  `endif // RANDOMIZE_REG_INIT
`endif // not def RANDOMIZE

// RANDOM may be set to an expression that produces a 32-bit random unsigned value.
`ifndef RANDOM
  `define RANDOM $random
`endif // not def RANDOM

// Users can define INIT_RANDOM as general code that gets injected into the
// initializer block for modules with registers.
`ifndef INIT_RANDOM
  `define INIT_RANDOM
`endif // not def INIT_RANDOM

// If using random initialization, you can also define RANDOMIZE_DELAY to
// customize the delay used, otherwise 0.002 is used.
`ifndef RANDOMIZE_DELAY
  `define RANDOMIZE_DELAY 0.002
`endif // not def RANDOMIZE_DELAY

// Define INIT_RANDOM_PROLOG_ for use in our modules below.
`ifndef INIT_RANDOM_PROLOG_
  `ifdef RANDOMIZE
    `ifdef VERILATOR
      `define INIT_RANDOM_PROLOG_ `INIT_RANDOM
    `else  // VERILATOR
      `define INIT_RANDOM_PROLOG_ `INIT_RANDOM #`RANDOMIZE_DELAY begin end
    `endif // VERILATOR
  `else  // RANDOMIZE
    `define INIT_RANDOM_PROLOG_
  `endif // RANDOMIZE
`endif // not def INIT_RANDOM_PROLOG_

// Include register initializers in init blocks unless synthesis is set
`ifndef SYNTHESIS
  `ifndef ENABLE_INITIAL_REG_
    `define ENABLE_INITIAL_REG_
  `endif // not def ENABLE_INITIAL_REG_
`endif // not def SYNTHESIS

// Include rmemory initializers in init blocks unless synthesis is set
`ifndef SYNTHESIS
  `ifndef ENABLE_INITIAL_MEM_
    `define ENABLE_INITIAL_MEM_
  `endif // not def ENABLE_INITIAL_MEM_
`endif // not def SYNTHESIS

// Standard header to adapt well known macros for prints and assertions.

// Users can define 'PRINTF_COND' to add an extra gate to prints.
`ifndef PRINTF_COND_
  `ifdef PRINTF_COND
    `define PRINTF_COND_ (`PRINTF_COND)
  `else  // PRINTF_COND
    `define PRINTF_COND_ 1
  `endif // PRINTF_COND
`endif // not def PRINTF_COND_

// Users can define 'ASSERT_VERBOSE_COND' to add an extra gate to assert error printing.
`ifndef ASSERT_VERBOSE_COND_
  `ifdef ASSERT_VERBOSE_COND
    `define ASSERT_VERBOSE_COND_ (`ASSERT_VERBOSE_COND)
  `else  // ASSERT_VERBOSE_COND
    `define ASSERT_VERBOSE_COND_ 1
  `endif // ASSERT_VERBOSE_COND
`endif // not def ASSERT_VERBOSE_COND_

// Users can define 'STOP_COND' to add an extra gate to stop conditions.
`ifndef STOP_COND_
  `ifdef STOP_COND
    `define STOP_COND_ (`STOP_COND)
  `else  // STOP_COND
    `define STOP_COND_ 1
  `endif // STOP_COND
`endif // not def STOP_COND_

module TimerCounter(
  input         clock,
                reset,
                io_task_start,	// @[generators/rtc-timer/src/main/scala/RTCTimer.scala:276:14]
                io_task_clear,	// @[generators/rtc-timer/src/main/scala/RTCTimer.scala:276:14]
                io_task_trigovrflw,	// @[generators/rtc-timer/src/main/scala/RTCTimer.scala:276:14]
  input  [11:0] io_prescaler,	// @[generators/rtc-timer/src/main/scala/RTCTimer.scala:276:14]
  output [31:0] io_counter	// @[generators/rtc-timer/src/main/scala/RTCTimer.scala:276:14]
);

  reg  [31:0] counter;	// @[generators/rtc-timer/src/main/scala/RTCTimer.scala:279:24]
  reg  [11:0] internal_counter;	// @[generators/rtc-timer/src/main/scala/RTCTimer.scala:293:35]
  wire        _GEN = internal_counter == io_prescaler;	// @[generators/rtc-timer/src/main/scala/RTCTimer.scala:293:35, :294:28]
  always @(posedge clock) begin
    if (reset) begin
      counter <= 32'h0;	// @[generators/rtc-timer/src/main/scala/RTCTimer.scala:279:24]
      internal_counter <= 12'h0;	// @[generators/rtc-timer/src/main/scala/RTCTimer.scala:293:35]
    end
    else begin
      if (io_task_clear)	// @[generators/rtc-timer/src/main/scala/RTCTimer.scala:276:14]
        counter <= 32'h0;	// @[generators/rtc-timer/src/main/scala/RTCTimer.scala:279:24]
      else if (io_task_trigovrflw)	// @[generators/rtc-timer/src/main/scala/RTCTimer.scala:276:14]
        counter <= 32'hFFFFFFFF;	// @[generators/rtc-timer/src/main/scala/RTCTimer.scala:279:24, :289:13]
      else if (io_task_start & _GEN)	// @[generators/rtc-timer/src/main/scala/RTCTimer.scala:279:24, :291:29, :294:{28,46}, :296:15]
        counter <= counter + 32'h1;	// @[generators/rtc-timer/src/main/scala/RTCTimer.scala:279:24, :296:26]
      if (_GEN)	// @[generators/rtc-timer/src/main/scala/RTCTimer.scala:294:28]
        internal_counter <= 12'h0;	// @[generators/rtc-timer/src/main/scala/RTCTimer.scala:293:35]
      else	// @[generators/rtc-timer/src/main/scala/RTCTimer.scala:294:28]
        internal_counter <= internal_counter + 12'h1;	// @[generators/rtc-timer/src/main/scala/RTCTimer.scala:293:35, :299:44]
    end
  end // always @(posedge)
  `ifdef ENABLE_INITIAL_REG_
    `ifdef FIRRTL_BEFORE_INITIAL
      `FIRRTL_BEFORE_INITIAL
    `endif // FIRRTL_BEFORE_INITIAL
    logic [31:0] _RANDOM[0:1];
    initial begin
      `ifdef INIT_RANDOM_PROLOG_
        `INIT_RANDOM_PROLOG_
      `endif // INIT_RANDOM_PROLOG_
      `ifdef RANDOMIZE_REG_INIT
        for (logic [1:0] i = 2'h0; i < 2'h2; i += 2'h1) begin
          _RANDOM[i[0]] = `RANDOM;
        end
        counter = _RANDOM[1'h0];	// @[generators/rtc-timer/src/main/scala/RTCTimer.scala:279:24]
        internal_counter = _RANDOM[1'h1][11:0];	// @[generators/rtc-timer/src/main/scala/RTCTimer.scala:293:35]
      `endif // RANDOMIZE_REG_INIT
    end // initial
    `ifdef FIRRTL_AFTER_INITIAL
      `FIRRTL_AFTER_INITIAL
    `endif // FIRRTL_AFTER_INITIAL
  `endif // ENABLE_INITIAL_REG_
  assign io_counter = counter;	// @[generators/rtc-timer/src/main/scala/RTCTimer.scala:279:24]
endmodule

