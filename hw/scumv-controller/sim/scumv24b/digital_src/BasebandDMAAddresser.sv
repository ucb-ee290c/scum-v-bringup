// Generated by CIRCT unknown git version
// Standard header to adapt well known macros for register randomization.
`ifndef RANDOMIZE
  `ifdef RANDOMIZE_MEM_INIT
    `define RANDOMIZE
  `endif // RANDOMIZE_MEM_INIT
`endif // not def RANDOMIZE
`ifndef RANDOMIZE
  `ifdef RANDOMIZE_REG_INIT
    `define RANDOMIZE
  `endif // RANDOMIZE_REG_INIT
`endif // not def RANDOMIZE

// RANDOM may be set to an expression that produces a 32-bit random unsigned value.
`ifndef RANDOM
  `define RANDOM $random
`endif // not def RANDOM

// Users can define INIT_RANDOM as general code that gets injected into the
// initializer block for modules with registers.
`ifndef INIT_RANDOM
  `define INIT_RANDOM
`endif // not def INIT_RANDOM

// If using random initialization, you can also define RANDOMIZE_DELAY to
// customize the delay used, otherwise 0.002 is used.
`ifndef RANDOMIZE_DELAY
  `define RANDOMIZE_DELAY 0.002
`endif // not def RANDOMIZE_DELAY

// Define INIT_RANDOM_PROLOG_ for use in our modules below.
`ifndef INIT_RANDOM_PROLOG_
  `ifdef RANDOMIZE
    `ifdef VERILATOR
      `define INIT_RANDOM_PROLOG_ `INIT_RANDOM
    `else  // VERILATOR
      `define INIT_RANDOM_PROLOG_ `INIT_RANDOM #`RANDOMIZE_DELAY begin end
    `endif // VERILATOR
  `else  // RANDOMIZE
    `define INIT_RANDOM_PROLOG_
  `endif // RANDOMIZE
`endif // not def INIT_RANDOM_PROLOG_

// Include register initializers in init blocks unless synthesis is set
`ifndef SYNTHESIS
  `ifndef ENABLE_INITIAL_REG_
    `define ENABLE_INITIAL_REG_
  `endif // not def ENABLE_INITIAL_REG_
`endif // not def SYNTHESIS

// Include rmemory initializers in init blocks unless synthesis is set
`ifndef SYNTHESIS
  `ifndef ENABLE_INITIAL_MEM_
    `define ENABLE_INITIAL_MEM_
  `endif // not def ENABLE_INITIAL_MEM_
`endif // not def SYNTHESIS

// Standard header to adapt well known macros for prints and assertions.

// Users can define 'PRINTF_COND' to add an extra gate to prints.
`ifndef PRINTF_COND_
  `ifdef PRINTF_COND
    `define PRINTF_COND_ (`PRINTF_COND)
  `else  // PRINTF_COND
    `define PRINTF_COND_ 1
  `endif // PRINTF_COND
`endif // not def PRINTF_COND_

// Users can define 'ASSERT_VERBOSE_COND' to add an extra gate to assert error printing.
`ifndef ASSERT_VERBOSE_COND_
  `ifdef ASSERT_VERBOSE_COND
    `define ASSERT_VERBOSE_COND_ (`ASSERT_VERBOSE_COND)
  `else  // ASSERT_VERBOSE_COND
    `define ASSERT_VERBOSE_COND_ 1
  `endif // ASSERT_VERBOSE_COND
`endif // not def ASSERT_VERBOSE_COND_

// Users can define 'STOP_COND' to add an extra gate to stop conditions.
`ifndef STOP_COND_
  `ifdef STOP_COND
    `define STOP_COND_ (`STOP_COND)
  `else  // STOP_COND
    `define STOP_COND_ 1
  `endif // STOP_COND
`endif // not def STOP_COND_

module BasebandDMAAddresser(
  input         clock,
                reset,
  output        io_in_ready,	// @[generators/baseband/src/main/scala/baseband/Baseband.scala:65:14]
  input         io_in_valid,	// @[generators/baseband/src/main/scala/baseband/Baseband.scala:65:14]
  input  [31:0] io_in_bits_data,	// @[generators/baseband/src/main/scala/baseband/Baseband.scala:65:14]
  input  [2:0]  io_in_bits_size,	// @[generators/baseband/src/main/scala/baseband/Baseband.scala:65:14]
  input         io_out_ready,	// @[generators/baseband/src/main/scala/baseband/Baseband.scala:65:14]
  output        io_out_valid,	// @[generators/baseband/src/main/scala/baseband/Baseband.scala:65:14]
  output [31:0] io_out_bits_addr,	// @[generators/baseband/src/main/scala/baseband/Baseband.scala:65:14]
                io_out_bits_data,	// @[generators/baseband/src/main/scala/baseband/Baseband.scala:65:14]
  output [2:0]  io_out_bits_totalBytes,	// @[generators/baseband/src/main/scala/baseband/Baseband.scala:65:14]
  input         io_baseAddr_valid,	// @[generators/baseband/src/main/scala/baseband/Baseband.scala:65:14]
  input  [31:0] io_baseAddr_bits	// @[generators/baseband/src/main/scala/baseband/Baseband.scala:65:14]
);

  reg         out_valid;	// @[generators/baseband/src/main/scala/baseband/Baseband.scala:71:26]
  reg         out_ready;	// @[generators/baseband/src/main/scala/baseband/Baseband.scala:72:26]
  reg  [2:0]  out_totalBytes;	// @[generators/baseband/src/main/scala/baseband/Baseband.scala:73:27]
  reg  [31:0] out_data;	// @[generators/baseband/src/main/scala/baseband/Baseband.scala:74:21]
  reg  [31:0] out_addr;	// @[generators/baseband/src/main/scala/baseband/Baseband.scala:75:21]
  reg  [31:0] offset;	// @[generators/baseband/src/main/scala/baseband/Baseband.scala:77:23]
  reg  [31:0] baseAddr;	// @[generators/baseband/src/main/scala/baseband/Baseband.scala:79:21]
  wire        _GEN = out_ready & io_in_valid;	// @[generators/baseband/src/main/scala/baseband/Baseband.scala:72:26, src/main/scala/chisel3/util/Decoupled.scala:52:35]
  always @(posedge clock) begin
    if (reset) begin
      out_valid <= 1'h0;	// @[generators/baseband/src/main/scala/baseband/Baseband.scala:71:26]
      out_ready <= 1'h0;	// @[generators/baseband/src/main/scala/baseband/Baseband.scala:71:26, :72:26]
      offset <= 32'h0;	// @[generators/baseband/src/main/scala/baseband/Baseband.scala:77:23]
    end
    else begin
      out_valid <= io_in_valid;	// @[generators/baseband/src/main/scala/baseband/Baseband.scala:71:26]
      out_ready <= io_out_ready;	// @[generators/baseband/src/main/scala/baseband/Baseband.scala:72:26]
      if (io_baseAddr_valid)	// @[generators/baseband/src/main/scala/baseband/Baseband.scala:65:14]
        offset <= 32'h0;	// @[generators/baseband/src/main/scala/baseband/Baseband.scala:77:23]
      else if (_GEN)	// @[src/main/scala/chisel3/util/Decoupled.scala:52:35]
        offset <= offset + {29'h0, io_in_bits_size};	// @[generators/baseband/src/main/scala/baseband/Baseband.scala:77:23, :93:22]
    end
    if (io_baseAddr_valid | ~_GEN) begin	// @[generators/baseband/src/main/scala/baseband/Baseband.scala:73:27, :75:21, :89:29, :92:29, src/main/scala/chisel3/util/Decoupled.scala:52:35]
    end
    else begin	// @[generators/baseband/src/main/scala/baseband/Baseband.scala:75:21, :89:29, :92:29]
      out_totalBytes <= io_in_bits_size;	// @[generators/baseband/src/main/scala/baseband/Baseband.scala:73:27]
      out_data <= io_in_bits_data;	// @[generators/baseband/src/main/scala/baseband/Baseband.scala:74:21]
      out_addr <= baseAddr + offset;	// @[generators/baseband/src/main/scala/baseband/Baseband.scala:75:21, :77:23, :79:21, :97:26]
    end
    if (io_baseAddr_valid)	// @[generators/baseband/src/main/scala/baseband/Baseband.scala:65:14]
      baseAddr <= io_baseAddr_bits;	// @[generators/baseband/src/main/scala/baseband/Baseband.scala:79:21]
  end // always @(posedge)
  `ifdef ENABLE_INITIAL_REG_
    `ifdef FIRRTL_BEFORE_INITIAL
      `FIRRTL_BEFORE_INITIAL
    `endif // FIRRTL_BEFORE_INITIAL
    logic [31:0] _RANDOM[0:4];
    initial begin
      `ifdef INIT_RANDOM_PROLOG_
        `INIT_RANDOM_PROLOG_
      `endif // INIT_RANDOM_PROLOG_
      `ifdef RANDOMIZE_REG_INIT
        for (logic [2:0] i = 3'h0; i < 3'h5; i += 3'h1) begin
          _RANDOM[i] = `RANDOM;
        end
        out_valid = _RANDOM[3'h0][0];	// @[generators/baseband/src/main/scala/baseband/Baseband.scala:71:26]
        out_ready = _RANDOM[3'h0][1];	// @[generators/baseband/src/main/scala/baseband/Baseband.scala:71:26, :72:26]
        out_totalBytes = _RANDOM[3'h0][4:2];	// @[generators/baseband/src/main/scala/baseband/Baseband.scala:71:26, :73:27]
        out_data = {_RANDOM[3'h0][31:5], _RANDOM[3'h1][4:0]};	// @[generators/baseband/src/main/scala/baseband/Baseband.scala:71:26, :74:21]
        out_addr = {_RANDOM[3'h1][31:5], _RANDOM[3'h2][4:0]};	// @[generators/baseband/src/main/scala/baseband/Baseband.scala:74:21, :75:21]
        offset = {_RANDOM[3'h2][31:5], _RANDOM[3'h3][4:0]};	// @[generators/baseband/src/main/scala/baseband/Baseband.scala:75:21, :77:23]
        baseAddr = {_RANDOM[3'h3][31:5], _RANDOM[3'h4][4:0]};	// @[generators/baseband/src/main/scala/baseband/Baseband.scala:77:23, :79:21]
      `endif // RANDOMIZE_REG_INIT
    end // initial
    `ifdef FIRRTL_AFTER_INITIAL
      `FIRRTL_AFTER_INITIAL
    `endif // FIRRTL_AFTER_INITIAL
  `endif // ENABLE_INITIAL_REG_
  assign io_in_ready = out_ready;	// @[generators/baseband/src/main/scala/baseband/Baseband.scala:72:26]
  assign io_out_valid = out_valid;	// @[generators/baseband/src/main/scala/baseband/Baseband.scala:71:26]
  assign io_out_bits_addr = out_addr;	// @[generators/baseband/src/main/scala/baseband/Baseband.scala:75:21]
  assign io_out_bits_data = out_data;	// @[generators/baseband/src/main/scala/baseband/Baseband.scala:74:21]
  assign io_out_bits_totalBytes = out_totalBytes;	// @[generators/baseband/src/main/scala/baseband/Baseband.scala:73:27]
endmodule

