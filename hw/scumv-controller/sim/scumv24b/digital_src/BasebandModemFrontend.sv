// Generated by CIRCT unknown git version
// Standard header to adapt well known macros for register randomization.
`ifndef RANDOMIZE
  `ifdef RANDOMIZE_MEM_INIT
    `define RANDOMIZE
  `endif // RANDOMIZE_MEM_INIT
`endif // not def RANDOMIZE
`ifndef RANDOMIZE
  `ifdef RANDOMIZE_REG_INIT
    `define RANDOMIZE
  `endif // RANDOMIZE_REG_INIT
`endif // not def RANDOMIZE

// RANDOM may be set to an expression that produces a 32-bit random unsigned value.
`ifndef RANDOM
  `define RANDOM $random
`endif // not def RANDOM

// Users can define INIT_RANDOM as general code that gets injected into the
// initializer block for modules with registers.
`ifndef INIT_RANDOM
  `define INIT_RANDOM
`endif // not def INIT_RANDOM

// If using random initialization, you can also define RANDOMIZE_DELAY to
// customize the delay used, otherwise 0.002 is used.
`ifndef RANDOMIZE_DELAY
  `define RANDOMIZE_DELAY 0.002
`endif // not def RANDOMIZE_DELAY

// Define INIT_RANDOM_PROLOG_ for use in our modules below.
`ifndef INIT_RANDOM_PROLOG_
  `ifdef RANDOMIZE
    `ifdef VERILATOR
      `define INIT_RANDOM_PROLOG_ `INIT_RANDOM
    `else  // VERILATOR
      `define INIT_RANDOM_PROLOG_ `INIT_RANDOM #`RANDOMIZE_DELAY begin end
    `endif // VERILATOR
  `else  // RANDOMIZE
    `define INIT_RANDOM_PROLOG_
  `endif // RANDOMIZE
`endif // not def INIT_RANDOM_PROLOG_

// Include register initializers in init blocks unless synthesis is set
`ifndef SYNTHESIS
  `ifndef ENABLE_INITIAL_REG_
    `define ENABLE_INITIAL_REG_
  `endif // not def ENABLE_INITIAL_REG_
`endif // not def SYNTHESIS

// Include rmemory initializers in init blocks unless synthesis is set
`ifndef SYNTHESIS
  `ifndef ENABLE_INITIAL_MEM_
    `define ENABLE_INITIAL_MEM_
  `endif // not def ENABLE_INITIAL_MEM_
`endif // not def SYNTHESIS

// Standard header to adapt well known macros for prints and assertions.

// Users can define 'PRINTF_COND' to add an extra gate to prints.
`ifndef PRINTF_COND_
  `ifdef PRINTF_COND
    `define PRINTF_COND_ (`PRINTF_COND)
  `else  // PRINTF_COND
    `define PRINTF_COND_ 1
  `endif // PRINTF_COND
`endif // not def PRINTF_COND_

// Users can define 'ASSERT_VERBOSE_COND' to add an extra gate to assert error printing.
`ifndef ASSERT_VERBOSE_COND_
  `ifdef ASSERT_VERBOSE_COND
    `define ASSERT_VERBOSE_COND_ (`ASSERT_VERBOSE_COND)
  `else  // ASSERT_VERBOSE_COND
    `define ASSERT_VERBOSE_COND_ 1
  `endif // ASSERT_VERBOSE_COND
`endif // not def ASSERT_VERBOSE_COND_

// Users can define 'STOP_COND' to add an extra gate to stop conditions.
`ifndef STOP_COND_
  `ifdef STOP_COND
    `define STOP_COND_ (`STOP_COND)
  `else  // STOP_COND
    `define STOP_COND_ 1
  `endif // STOP_COND
`endif // not def STOP_COND_

module BasebandModemFrontend(
  input         clock,
                reset,
  output        auto_control_xing_in_a_ready,	// @[generators/rocket-chip/src/main/scala/diplomacy/LazyModule.scala:366:18]
  input         auto_control_xing_in_a_valid,	// @[generators/rocket-chip/src/main/scala/diplomacy/LazyModule.scala:366:18]
  input  [2:0]  auto_control_xing_in_a_bits_opcode,	// @[generators/rocket-chip/src/main/scala/diplomacy/LazyModule.scala:366:18]
                auto_control_xing_in_a_bits_param,	// @[generators/rocket-chip/src/main/scala/diplomacy/LazyModule.scala:366:18]
  input  [1:0]  auto_control_xing_in_a_bits_size,	// @[generators/rocket-chip/src/main/scala/diplomacy/LazyModule.scala:366:18]
  input  [15:0] auto_control_xing_in_a_bits_source,	// @[generators/rocket-chip/src/main/scala/diplomacy/LazyModule.scala:366:18]
                auto_control_xing_in_a_bits_address,	// @[generators/rocket-chip/src/main/scala/diplomacy/LazyModule.scala:366:18]
  input  [3:0]  auto_control_xing_in_a_bits_mask,	// @[generators/rocket-chip/src/main/scala/diplomacy/LazyModule.scala:366:18]
  input  [31:0] auto_control_xing_in_a_bits_data,	// @[generators/rocket-chip/src/main/scala/diplomacy/LazyModule.scala:366:18]
  input         auto_control_xing_in_a_bits_corrupt,	// @[generators/rocket-chip/src/main/scala/diplomacy/LazyModule.scala:366:18]
                auto_control_xing_in_d_ready,	// @[generators/rocket-chip/src/main/scala/diplomacy/LazyModule.scala:366:18]
  output        auto_control_xing_in_d_valid,	// @[generators/rocket-chip/src/main/scala/diplomacy/LazyModule.scala:366:18]
  output [2:0]  auto_control_xing_in_d_bits_opcode,	// @[generators/rocket-chip/src/main/scala/diplomacy/LazyModule.scala:366:18]
  output [1:0]  auto_control_xing_in_d_bits_size,	// @[generators/rocket-chip/src/main/scala/diplomacy/LazyModule.scala:366:18]
  output [15:0] auto_control_xing_in_d_bits_source,	// @[generators/rocket-chip/src/main/scala/diplomacy/LazyModule.scala:366:18]
  output [31:0] auto_control_xing_in_d_bits_data,	// @[generators/rocket-chip/src/main/scala/diplomacy/LazyModule.scala:366:18]
  output        auto_int_xing_out_sync_0,	// @[generators/rocket-chip/src/main/scala/diplomacy/LazyModule.scala:366:18]
                auto_int_xing_out_sync_1,	// @[generators/rocket-chip/src/main/scala/diplomacy/LazyModule.scala:366:18]
                auto_int_xing_out_sync_2,	// @[generators/rocket-chip/src/main/scala/diplomacy/LazyModule.scala:366:18]
                auto_int_xing_out_sync_3,	// @[generators/rocket-chip/src/main/scala/diplomacy/LazyModule.scala:366:18]
                auto_int_xing_out_sync_4,	// @[generators/rocket-chip/src/main/scala/diplomacy/LazyModule.scala:366:18]
                auto_int_xing_out_sync_5,	// @[generators/rocket-chip/src/main/scala/diplomacy/LazyModule.scala:366:18]
  input         io_back_cmd_ready,	// @[generators/baseband/src/main/scala/baseband/BasebandModem.scala:112:13]
  output        io_back_cmd_valid,	// @[generators/baseband/src/main/scala/baseband/BasebandModem.scala:112:13]
  output [3:0]  io_back_cmd_bits_inst_primaryInst,	// @[generators/baseband/src/main/scala/baseband/BasebandModem.scala:112:13]
                io_back_cmd_bits_inst_secondaryInst,	// @[generators/baseband/src/main/scala/baseband/BasebandModem.scala:112:13]
  output [23:0] io_back_cmd_bits_inst_data,	// @[generators/baseband/src/main/scala/baseband/BasebandModem.scala:112:13]
  output [31:0] io_back_cmd_bits_additionalData,	// @[generators/baseband/src/main/scala/baseband/BasebandModem.scala:112:13]
  output        io_back_lutCmd_valid,	// @[generators/baseband/src/main/scala/baseband/BasebandModem.scala:112:13]
  output [3:0]  io_back_lutCmd_bits_lut,	// @[generators/baseband/src/main/scala/baseband/BasebandModem.scala:112:13]
  output [5:0]  io_back_lutCmd_bits_address,	// @[generators/baseband/src/main/scala/baseband/BasebandModem.scala:112:13]
  output [21:0] io_back_lutCmd_bits_value,	// @[generators/baseband/src/main/scala/baseband/BasebandModem.scala:112:13]
  output        io_back_firCmd_valid,	// @[generators/baseband/src/main/scala/baseband/BasebandModem.scala:112:13]
  output [3:0]  io_back_firCmd_bits_fir,	// @[generators/baseband/src/main/scala/baseband/BasebandModem.scala:112:13]
  output [5:0]  io_back_firCmd_bits_coeff,	// @[generators/baseband/src/main/scala/baseband/BasebandModem.scala:112:13]
  output [21:0] io_back_firCmd_bits_value,	// @[generators/baseband/src/main/scala/baseband/BasebandModem.scala:112:13]
  input  [31:0] io_back_status_status0,	// @[generators/baseband/src/main/scala/baseband/BasebandModem.scala:112:13]
                io_back_status_status1,	// @[generators/baseband/src/main/scala/baseband/BasebandModem.scala:112:13]
                io_back_status_status2,	// @[generators/baseband/src/main/scala/baseband/BasebandModem.scala:112:13]
                io_back_status_status3,	// @[generators/baseband/src/main/scala/baseband/BasebandModem.scala:112:13]
  input  [63:0] io_back_status_status4,	// @[generators/baseband/src/main/scala/baseband/BasebandModem.scala:112:13]
  input         io_back_interrupt_rxError,	// @[generators/baseband/src/main/scala/baseband/BasebandModem.scala:112:13]
                io_back_interrupt_rxStart,	// @[generators/baseband/src/main/scala/baseband/BasebandModem.scala:112:13]
                io_back_interrupt_rxFinish,	// @[generators/baseband/src/main/scala/baseband/BasebandModem.scala:112:13]
                io_back_interrupt_txError,	// @[generators/baseband/src/main/scala/baseband/BasebandModem.scala:112:13]
                io_back_interrupt_txFinish,	// @[generators/baseband/src/main/scala/baseband/BasebandModem.scala:112:13]
  output        io_back_messages_rxErrorMessage_ready,	// @[generators/baseband/src/main/scala/baseband/BasebandModem.scala:112:13]
  input         io_back_messages_rxErrorMessage_valid,	// @[generators/baseband/src/main/scala/baseband/BasebandModem.scala:112:13]
  input  [31:0] io_back_messages_rxErrorMessage_bits,	// @[generators/baseband/src/main/scala/baseband/BasebandModem.scala:112:13]
  output        io_back_messages_rxFinishMessage_ready,	// @[generators/baseband/src/main/scala/baseband/BasebandModem.scala:112:13]
  input         io_back_messages_rxFinishMessage_valid,	// @[generators/baseband/src/main/scala/baseband/BasebandModem.scala:112:13]
  input  [31:0] io_back_messages_rxFinishMessage_bits,	// @[generators/baseband/src/main/scala/baseband/BasebandModem.scala:112:13]
  output        io_back_messages_txErrorMessage_ready,	// @[generators/baseband/src/main/scala/baseband/BasebandModem.scala:112:13]
  input         io_back_messages_txErrorMessage_valid,	// @[generators/baseband/src/main/scala/baseband/BasebandModem.scala:112:13]
  input  [31:0] io_back_messages_txErrorMessage_bits,	// @[generators/baseband/src/main/scala/baseband/BasebandModem.scala:112:13]
  output [31:0] io_back_ifCounter_input_ifTickThreshold,	// @[generators/baseband/src/main/scala/baseband/BasebandModem.scala:112:13]
  output        io_back_ifCounter_input_control_restartCounter,	// @[generators/baseband/src/main/scala/baseband/BasebandModem.scala:112:13]
  input  [31:0] io_back_ifCounter_output_adcTicks,	// @[generators/baseband/src/main/scala/baseband/BasebandModem.scala:112:13]
                io_back_ifCounter_output_ifTicksPacket,	// @[generators/baseband/src/main/scala/baseband/BasebandModem.scala:112:13]
                io_back_ifCounter_output_adcTicksPacket,	// @[generators/baseband/src/main/scala/baseband/BasebandModem.scala:112:13]
                io_back_ifCounter_output_ifTicksPrevPacket,	// @[generators/baseband/src/main/scala/baseband/BasebandModem.scala:112:13]
                io_back_ifCounter_output_adcTicksPrevPacket,	// @[generators/baseband/src/main/scala/baseband/BasebandModem.scala:112:13]
  input         io_back_ifCounter_output_thresholdInterrupt,	// @[generators/baseband/src/main/scala/baseband/BasebandModem.scala:112:13]
  output        io_back_adcClockTuning_input_restart,	// @[generators/baseband/src/main/scala/baseband/BasebandModem.scala:112:13]
                io_back_adcClockTuning_input_mode,	// @[generators/baseband/src/main/scala/baseband/BasebandModem.scala:112:13]
  output [7:0]  io_back_adcClockTuning_input_duration,	// @[generators/baseband/src/main/scala/baseband/BasebandModem.scala:112:13]
  output [31:0] io_back_adcClockTuning_input_k_p,	// @[generators/baseband/src/main/scala/baseband/BasebandModem.scala:112:13]
                io_back_adcClockTuning_input_k_i,	// @[generators/baseband/src/main/scala/baseband/BasebandModem.scala:112:13]
  output        io_back_adcClockTuning_input_p_control_only,	// @[generators/baseband/src/main/scala/baseband/BasebandModem.scala:112:13]
  output [31:0] io_back_adcClockTuning_input_nominal_adc_clock_freq,	// @[generators/baseband/src/main/scala/baseband/BasebandModem.scala:112:13]
  input  [7:0]  io_back_adcClockTuning_output_control_word,	// @[generators/baseband/src/main/scala/baseband/BasebandModem.scala:112:13]
  input  [1:0]  io_back_adcClockTuning_output_sop_eop_debug,	// @[generators/baseband/src/main/scala/baseband/BasebandModem.scala:112:13]
  input  [31:0] io_back_adcClockTuning_output_curr_calc_adc_clock_freq_debug,	// @[generators/baseband/src/main/scala/baseband/BasebandModem.scala:112:13]
  input  [63:0] io_back_adcClockTuning_output_lo_start_debug,	// @[generators/baseband/src/main/scala/baseband/BasebandModem.scala:112:13]
                io_back_adcClockTuning_output_lo_stop_debug,	// @[generators/baseband/src/main/scala/baseband/BasebandModem.scala:112:13]
  input  [31:0] io_back_adcClockTuning_output_adc_ticks_counter,	// @[generators/baseband/src/main/scala/baseband/BasebandModem.scala:112:13]
                io_back_adcClockTuning_output_f_err,	// @[generators/baseband/src/main/scala/baseband/BasebandModem.scala:112:13]
                io_back_adcClockTuning_output_accumulated_err,	// @[generators/baseband/src/main/scala/baseband/BasebandModem.scala:112:13]
  input         io_back_adcClockTuning_output_controller_active,	// @[generators/baseband/src/main/scala/baseband/BasebandModem.scala:112:13]
                io_back_adcClockTuning_output_trigger_controller,	// @[generators/baseband/src/main/scala/baseband/BasebandModem.scala:112:13]
  input  [9:0]  io_back_adcClockTuning_output_p_term_trunc,	// @[generators/baseband/src/main/scala/baseband/BasebandModem.scala:112:13]
                io_back_adcClockTuning_output_i_term_trunc,	// @[generators/baseband/src/main/scala/baseband/BasebandModem.scala:112:13]
  input         io_back_adcClockTuning_output_controller_state,	// @[generators/baseband/src/main/scala/baseband/BasebandModem.scala:112:13]
  output [7:0]  io_tuning_trim_g0,	// @[generators/baseband/src/main/scala/baseband/BasebandModem.scala:112:13]
  input  [7:0]  io_tuning_trim_g1,	// @[generators/baseband/src/main/scala/baseband/BasebandModem.scala:112:13]
  output [7:0]  io_tuning_trim_g2,	// @[generators/baseband/src/main/scala/baseband/BasebandModem.scala:112:13]
  output [9:0]  io_tuning_i_vga_gain_ctrl,	// @[generators/baseband/src/main/scala/baseband/BasebandModem.scala:112:13]
  output [3:0]  io_tuning_i_bpf_chp_0,	// @[generators/baseband/src/main/scala/baseband/BasebandModem.scala:112:13]
                io_tuning_i_bpf_chp_1,	// @[generators/baseband/src/main/scala/baseband/BasebandModem.scala:112:13]
                io_tuning_i_bpf_chp_2,	// @[generators/baseband/src/main/scala/baseband/BasebandModem.scala:112:13]
                io_tuning_i_bpf_chp_3,	// @[generators/baseband/src/main/scala/baseband/BasebandModem.scala:112:13]
                io_tuning_i_bpf_chp_4,	// @[generators/baseband/src/main/scala/baseband/BasebandModem.scala:112:13]
                io_tuning_i_bpf_chp_5,	// @[generators/baseband/src/main/scala/baseband/BasebandModem.scala:112:13]
                io_tuning_i_bpf_clp_0,	// @[generators/baseband/src/main/scala/baseband/BasebandModem.scala:112:13]
                io_tuning_i_bpf_clp_1,	// @[generators/baseband/src/main/scala/baseband/BasebandModem.scala:112:13]
                io_tuning_i_bpf_clp_2,	// @[generators/baseband/src/main/scala/baseband/BasebandModem.scala:112:13]
  output [9:0]  io_tuning_q_vga_gain_ctrl,	// @[generators/baseband/src/main/scala/baseband/BasebandModem.scala:112:13]
  output [3:0]  io_tuning_q_bpf_chp_0,	// @[generators/baseband/src/main/scala/baseband/BasebandModem.scala:112:13]
                io_tuning_q_bpf_chp_1,	// @[generators/baseband/src/main/scala/baseband/BasebandModem.scala:112:13]
                io_tuning_q_bpf_chp_2,	// @[generators/baseband/src/main/scala/baseband/BasebandModem.scala:112:13]
                io_tuning_q_bpf_chp_3,	// @[generators/baseband/src/main/scala/baseband/BasebandModem.scala:112:13]
                io_tuning_q_bpf_chp_4,	// @[generators/baseband/src/main/scala/baseband/BasebandModem.scala:112:13]
                io_tuning_q_bpf_chp_5,	// @[generators/baseband/src/main/scala/baseband/BasebandModem.scala:112:13]
                io_tuning_q_bpf_clp_0,	// @[generators/baseband/src/main/scala/baseband/BasebandModem.scala:112:13]
                io_tuning_q_bpf_clp_1,	// @[generators/baseband/src/main/scala/baseband/BasebandModem.scala:112:13]
                io_tuning_q_bpf_clp_2,	// @[generators/baseband/src/main/scala/baseband/BasebandModem.scala:112:13]
  output [5:0]  io_tuning_current_dac_i_vga_s2,	// @[generators/baseband/src/main/scala/baseband/BasebandModem.scala:112:13]
                io_tuning_current_dac_q_vga_s2,	// @[generators/baseband/src/main/scala/baseband/BasebandModem.scala:112:13]
                io_tuning_current_dac_vco,	// @[generators/baseband/src/main/scala/baseband/BasebandModem.scala:112:13]
  output        io_tuning_enable_i_mix,	// @[generators/baseband/src/main/scala/baseband/BasebandModem.scala:112:13]
                io_tuning_enable_i_buf,	// @[generators/baseband/src/main/scala/baseband/BasebandModem.scala:112:13]
                io_tuning_enable_i_tia,	// @[generators/baseband/src/main/scala/baseband/BasebandModem.scala:112:13]
                io_tuning_enable_i_vga,	// @[generators/baseband/src/main/scala/baseband/BasebandModem.scala:112:13]
                io_tuning_enable_i_bpf,	// @[generators/baseband/src/main/scala/baseband/BasebandModem.scala:112:13]
                io_tuning_enable_q_mix,	// @[generators/baseband/src/main/scala/baseband/BasebandModem.scala:112:13]
                io_tuning_enable_q_buf,	// @[generators/baseband/src/main/scala/baseband/BasebandModem.scala:112:13]
                io_tuning_enable_q_tia,	// @[generators/baseband/src/main/scala/baseband/BasebandModem.scala:112:13]
                io_tuning_enable_q_vga,	// @[generators/baseband/src/main/scala/baseband/BasebandModem.scala:112:13]
                io_tuning_enable_q_bpf,	// @[generators/baseband/src/main/scala/baseband/BasebandModem.scala:112:13]
                io_tuning_enable_rx1,	// @[generators/baseband/src/main/scala/baseband/BasebandModem.scala:112:13]
                io_tuning_enable_rx2,	// @[generators/baseband/src/main/scala/baseband/BasebandModem.scala:112:13]
                io_tuning_enable_vco_lo,	// @[generators/baseband/src/main/scala/baseband/BasebandModem.scala:112:13]
                io_tuning_enable_ext_lo,	// @[generators/baseband/src/main/scala/baseband/BasebandModem.scala:112:13]
  output [9:0]  io_tuning_mux_dbg_in,	// @[generators/baseband/src/main/scala/baseband/BasebandModem.scala:112:13]
                io_tuning_mux_dbg_out,	// @[generators/baseband/src/main/scala/baseband/BasebandModem.scala:112:13]
  output [8:0]  io_tuning_adc_clk_tuning,	// @[generators/baseband/src/main/scala/baseband/BasebandModem.scala:112:13]
  output [7:0]  io_tuningControl_i_AGC_control_sampleWindow,	// @[generators/baseband/src/main/scala/baseband/BasebandModem.scala:112:13]
                io_tuningControl_i_AGC_control_idealPeakToPeak,	// @[generators/baseband/src/main/scala/baseband/BasebandModem.scala:112:13]
                io_tuningControl_i_AGC_control_toleranceP2P,	// @[generators/baseband/src/main/scala/baseband/BasebandModem.scala:112:13]
                io_tuningControl_i_AGC_control_gainInc,	// @[generators/baseband/src/main/scala/baseband/BasebandModem.scala:112:13]
                io_tuningControl_i_AGC_control_gainDec,	// @[generators/baseband/src/main/scala/baseband/BasebandModem.scala:112:13]
  output        io_tuningControl_i_AGC_control_reset,	// @[generators/baseband/src/main/scala/baseband/BasebandModem.scala:112:13]
                io_tuningControl_i_AGC_useAGC,	// @[generators/baseband/src/main/scala/baseband/BasebandModem.scala:112:13]
  output [8:0]  io_tuningControl_i_DCO_control_gain,	// @[generators/baseband/src/main/scala/baseband/BasebandModem.scala:112:13]
  output        io_tuningControl_i_DCO_control_reset,	// @[generators/baseband/src/main/scala/baseband/BasebandModem.scala:112:13]
                io_tuningControl_i_DCO_useDCO,	// @[generators/baseband/src/main/scala/baseband/BasebandModem.scala:112:13]
  output [7:0]  io_tuningControl_q_AGC_control_sampleWindow,	// @[generators/baseband/src/main/scala/baseband/BasebandModem.scala:112:13]
                io_tuningControl_q_AGC_control_idealPeakToPeak,	// @[generators/baseband/src/main/scala/baseband/BasebandModem.scala:112:13]
                io_tuningControl_q_AGC_control_toleranceP2P,	// @[generators/baseband/src/main/scala/baseband/BasebandModem.scala:112:13]
                io_tuningControl_q_AGC_control_gainInc,	// @[generators/baseband/src/main/scala/baseband/BasebandModem.scala:112:13]
                io_tuningControl_q_AGC_control_gainDec,	// @[generators/baseband/src/main/scala/baseband/BasebandModem.scala:112:13]
  output        io_tuningControl_q_AGC_control_reset,	// @[generators/baseband/src/main/scala/baseband/BasebandModem.scala:112:13]
                io_tuningControl_q_AGC_useAGC,	// @[generators/baseband/src/main/scala/baseband/BasebandModem.scala:112:13]
  output [8:0]  io_tuningControl_q_DCO_control_gain,	// @[generators/baseband/src/main/scala/baseband/BasebandModem.scala:112:13]
  output        io_tuningControl_q_DCO_control_reset,	// @[generators/baseband/src/main/scala/baseband/BasebandModem.scala:112:13]
                io_tuningControl_q_DCO_useDCO,	// @[generators/baseband/src/main/scala/baseband/BasebandModem.scala:112:13]
                io_tuningControl_debug_enabled	// @[generators/baseband/src/main/scala/baseband/BasebandModem.scala:112:13]
);

  wire              _out_wofireMux_T_2;	// @[generators/rocket-chip/src/main/scala/tilelink/RegisterRouter.scala:82:24]
  wire              _out_rofireMux_T_1;	// @[generators/rocket-chip/src/main/scala/tilelink/RegisterRouter.scala:82:24]
  wire              out_backSel_24;	// @[generators/rocket-chip/src/main/scala/tilelink/RegisterRouter.scala:82:24]
  wire              out_backSel_23;	// @[generators/rocket-chip/src/main/scala/tilelink/RegisterRouter.scala:82:24]
  wire              out_backSel_22;	// @[generators/rocket-chip/src/main/scala/tilelink/RegisterRouter.scala:82:24]
  wire              out_backSel_21;	// @[generators/rocket-chip/src/main/scala/tilelink/RegisterRouter.scala:82:24]
  wire              out_backSel_20;	// @[generators/rocket-chip/src/main/scala/tilelink/RegisterRouter.scala:82:24]
  wire              out_backSel_0;	// @[generators/rocket-chip/src/main/scala/tilelink/RegisterRouter.scala:82:24]
  reg  [31:0]       additionalData;	// @[generators/baseband/src/main/scala/baseband/BasebandModem.scala:124:27]
  reg  [7:0]        trim_g0;	// @[generators/baseband/src/main/scala/baseband/BasebandModem.scala:152:24]
  reg  [7:0]        trim_g1;	// @[generators/baseband/src/main/scala/baseband/BasebandModem.scala:153:24]
  reg  [7:0]        trim_g2;	// @[generators/baseband/src/main/scala/baseband/BasebandModem.scala:154:24]
  reg               debug_enable;	// @[generators/baseband/src/main/scala/baseband/BasebandModem.scala:161:29]
  reg  [9:0]        i_vga_gain_ctrl;	// @[generators/baseband/src/main/scala/baseband/BasebandModem.scala:163:32]
  reg               i_vgaAtten_reset;	// @[generators/baseband/src/main/scala/baseband/BasebandModem.scala:164:33]
  reg               i_vgaAtten_useAGC;	// @[generators/baseband/src/main/scala/baseband/BasebandModem.scala:165:34]
  reg  [7:0]        i_vgaAtten_sampleWindow;	// @[generators/baseband/src/main/scala/baseband/BasebandModem.scala:168:40]
  reg  [7:0]        i_vgaAtten_idealPeakToPeak;	// @[generators/baseband/src/main/scala/baseband/BasebandModem.scala:169:43]
  reg  [7:0]        i_vgaAtten_toleranceP2P;	// @[generators/baseband/src/main/scala/baseband/BasebandModem.scala:170:40]
  reg  [7:0]        i_vgaAtten_gainInc;	// @[generators/baseband/src/main/scala/baseband/BasebandModem.scala:171:35]
  reg  [7:0]        i_vgaAtten_gainDec;	// @[generators/baseband/src/main/scala/baseband/BasebandModem.scala:172:35]
  reg  [3:0]        i_bpf_chp_0;	// @[generators/baseband/src/main/scala/baseband/BasebandModem.scala:175:28]
  reg  [3:0]        i_bpf_chp_1;	// @[generators/baseband/src/main/scala/baseband/BasebandModem.scala:176:28]
  reg  [3:0]        i_bpf_chp_2;	// @[generators/baseband/src/main/scala/baseband/BasebandModem.scala:177:28]
  reg  [3:0]        i_bpf_chp_3;	// @[generators/baseband/src/main/scala/baseband/BasebandModem.scala:178:28]
  reg  [3:0]        i_bpf_chp_4;	// @[generators/baseband/src/main/scala/baseband/BasebandModem.scala:179:28]
  reg  [3:0]        i_bpf_chp_5;	// @[generators/baseband/src/main/scala/baseband/BasebandModem.scala:180:28]
  reg  [3:0]        i_bpf_clp_0;	// @[generators/baseband/src/main/scala/baseband/BasebandModem.scala:181:28]
  reg  [3:0]        i_bpf_clp_1;	// @[generators/baseband/src/main/scala/baseband/BasebandModem.scala:182:28]
  reg  [3:0]        i_bpf_clp_2;	// @[generators/baseband/src/main/scala/baseband/BasebandModem.scala:183:28]
  reg  [9:0]        q_vga_gain_ctrl;	// @[generators/baseband/src/main/scala/baseband/BasebandModem.scala:185:32]
  reg               q_vgaAtten_reset;	// @[generators/baseband/src/main/scala/baseband/BasebandModem.scala:186:33]
  reg               q_vgaAtten_useAGC;	// @[generators/baseband/src/main/scala/baseband/BasebandModem.scala:187:34]
  reg  [7:0]        q_vgaAtten_sampleWindow;	// @[generators/baseband/src/main/scala/baseband/BasebandModem.scala:190:40]
  reg  [7:0]        q_vgaAtten_idealPeakToPeak;	// @[generators/baseband/src/main/scala/baseband/BasebandModem.scala:191:43]
  reg  [7:0]        q_vgaAtten_toleranceP2P;	// @[generators/baseband/src/main/scala/baseband/BasebandModem.scala:192:40]
  reg  [7:0]        q_vgaAtten_gainInc;	// @[generators/baseband/src/main/scala/baseband/BasebandModem.scala:193:35]
  reg  [7:0]        q_vgaAtten_gainDec;	// @[generators/baseband/src/main/scala/baseband/BasebandModem.scala:194:35]
  reg  [3:0]        q_bpf_chp_0;	// @[generators/baseband/src/main/scala/baseband/BasebandModem.scala:197:28]
  reg  [3:0]        q_bpf_chp_1;	// @[generators/baseband/src/main/scala/baseband/BasebandModem.scala:198:28]
  reg  [3:0]        q_bpf_chp_2;	// @[generators/baseband/src/main/scala/baseband/BasebandModem.scala:199:28]
  reg  [3:0]        q_bpf_chp_3;	// @[generators/baseband/src/main/scala/baseband/BasebandModem.scala:200:28]
  reg  [3:0]        q_bpf_chp_4;	// @[generators/baseband/src/main/scala/baseband/BasebandModem.scala:201:28]
  reg  [3:0]        q_bpf_chp_5;	// @[generators/baseband/src/main/scala/baseband/BasebandModem.scala:202:28]
  reg  [3:0]        q_bpf_clp_0;	// @[generators/baseband/src/main/scala/baseband/BasebandModem.scala:203:28]
  reg  [3:0]        q_bpf_clp_1;	// @[generators/baseband/src/main/scala/baseband/BasebandModem.scala:204:28]
  reg  [3:0]        q_bpf_clp_2;	// @[generators/baseband/src/main/scala/baseband/BasebandModem.scala:205:28]
  reg               i_DCO_useDCO;	// @[generators/baseband/src/main/scala/baseband/BasebandModem.scala:207:29]
  reg               i_DCO_reset;	// @[generators/baseband/src/main/scala/baseband/BasebandModem.scala:208:28]
  reg  [7:0]        i_DCO_gain;	// @[generators/baseband/src/main/scala/baseband/BasebandModem.scala:209:27]
  reg               q_DCO_useDCO;	// @[generators/baseband/src/main/scala/baseband/BasebandModem.scala:211:29]
  reg               q_DCO_reset;	// @[generators/baseband/src/main/scala/baseband/BasebandModem.scala:212:28]
  reg  [7:0]        q_DCO_gain;	// @[generators/baseband/src/main/scala/baseband/BasebandModem.scala:213:27]
  reg  [5:0]        i_current_dac_vga_s2;	// @[generators/baseband/src/main/scala/baseband/BasebandModem.scala:216:37]
  reg  [5:0]        q_current_dac_vga_s2;	// @[generators/baseband/src/main/scala/baseband/BasebandModem.scala:217:37]
  reg  [5:0]        current_dac_vco;	// @[generators/baseband/src/main/scala/baseband/BasebandModem.scala:220:32]
  reg  [9:0]        mux_dbg_in;	// @[generators/baseband/src/main/scala/baseband/BasebandModem.scala:222:27]
  reg  [9:0]        mux_dbg_out;	// @[generators/baseband/src/main/scala/baseband/BasebandModem.scala:223:28]
  reg               enable_i_mix;	// @[generators/baseband/src/main/scala/baseband/BasebandModem.scala:227:29]
  reg               enable_i_buf;	// @[generators/baseband/src/main/scala/baseband/BasebandModem.scala:228:29]
  reg               enable_i_tia;	// @[generators/baseband/src/main/scala/baseband/BasebandModem.scala:229:29]
  reg               enable_i_vga;	// @[generators/baseband/src/main/scala/baseband/BasebandModem.scala:230:29]
  reg               enable_i_bpf;	// @[generators/baseband/src/main/scala/baseband/BasebandModem.scala:231:29]
  reg               enable_q_mix;	// @[generators/baseband/src/main/scala/baseband/BasebandModem.scala:233:29]
  reg               enable_q_buf;	// @[generators/baseband/src/main/scala/baseband/BasebandModem.scala:234:29]
  reg               enable_q_tia;	// @[generators/baseband/src/main/scala/baseband/BasebandModem.scala:235:29]
  reg               enable_q_vga;	// @[generators/baseband/src/main/scala/baseband/BasebandModem.scala:236:29]
  reg               enable_q_bpf;	// @[generators/baseband/src/main/scala/baseband/BasebandModem.scala:237:29]
  reg               enable_rx1;	// @[generators/baseband/src/main/scala/baseband/BasebandModem.scala:239:27]
  reg               enable_rx2;	// @[generators/baseband/src/main/scala/baseband/BasebandModem.scala:240:27]
  reg               enable_vco_lo;	// @[generators/baseband/src/main/scala/baseband/BasebandModem.scala:241:30]
  reg               enable_ext_lo;	// @[generators/baseband/src/main/scala/baseband/BasebandModem.scala:242:30]
  reg  [31:0]       ifCounter_ifTickThreshold;	// @[generators/baseband/src/main/scala/baseband/BasebandModem.scala:248:42]
  reg               ifCounter_control_restartCounter;	// @[generators/baseband/src/main/scala/baseband/BasebandModem.scala:249:49]
  reg               adcClockTuning_restart;	// @[generators/baseband/src/main/scala/baseband/BasebandModem.scala:254:39]
  reg               adcClockTuning_mode;	// @[generators/baseband/src/main/scala/baseband/BasebandModem.scala:255:36]
  reg  [7:0]        adcClockTuning_duration;	// @[generators/baseband/src/main/scala/baseband/BasebandModem.scala:256:40]
  reg  [31:0]       adcClockTuning_k_p;	// @[generators/baseband/src/main/scala/baseband/BasebandModem.scala:257:35]
  reg  [31:0]       adcClockTuning_k_i;	// @[generators/baseband/src/main/scala/baseband/BasebandModem.scala:258:35]
  reg               adcClockTuning_p_control_only;	// @[generators/baseband/src/main/scala/baseband/BasebandModem.scala:263:46]
  reg  [31:0]       adcClockTuning_nominal_adc_clock_freq;	// @[generators/baseband/src/main/scala/baseband/BasebandModem.scala:264:54]
  wire              out_front_bits_read = auto_control_xing_in_a_bits_opcode == 3'h4;	// @[generators/rocket-chip/src/main/scala/tilelink/RegisterRouter.scala:69:36]
  wire [7:0]        _out_backMask_T_5 = {8{auto_control_xing_in_a_bits_mask[0]}};	// @[generators/rocket-chip/src/main/scala/tilelink/RegisterRouter.scala:82:24]
  wire [7:0]        _out_backMask_T_9 = {8{auto_control_xing_in_a_bits_mask[2]}};	// @[generators/rocket-chip/src/main/scala/tilelink/RegisterRouter.scala:82:24]
  wire [31:0]       out_backMask = {{8{auto_control_xing_in_a_bits_mask[3]}}, _out_backMask_T_9, {8{auto_control_xing_in_a_bits_mask[1]}}, _out_backMask_T_5};	// @[generators/rocket-chip/src/main/scala/tilelink/RegisterRouter.scala:82:24]
  assign out_backSel_0 = auto_control_xing_in_a_bits_address[7:2] == 6'h0;	// @[generators/baseband/src/main/scala/baseband/BasebandModem.scala:216:37, generators/rocket-chip/src/main/scala/tilelink/RegisterRouter.scala:82:24]
  assign out_backSel_20 = auto_control_xing_in_a_bits_address[7:2] == 6'h14;	// @[generators/rocket-chip/src/main/scala/tilelink/RegisterRouter.scala:82:24, src/main/scala/chisel3/util/OneHot.scala:58:35]
  assign out_backSel_21 = auto_control_xing_in_a_bits_address[7:2] == 6'h15;	// @[generators/rocket-chip/src/main/scala/tilelink/RegisterRouter.scala:82:24, src/main/scala/chisel3/util/OneHot.scala:58:35]
  assign out_backSel_22 = auto_control_xing_in_a_bits_address[7:2] == 6'h16;	// @[generators/rocket-chip/src/main/scala/tilelink/RegisterRouter.scala:82:24, src/main/scala/chisel3/util/OneHot.scala:58:35]
  assign out_backSel_23 = auto_control_xing_in_a_bits_address[7:2] == 6'h17;	// @[generators/rocket-chip/src/main/scala/tilelink/RegisterRouter.scala:82:24, src/main/scala/chisel3/util/OneHot.scala:58:35]
  assign out_backSel_24 = auto_control_xing_in_a_bits_address[7:2] == 6'h18;	// @[generators/rocket-chip/src/main/scala/tilelink/RegisterRouter.scala:82:24, src/main/scala/chisel3/util/OneHot.scala:58:35]
  wire              _out_wofireMux_T = auto_control_xing_in_a_valid & auto_control_xing_in_d_ready;	// @[generators/rocket-chip/src/main/scala/tilelink/RegisterRouter.scala:82:24]
  assign _out_rofireMux_T_1 = _out_wofireMux_T & out_front_bits_read;	// @[generators/rocket-chip/src/main/scala/tilelink/RegisterRouter.scala:69:36, :82:24]
  wire [63:0]       _GEN = {{1'h1}, {1'h1}, {1'h1}, {1'h1}, {1'h1}, {1'h1}, {1'h1}, {1'h1}, {1'h1}, {1'h1}, {1'h1}, {1'h1}, {1'h1}, {1'h1}, {1'h1}, {1'h1}, {1'h1}, {1'h1}, {1'h1}, {1'h1}, {1'h1}, {1'h1}, {1'h1}, {1'h1}, {1'h1}, {1'h1}, {1'h1}, {1'h1}, {1'h1}, {1'h1}, {1'h1}, {1'h1}, {1'h1}, {1'h1}, {1'h1}, {1'h1}, {1'h1}, {1'h1}, {1'h1}, {1'h1}, {io_back_messages_txErrorMessage_valid | ~(|out_backMask) | (|(auto_control_xing_in_a_bits_address[11:8]))}, {io_back_messages_rxFinishMessage_valid | ~(|out_backMask) | (|(auto_control_xing_in_a_bits_address[11:8]))}, {io_back_messages_rxErrorMessage_valid | ~(|out_backMask) | (|(auto_control_xing_in_a_bits_address[11:8]))}, {1'h1}, {1'h1}, {1'h1}, {1'h1}, {1'h1}, {1'h1}, {1'h1}, {1'h1}, {1'h1}, {1'h1}, {1'h1}, {1'h1}, {1'h1}, {1'h1}, {1'h1}, {1'h1}, {1'h1}, {1'h1}, {1'h1}, {1'h1}, {1'h1}};	// @[generators/rocket-chip/src/main/scala/tilelink/Buffer.scala:47:20, generators/rocket-chip/src/main/scala/tilelink/Edges.scala:192:34, generators/rocket-chip/src/main/scala/tilelink/RegisterRouter.scala:70:19, :82:24, generators/rocket-chip/src/main/scala/util/MuxLiteral.scala:49:10]
  assign _out_wofireMux_T_2 = _out_wofireMux_T & ~out_front_bits_read;	// @[generators/rocket-chip/src/main/scala/tilelink/RegisterRouter.scala:69:36, :82:24]
  wire              out_woready_37 = _out_wofireMux_T_2 & auto_control_xing_in_a_bits_address[7:2] == 6'h8 & ~(|(auto_control_xing_in_a_bits_address[11:8]));	// @[generators/rocket-chip/src/main/scala/tilelink/Edges.scala:192:34, generators/rocket-chip/src/main/scala/tilelink/RegisterRouter.scala:70:19, :82:24, src/main/scala/chisel3/util/OneHot.scala:58:35]
  wire              out_woready_18 = _out_wofireMux_T_2 & auto_control_xing_in_a_bits_address[7:2] == 6'h9 & ~(|(auto_control_xing_in_a_bits_address[11:8]));	// @[generators/rocket-chip/src/main/scala/tilelink/Edges.scala:192:34, generators/rocket-chip/src/main/scala/tilelink/RegisterRouter.scala:70:19, :82:24, src/main/scala/chisel3/util/OneHot.scala:58:35]
  wire              out_woready_6 = _out_wofireMux_T_2 & auto_control_xing_in_a_bits_address[7:2] == 6'hA & ~(|(auto_control_xing_in_a_bits_address[11:8]));	// @[generators/rocket-chip/src/main/scala/tilelink/Edges.scala:192:34, generators/rocket-chip/src/main/scala/tilelink/RegisterRouter.scala:70:19, :82:24, src/main/scala/chisel3/util/OneHot.scala:58:35]
  wire              out_woready_88 = _out_wofireMux_T_2 & auto_control_xing_in_a_bits_address[7:2] == 6'hB & ~(|(auto_control_xing_in_a_bits_address[11:8]));	// @[generators/rocket-chip/src/main/scala/tilelink/Edges.scala:192:34, generators/rocket-chip/src/main/scala/tilelink/RegisterRouter.scala:70:19, :82:24, src/main/scala/chisel3/util/OneHot.scala:58:35]
  wire              out_woready_22 = _out_wofireMux_T_2 & auto_control_xing_in_a_bits_address[7:2] == 6'hC & ~(|(auto_control_xing_in_a_bits_address[11:8]));	// @[generators/rocket-chip/src/main/scala/tilelink/Edges.scala:192:34, generators/rocket-chip/src/main/scala/tilelink/RegisterRouter.scala:70:19, :82:24, src/main/scala/chisel3/util/OneHot.scala:58:35]
  wire              out_woready_60 = _out_wofireMux_T_2 & auto_control_xing_in_a_bits_address[7:2] == 6'hD & ~(|(auto_control_xing_in_a_bits_address[11:8]));	// @[generators/rocket-chip/src/main/scala/tilelink/Edges.scala:192:34, generators/rocket-chip/src/main/scala/tilelink/RegisterRouter.scala:70:19, :82:24, src/main/scala/chisel3/util/OneHot.scala:58:35]
  wire              out_woready_13 = _out_wofireMux_T_2 & auto_control_xing_in_a_bits_address[7:2] == 6'hE & ~(|(auto_control_xing_in_a_bits_address[11:8]));	// @[generators/rocket-chip/src/main/scala/tilelink/Edges.scala:192:34, generators/rocket-chip/src/main/scala/tilelink/RegisterRouter.scala:70:19, :82:24, src/main/scala/chisel3/util/OneHot.scala:58:35]
  wire              out_woready_104 = _out_wofireMux_T_2 & auto_control_xing_in_a_bits_address[7:2] == 6'hF & ~(|(auto_control_xing_in_a_bits_address[11:8]));	// @[generators/rocket-chip/src/main/scala/tilelink/Edges.scala:192:34, generators/rocket-chip/src/main/scala/tilelink/RegisterRouter.scala:70:19, :82:24, src/main/scala/chisel3/util/OneHot.scala:58:35]
  wire              out_woready_80 = _out_wofireMux_T_2 & auto_control_xing_in_a_bits_address[7:2] == 6'h10 & ~(|(auto_control_xing_in_a_bits_address[11:8]));	// @[generators/rocket-chip/src/main/scala/tilelink/Edges.scala:192:34, generators/rocket-chip/src/main/scala/tilelink/RegisterRouter.scala:70:19, :82:24, src/main/scala/chisel3/util/OneHot.scala:58:35]
  wire              out_woready_64 = _out_wofireMux_T_2 & auto_control_xing_in_a_bits_address[7:2] == 6'h11 & ~(|(auto_control_xing_in_a_bits_address[11:8]));	// @[generators/rocket-chip/src/main/scala/tilelink/Edges.scala:192:34, generators/rocket-chip/src/main/scala/tilelink/RegisterRouter.scala:70:19, :82:24, src/main/scala/chisel3/util/OneHot.scala:58:35]
  wire              out_woready_33 = _out_wofireMux_T_2 & auto_control_xing_in_a_bits_address[7:2] == 6'h12 & ~(|(auto_control_xing_in_a_bits_address[11:8]));	// @[generators/rocket-chip/src/main/scala/tilelink/Edges.scala:192:34, generators/rocket-chip/src/main/scala/tilelink/RegisterRouter.scala:70:19, :82:24, src/main/scala/chisel3/util/OneHot.scala:58:35]
  wire              out_woready_98 = _out_wofireMux_T_2 & auto_control_xing_in_a_bits_address[7:2] == 6'h13 & ~(|(auto_control_xing_in_a_bits_address[11:8]));	// @[generators/rocket-chip/src/main/scala/tilelink/Edges.scala:192:34, generators/rocket-chip/src/main/scala/tilelink/RegisterRouter.scala:70:19, :82:24, src/main/scala/chisel3/util/OneHot.scala:58:35]
  wire              out_woready_46 = _out_wofireMux_T_2 & auto_control_xing_in_a_bits_address[7:2] == 6'h19 & ~(|(auto_control_xing_in_a_bits_address[11:8]));	// @[generators/rocket-chip/src/main/scala/tilelink/Edges.scala:192:34, generators/rocket-chip/src/main/scala/tilelink/RegisterRouter.scala:70:19, :82:24, src/main/scala/chisel3/util/OneHot.scala:58:35]
  wire              out_woready_68 = _out_wofireMux_T_2 & auto_control_xing_in_a_bits_address[7:2] == 6'h20 & ~(|(auto_control_xing_in_a_bits_address[11:8]));	// @[generators/rocket-chip/src/main/scala/tilelink/Edges.scala:192:34, generators/rocket-chip/src/main/scala/tilelink/RegisterRouter.scala:70:19, :82:24, src/main/scala/chisel3/util/OneHot.scala:58:35]
  wire [63:0]       _GEN_0 = {{1'h1}, {1'h1}, {1'h1}, {1'h1}, {1'h1}, {1'h1}, {1'h1}, {1'h1}, {1'h1}, {1'h1}, {1'h1}, {1'h1}, {1'h1}, {1'h1}, {1'h1}, {1'h1}, {1'h1}, {1'h1}, {1'h1}, {1'h1}, {1'h1}, {1'h1}, {1'h1}, {1'h1}, {1'h1}, {1'h1}, {1'h1}, {1'h1}, {1'h1}, {1'h1}, {1'h1}, {1'h1}, {1'h1}, {1'h1}, {1'h1}, {1'h1}, {1'h1}, {1'h1}, {1'h1}, {1'h1}, {1'h1}, {1'h1}, {1'h1}, {1'h1}, {1'h1}, {1'h1}, {1'h1}, {1'h1}, {1'h1}, {1'h1}, {1'h1}, {1'h1}, {1'h1}, {1'h1}, {1'h1}, {1'h1}, {1'h1}, {1'h1}, {1'h1}, {1'h1}, {1'h1}, {1'h1}, {1'h1}, {io_back_cmd_ready | ~(&out_backMask) | (|(auto_control_xing_in_a_bits_address[11:8]))}};	// @[generators/rocket-chip/src/main/scala/tilelink/Buffer.scala:47:20, generators/rocket-chip/src/main/scala/tilelink/Edges.scala:192:34, generators/rocket-chip/src/main/scala/tilelink/RegisterRouter.scala:70:19, :82:24, generators/rocket-chip/src/main/scala/util/MuxLiteral.scala:49:10]
  wire              out_oready = out_front_bits_read ? _GEN[auto_control_xing_in_a_bits_address[7:2]] : _GEN_0[auto_control_xing_in_a_bits_address[7:2]];	// @[generators/rocket-chip/src/main/scala/tilelink/RegisterRouter.scala:69:36, :82:24, generators/rocket-chip/src/main/scala/util/MuxLiteral.scala:49:10]
  wire              out_front_ready = auto_control_xing_in_d_ready & out_oready;	// @[generators/rocket-chip/src/main/scala/tilelink/RegisterRouter.scala:82:24]
  wire              out_valid = auto_control_xing_in_a_valid & out_oready;	// @[generators/rocket-chip/src/main/scala/tilelink/RegisterRouter.scala:82:24]
  wire [63:0]       _GEN_1 =
    {{1'h1},
     {1'h1},
     {1'h1},
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     {1'h1},
     {~(|(auto_control_xing_in_a_bits_address[11:8]))},
     {~(|(auto_control_xing_in_a_bits_address[11:8]))},
     {~(|(auto_control_xing_in_a_bits_address[11:8]))},
     {~(|(auto_control_xing_in_a_bits_address[11:8]))},
     {~(|(auto_control_xing_in_a_bits_address[11:8]))},
     {~(|(auto_control_xing_in_a_bits_address[11:8]))},
     {~(|(auto_control_xing_in_a_bits_address[11:8]))},
     {~(|(auto_control_xing_in_a_bits_address[11:8]))},
     {~(|(auto_control_xing_in_a_bits_address[11:8]))},
     {~(|(auto_control_xing_in_a_bits_address[11:8]))},
     {~(|(auto_control_xing_in_a_bits_address[11:8]))},
     {~(|(auto_control_xing_in_a_bits_address[11:8]))},
     {~(|(auto_control_xing_in_a_bits_address[11:8]))},
     {~(|(auto_control_xing_in_a_bits_address[11:8]))},
     {~(|(auto_control_xing_in_a_bits_address[11:8]))},
     {~(|(auto_control_xing_in_a_bits_address[11:8]))},
     {~(|(auto_control_xing_in_a_bits_address[11:8]))},
     {~(|(auto_control_xing_in_a_bits_address[11:8]))},
     {~(|(auto_control_xing_in_a_bits_address[11:8]))},
     {~(|(auto_control_xing_in_a_bits_address[11:8]))},
     {~(|(auto_control_xing_in_a_bits_address[11:8]))},
     {~(|(auto_control_xing_in_a_bits_address[11:8]))},
     {~(|(auto_control_xing_in_a_bits_address[11:8]))},
     {~(|(auto_control_xing_in_a_bits_address[11:8]))},
     {~(|(auto_control_xing_in_a_bits_address[11:8]))},
     {~(|(auto_control_xing_in_a_bits_address[11:8]))},
     {~(|(auto_control_xing_in_a_bits_address[11:8]))},
     {~(|(auto_control_xing_in_a_bits_address[11:8]))},
     {~(|(auto_control_xing_in_a_bits_address[11:8]))},
     {~(|(auto_control_xing_in_a_bits_address[11:8]))},
     {~(|(auto_control_xing_in_a_bits_address[11:8]))},
     {~(|(auto_control_xing_in_a_bits_address[11:8]))},
     {~(|(auto_control_xing_in_a_bits_address[11:8]))},
     {~(|(auto_control_xing_in_a_bits_address[11:8]))},
     {~(|(auto_control_xing_in_a_bits_address[11:8]))},
     {~(|(auto_control_xing_in_a_bits_address[11:8]))},
     {~(|(auto_control_xing_in_a_bits_address[11:8]))},
     {~(|(auto_control_xing_in_a_bits_address[11:8]))},
     {~(|(auto_control_xing_in_a_bits_address[11:8]))},
     {~(|(auto_control_xing_in_a_bits_address[11:8]))},
     {~(|(auto_control_xing_in_a_bits_address[11:8]))},
     {~(|(auto_control_xing_in_a_bits_address[11:8]))},
     {~(|(auto_control_xing_in_a_bits_address[11:8]))},
     {~(|(auto_control_xing_in_a_bits_address[11:8]))},
     {~(|(auto_control_xing_in_a_bits_address[11:8]))},
     {~(|(auto_control_xing_in_a_bits_address[11:8]))},
     {~(|(auto_control_xing_in_a_bits_address[11:8]))},
     {~(|(auto_control_xing_in_a_bits_address[11:8]))}};	// @[generators/rocket-chip/src/main/scala/tilelink/Buffer.scala:47:20, generators/rocket-chip/src/main/scala/tilelink/Edges.scala:192:34, generators/rocket-chip/src/main/scala/tilelink/RegisterRouter.scala:70:19, :82:24, generators/rocket-chip/src/main/scala/util/MuxLiteral.scala:49:10]
  wire [63:0][31:0] _GEN_2 =
    {{32'h0},
     {32'h0},
     {32'h0},
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     {32'h0},
     {{15'h0, io_back_adcClockTuning_output_controller_state, 6'h0, io_back_adcClockTuning_output_i_term_trunc}},
     {{6'h0, io_back_adcClockTuning_output_p_term_trunc, 7'h0, io_back_adcClockTuning_output_trigger_controller, 7'h0, io_back_adcClockTuning_output_controller_active}},
     {io_back_adcClockTuning_output_accumulated_err},
     {io_back_adcClockTuning_output_f_err},
     {io_back_adcClockTuning_output_adc_ticks_counter},
     {32'h0},
     {io_back_adcClockTuning_output_lo_stop_debug[31:0]},
     {32'h0},
     {io_back_adcClockTuning_output_lo_start_debug[31:0]},
     {io_back_adcClockTuning_output_curr_calc_adc_clock_freq_debug},
     {{22'h0, io_back_adcClockTuning_output_sop_eop_debug, io_back_adcClockTuning_output_control_word}},
     {adcClockTuning_nominal_adc_clock_freq},
     {adcClockTuning_k_i},
     {adcClockTuning_k_p},
     {{24'h0, adcClockTuning_duration}},
     {{7'h0, adcClockTuning_p_control_only, 7'h0, adcClockTuning_mode, 7'h0, adcClockTuning_restart, 7'h0, ifCounter_control_restartCounter}},
     {io_back_ifCounter_output_adcTicksPrevPacket},
     {io_back_ifCounter_output_ifTicksPrevPacket},
     {io_back_ifCounter_output_adcTicksPacket},
     {io_back_ifCounter_output_ifTicksPacket},
     {io_back_ifCounter_output_adcTicks},
     {ifCounter_ifTickThreshold},
     {{q_vgaAtten_gainDec, q_vgaAtten_gainInc, i_vgaAtten_gainDec, i_vgaAtten_gainInc}},
     {32'h0},
     {io_back_messages_txErrorMessage_bits},
     {io_back_messages_rxFinishMessage_bits},
     {io_back_messages_rxErrorMessage_bits},
     {32'h0},
     {{28'h0, enable_ext_lo, enable_vco_lo, enable_rx2, enable_rx1}},
     {{3'h0, enable_q_bpf, enable_q_vga, enable_q_tia, enable_q_buf, enable_q_mix, 3'h0, enable_i_bpf, enable_i_vga, enable_i_tia, enable_i_buf, enable_i_mix, 6'h0, mux_dbg_out}},
     {{6'h0, mux_dbg_in, 10'h0, current_dac_vco}},
     {{2'h0, q_current_dac_vga_s2, 2'h0, i_current_dac_vga_s2, q_DCO_gain, 7'h0, q_DCO_reset}},
     {{7'h0, q_DCO_useDCO, i_DCO_gain, 7'h0, i_DCO_reset, 7'h0, i_DCO_useDCO}},
     {{4'h0, q_bpf_clp_2, q_bpf_clp_1, q_bpf_clp_0, q_bpf_chp_5, q_bpf_chp_4, q_bpf_chp_3, q_bpf_chp_2}},
     {{q_bpf_chp_1, q_bpf_chp_0, q_vgaAtten_toleranceP2P, q_vgaAtten_idealPeakToPeak, q_vgaAtten_sampleWindow}},
     {{7'h0, q_vgaAtten_useAGC, 7'h0, q_vgaAtten_reset, 6'h0, q_vga_gain_ctrl}},
     {{4'h0, i_bpf_clp_2, i_bpf_clp_1, i_bpf_clp_0, i_bpf_chp_5, i_bpf_chp_4, i_bpf_chp_3, i_bpf_chp_2}},
     {{i_bpf_chp_1, i_bpf_chp_0, i_vgaAtten_toleranceP2P, i_vgaAtten_idealPeakToPeak, i_vgaAtten_sampleWindow}},
     {{7'h0, i_vgaAtten_useAGC, 7'h0, i_vgaAtten_reset, 6'h0, i_vga_gain_ctrl}},
     {{7'h0, debug_enable, trim_g2, trim_g1, trim_g0}},
     {32'h0},
     {io_back_status_status4[31:0]},
     {io_back_status_status3},
     {io_back_status_status2},
     {io_back_status_status1},
     {io_back_status_status0},
     {32'h0},
     {32'h0}};	// @[generators/baseband/src/main/scala/baseband/BasebandModem.scala:152:24, :153:24, :154:24, :161:29, :163:32, :164:33, :165:34, :168:40, :169:43, :170:40, :171:35, :172:35, :175:28, :176:28, :177:28, :178:28, :179:28, :180:28, :181:28, :182:28, :183:28, :185:32, :186:33, :187:34, :190:40, :191:43, :192:40, :193:35, :194:35, :197:28, :198:28, :199:28, :200:28, :201:28, :202:28, :203:28, :204:28, :205:28, :207:29, :208:28, :209:27, :211:29, :212:28, :213:27, :216:37, :217:37, :220:32, :222:27, :223:28, :227:29, :228:29, :229:29, :230:29, :231:29, :233:29, :234:29, :235:29, :236:29, :237:29, :239:27, :240:27, :241:30, :242:30, :248:42, :249:49, :254:39, :255:36, :256:40, :257:35, :258:35, :263:46, :264:54, :376:54, :377:80, :378:78, generators/rocket-chip/src/main/scala/tilelink/RegisterRouter.scala:82:24, generators/rocket-chip/src/main/scala/util/MuxLiteral.scala:49:{10,48}]
  wire [2:0]        controlXingIn_d_bits_opcode = {2'h0, out_front_bits_read};	// @[generators/rocket-chip/src/main/scala/tilelink/RegisterRouter.scala:69:36, :82:24, :100:19]
  wire [9:0]        _out_womask_T_99 = {{2{auto_control_xing_in_a_bits_mask[1]}}, _out_backMask_T_5};	// @[generators/rocket-chip/src/main/scala/tilelink/RegisterRouter.scala:82:24]
  always @(posedge clock) begin
    if (_out_wofireMux_T_2 & auto_control_xing_in_a_bits_address[7:2] == 6'h1 & ~(|(auto_control_xing_in_a_bits_address[11:8])) & (&out_backMask))	// @[generators/rocket-chip/src/main/scala/tilelink/Edges.scala:192:34, generators/rocket-chip/src/main/scala/tilelink/RegisterRouter.scala:70:19, :82:24, src/main/scala/chisel3/util/OneHot.scala:58:35]
      additionalData <= auto_control_xing_in_a_bits_data;	// @[generators/baseband/src/main/scala/baseband/BasebandModem.scala:124:27]
    if (reset) begin
      trim_g0 <= 8'h0;	// @[generators/baseband/src/main/scala/baseband/BasebandModem.scala:152:24]
      trim_g1 <= 8'h0;	// @[generators/baseband/src/main/scala/baseband/BasebandModem.scala:152:24, :153:24]
      trim_g2 <= 8'h0;	// @[generators/baseband/src/main/scala/baseband/BasebandModem.scala:152:24, :154:24]
      debug_enable <= 1'h0;	// @[generators/baseband/src/main/scala/baseband/BasebandModem.scala:161:29, generators/rocket-chip/src/main/scala/tilelink/Bundles.scala:259:74]
      i_vga_gain_ctrl <= 10'h0;	// @[generators/baseband/src/main/scala/baseband/BasebandModem.scala:163:32]
      i_vgaAtten_reset <= 1'h0;	// @[generators/baseband/src/main/scala/baseband/BasebandModem.scala:164:33, generators/rocket-chip/src/main/scala/tilelink/Bundles.scala:259:74]
      i_vgaAtten_useAGC <= 1'h0;	// @[generators/baseband/src/main/scala/baseband/BasebandModem.scala:165:34, generators/rocket-chip/src/main/scala/tilelink/Bundles.scala:259:74]
      i_vgaAtten_sampleWindow <= 8'h16;	// @[generators/baseband/src/main/scala/baseband/BasebandModem.scala:168:40]
      i_vgaAtten_idealPeakToPeak <= 8'h80;	// @[generators/baseband/src/main/scala/baseband/BasebandModem.scala:169:43]
      i_vgaAtten_toleranceP2P <= 8'hA;	// @[generators/baseband/src/main/scala/baseband/BasebandModem.scala:170:40]
      i_vgaAtten_gainInc <= 8'h1;	// @[generators/baseband/src/main/scala/baseband/BasebandModem.scala:171:35]
      i_vgaAtten_gainDec <= 8'h4;	// @[generators/baseband/src/main/scala/baseband/BasebandModem.scala:172:35]
      i_bpf_chp_0 <= 4'h0;	// @[generators/baseband/src/main/scala/baseband/BasebandModem.scala:175:28]
      i_bpf_chp_1 <= 4'h0;	// @[generators/baseband/src/main/scala/baseband/BasebandModem.scala:176:28]
      i_bpf_chp_2 <= 4'h0;	// @[generators/baseband/src/main/scala/baseband/BasebandModem.scala:177:28]
      i_bpf_chp_3 <= 4'h0;	// @[generators/baseband/src/main/scala/baseband/BasebandModem.scala:178:28]
      i_bpf_chp_4 <= 4'h0;	// @[generators/baseband/src/main/scala/baseband/BasebandModem.scala:179:28]
      i_bpf_chp_5 <= 4'h0;	// @[generators/baseband/src/main/scala/baseband/BasebandModem.scala:180:28]
      i_bpf_clp_0 <= 4'h0;	// @[generators/baseband/src/main/scala/baseband/BasebandModem.scala:181:28]
      i_bpf_clp_1 <= 4'h0;	// @[generators/baseband/src/main/scala/baseband/BasebandModem.scala:182:28]
      i_bpf_clp_2 <= 4'h0;	// @[generators/baseband/src/main/scala/baseband/BasebandModem.scala:183:28]
      q_vga_gain_ctrl <= 10'h0;	// @[generators/baseband/src/main/scala/baseband/BasebandModem.scala:163:32, :185:32]
      q_vgaAtten_reset <= 1'h0;	// @[generators/baseband/src/main/scala/baseband/BasebandModem.scala:186:33, generators/rocket-chip/src/main/scala/tilelink/Bundles.scala:259:74]
      q_vgaAtten_useAGC <= 1'h0;	// @[generators/baseband/src/main/scala/baseband/BasebandModem.scala:187:34, generators/rocket-chip/src/main/scala/tilelink/Bundles.scala:259:74]
      q_vgaAtten_sampleWindow <= 8'h16;	// @[generators/baseband/src/main/scala/baseband/BasebandModem.scala:168:40, :190:40]
      q_vgaAtten_idealPeakToPeak <= 8'h80;	// @[generators/baseband/src/main/scala/baseband/BasebandModem.scala:169:43, :191:43]
      q_vgaAtten_toleranceP2P <= 8'hA;	// @[generators/baseband/src/main/scala/baseband/BasebandModem.scala:170:40, :192:40]
      q_vgaAtten_gainInc <= 8'h1;	// @[generators/baseband/src/main/scala/baseband/BasebandModem.scala:171:35, :193:35]
      q_vgaAtten_gainDec <= 8'h4;	// @[generators/baseband/src/main/scala/baseband/BasebandModem.scala:172:35, :194:35]
      q_bpf_chp_0 <= 4'h0;	// @[generators/baseband/src/main/scala/baseband/BasebandModem.scala:197:28]
      q_bpf_chp_1 <= 4'h0;	// @[generators/baseband/src/main/scala/baseband/BasebandModem.scala:198:28]
      q_bpf_chp_2 <= 4'h0;	// @[generators/baseband/src/main/scala/baseband/BasebandModem.scala:199:28]
      q_bpf_chp_3 <= 4'h0;	// @[generators/baseband/src/main/scala/baseband/BasebandModem.scala:200:28]
      q_bpf_chp_4 <= 4'h0;	// @[generators/baseband/src/main/scala/baseband/BasebandModem.scala:201:28]
      q_bpf_chp_5 <= 4'h0;	// @[generators/baseband/src/main/scala/baseband/BasebandModem.scala:202:28]
      q_bpf_clp_0 <= 4'h0;	// @[generators/baseband/src/main/scala/baseband/BasebandModem.scala:203:28]
      q_bpf_clp_1 <= 4'h0;	// @[generators/baseband/src/main/scala/baseband/BasebandModem.scala:204:28]
      q_bpf_clp_2 <= 4'h0;	// @[generators/baseband/src/main/scala/baseband/BasebandModem.scala:205:28]
      i_DCO_useDCO <= 1'h0;	// @[generators/baseband/src/main/scala/baseband/BasebandModem.scala:207:29, generators/rocket-chip/src/main/scala/tilelink/Bundles.scala:259:74]
      i_DCO_reset <= 1'h0;	// @[generators/baseband/src/main/scala/baseband/BasebandModem.scala:208:28, generators/rocket-chip/src/main/scala/tilelink/Bundles.scala:259:74]
      i_DCO_gain <= 8'h20;	// @[generators/baseband/src/main/scala/baseband/BasebandModem.scala:209:27]
      q_DCO_useDCO <= 1'h0;	// @[generators/baseband/src/main/scala/baseband/BasebandModem.scala:211:29, generators/rocket-chip/src/main/scala/tilelink/Bundles.scala:259:74]
      q_DCO_reset <= 1'h0;	// @[generators/baseband/src/main/scala/baseband/BasebandModem.scala:212:28, generators/rocket-chip/src/main/scala/tilelink/Bundles.scala:259:74]
      q_DCO_gain <= 8'h20;	// @[generators/baseband/src/main/scala/baseband/BasebandModem.scala:209:27, :213:27]
      i_current_dac_vga_s2 <= 6'h0;	// @[generators/baseband/src/main/scala/baseband/BasebandModem.scala:216:37]
      q_current_dac_vga_s2 <= 6'h0;	// @[generators/baseband/src/main/scala/baseband/BasebandModem.scala:216:37, :217:37]
      current_dac_vco <= 6'h0;	// @[generators/baseband/src/main/scala/baseband/BasebandModem.scala:216:37, :220:32]
      mux_dbg_in <= 10'h0;	// @[generators/baseband/src/main/scala/baseband/BasebandModem.scala:163:32, :222:27]
      mux_dbg_out <= 10'h0;	// @[generators/baseband/src/main/scala/baseband/BasebandModem.scala:163:32, :223:28]
      enable_i_mix <= 1'h0;	// @[generators/baseband/src/main/scala/baseband/BasebandModem.scala:227:29, generators/rocket-chip/src/main/scala/tilelink/Bundles.scala:259:74]
      enable_i_buf <= 1'h0;	// @[generators/baseband/src/main/scala/baseband/BasebandModem.scala:228:29, generators/rocket-chip/src/main/scala/tilelink/Bundles.scala:259:74]
      enable_i_tia <= 1'h0;	// @[generators/baseband/src/main/scala/baseband/BasebandModem.scala:229:29, generators/rocket-chip/src/main/scala/tilelink/Bundles.scala:259:74]
      enable_i_vga <= 1'h0;	// @[generators/baseband/src/main/scala/baseband/BasebandModem.scala:230:29, generators/rocket-chip/src/main/scala/tilelink/Bundles.scala:259:74]
      enable_i_bpf <= 1'h0;	// @[generators/baseband/src/main/scala/baseband/BasebandModem.scala:231:29, generators/rocket-chip/src/main/scala/tilelink/Bundles.scala:259:74]
      enable_q_mix <= 1'h0;	// @[generators/baseband/src/main/scala/baseband/BasebandModem.scala:233:29, generators/rocket-chip/src/main/scala/tilelink/Bundles.scala:259:74]
      enable_q_buf <= 1'h0;	// @[generators/baseband/src/main/scala/baseband/BasebandModem.scala:234:29, generators/rocket-chip/src/main/scala/tilelink/Bundles.scala:259:74]
      enable_q_tia <= 1'h0;	// @[generators/baseband/src/main/scala/baseband/BasebandModem.scala:235:29, generators/rocket-chip/src/main/scala/tilelink/Bundles.scala:259:74]
      enable_q_vga <= 1'h0;	// @[generators/baseband/src/main/scala/baseband/BasebandModem.scala:236:29, generators/rocket-chip/src/main/scala/tilelink/Bundles.scala:259:74]
      enable_q_bpf <= 1'h0;	// @[generators/baseband/src/main/scala/baseband/BasebandModem.scala:237:29, generators/rocket-chip/src/main/scala/tilelink/Bundles.scala:259:74]
      enable_rx1 <= 1'h0;	// @[generators/baseband/src/main/scala/baseband/BasebandModem.scala:239:27, generators/rocket-chip/src/main/scala/tilelink/Bundles.scala:259:74]
      enable_rx2 <= 1'h0;	// @[generators/baseband/src/main/scala/baseband/BasebandModem.scala:240:27, generators/rocket-chip/src/main/scala/tilelink/Bundles.scala:259:74]
      enable_vco_lo <= 1'h1;	// @[generators/baseband/src/main/scala/baseband/BasebandModem.scala:241:30, generators/rocket-chip/src/main/scala/tilelink/Buffer.scala:47:20]
      enable_ext_lo <= 1'h0;	// @[generators/baseband/src/main/scala/baseband/BasebandModem.scala:242:30, generators/rocket-chip/src/main/scala/tilelink/Bundles.scala:259:74]
      ifCounter_ifTickThreshold <= 32'h0;	// @[generators/baseband/src/main/scala/baseband/BasebandModem.scala:248:42, generators/rocket-chip/src/main/scala/util/MuxLiteral.scala:49:48]
      ifCounter_control_restartCounter <= 1'h0;	// @[generators/baseband/src/main/scala/baseband/BasebandModem.scala:249:49, generators/rocket-chip/src/main/scala/tilelink/Bundles.scala:259:74]
      adcClockTuning_restart <= 1'h1;	// @[generators/baseband/src/main/scala/baseband/BasebandModem.scala:254:39, generators/rocket-chip/src/main/scala/tilelink/Buffer.scala:47:20]
      adcClockTuning_mode <= 1'h0;	// @[generators/baseband/src/main/scala/baseband/BasebandModem.scala:255:36, generators/rocket-chip/src/main/scala/tilelink/Bundles.scala:259:74]
      adcClockTuning_duration <= 8'h0;	// @[generators/baseband/src/main/scala/baseband/BasebandModem.scala:152:24, :256:40]
      adcClockTuning_k_p <= 32'h0;	// @[generators/baseband/src/main/scala/baseband/BasebandModem.scala:257:35, generators/rocket-chip/src/main/scala/util/MuxLiteral.scala:49:48]
      adcClockTuning_k_i <= 32'h0;	// @[generators/baseband/src/main/scala/baseband/BasebandModem.scala:258:35, generators/rocket-chip/src/main/scala/util/MuxLiteral.scala:49:48]
      adcClockTuning_p_control_only <= 1'h1;	// @[generators/baseband/src/main/scala/baseband/BasebandModem.scala:263:46, generators/rocket-chip/src/main/scala/tilelink/Buffer.scala:47:20]
      adcClockTuning_nominal_adc_clock_freq <= 32'h0;	// @[generators/baseband/src/main/scala/baseband/BasebandModem.scala:264:54, generators/rocket-chip/src/main/scala/util/MuxLiteral.scala:49:48]
    end
    else begin
      if (out_woready_37 & auto_control_xing_in_a_bits_mask[0])	// @[generators/rocket-chip/src/main/scala/tilelink/RegisterRouter.scala:82:24]
        trim_g0 <= auto_control_xing_in_a_bits_data[7:0];	// @[generators/baseband/src/main/scala/baseband/BasebandModem.scala:152:24, generators/rocket-chip/src/main/scala/tilelink/RegisterRouter.scala:82:24]
      trim_g1 <= out_woready_37 & auto_control_xing_in_a_bits_mask[1] ? auto_control_xing_in_a_bits_data[15:8] : io_tuning_trim_g1;	// @[generators/baseband/src/main/scala/baseband/BasebandModem.scala:153:24, :279:11, generators/rocket-chip/src/main/scala/regmapper/RegField.scala:74:{88,92}, generators/rocket-chip/src/main/scala/tilelink/RegisterRouter.scala:82:24]
      if (out_woready_37 & auto_control_xing_in_a_bits_mask[2])	// @[generators/rocket-chip/src/main/scala/tilelink/RegisterRouter.scala:82:24]
        trim_g2 <= auto_control_xing_in_a_bits_data[23:16];	// @[generators/baseband/src/main/scala/baseband/BasebandModem.scala:154:24, generators/rocket-chip/src/main/scala/tilelink/RegisterRouter.scala:82:24]
      if (out_woready_37 & auto_control_xing_in_a_bits_mask[3])	// @[generators/rocket-chip/src/main/scala/tilelink/RegisterRouter.scala:82:24]
        debug_enable <= auto_control_xing_in_a_bits_data[24];	// @[generators/baseband/src/main/scala/baseband/BasebandModem.scala:161:29, generators/rocket-chip/src/main/scala/tilelink/RegisterRouter.scala:82:24]
      if (out_woready_18 & (&_out_womask_T_99))	// @[generators/rocket-chip/src/main/scala/tilelink/RegisterRouter.scala:82:24]
        i_vga_gain_ctrl <= auto_control_xing_in_a_bits_data[9:0];	// @[generators/baseband/src/main/scala/baseband/BasebandModem.scala:163:32, generators/rocket-chip/src/main/scala/tilelink/RegisterRouter.scala:82:24]
      if (out_woready_18 & auto_control_xing_in_a_bits_mask[2])	// @[generators/rocket-chip/src/main/scala/tilelink/RegisterRouter.scala:82:24]
        i_vgaAtten_reset <= auto_control_xing_in_a_bits_data[16];	// @[generators/baseband/src/main/scala/baseband/BasebandModem.scala:164:33, generators/rocket-chip/src/main/scala/tilelink/RegisterRouter.scala:82:24]
      if (out_woready_18 & auto_control_xing_in_a_bits_mask[3])	// @[generators/rocket-chip/src/main/scala/tilelink/RegisterRouter.scala:82:24]
        i_vgaAtten_useAGC <= auto_control_xing_in_a_bits_data[24];	// @[generators/baseband/src/main/scala/baseband/BasebandModem.scala:165:34, generators/rocket-chip/src/main/scala/tilelink/RegisterRouter.scala:82:24]
      if (out_woready_6 & auto_control_xing_in_a_bits_mask[0])	// @[generators/rocket-chip/src/main/scala/tilelink/RegisterRouter.scala:82:24]
        i_vgaAtten_sampleWindow <= auto_control_xing_in_a_bits_data[7:0];	// @[generators/baseband/src/main/scala/baseband/BasebandModem.scala:168:40, generators/rocket-chip/src/main/scala/tilelink/RegisterRouter.scala:82:24]
      if (out_woready_6 & auto_control_xing_in_a_bits_mask[1])	// @[generators/rocket-chip/src/main/scala/tilelink/RegisterRouter.scala:82:24]
        i_vgaAtten_idealPeakToPeak <= auto_control_xing_in_a_bits_data[15:8];	// @[generators/baseband/src/main/scala/baseband/BasebandModem.scala:169:43, generators/rocket-chip/src/main/scala/tilelink/RegisterRouter.scala:82:24]
      if (out_woready_6 & auto_control_xing_in_a_bits_mask[2])	// @[generators/rocket-chip/src/main/scala/tilelink/RegisterRouter.scala:82:24]
        i_vgaAtten_toleranceP2P <= auto_control_xing_in_a_bits_data[23:16];	// @[generators/baseband/src/main/scala/baseband/BasebandModem.scala:170:40, generators/rocket-chip/src/main/scala/tilelink/RegisterRouter.scala:82:24]
      if (out_woready_46 & auto_control_xing_in_a_bits_mask[0])	// @[generators/rocket-chip/src/main/scala/tilelink/RegisterRouter.scala:82:24]
        i_vgaAtten_gainInc <= auto_control_xing_in_a_bits_data[7:0];	// @[generators/baseband/src/main/scala/baseband/BasebandModem.scala:171:35, generators/rocket-chip/src/main/scala/tilelink/RegisterRouter.scala:82:24]
      if (out_woready_46 & auto_control_xing_in_a_bits_mask[1])	// @[generators/rocket-chip/src/main/scala/tilelink/RegisterRouter.scala:82:24]
        i_vgaAtten_gainDec <= auto_control_xing_in_a_bits_data[15:8];	// @[generators/baseband/src/main/scala/baseband/BasebandModem.scala:172:35, generators/rocket-chip/src/main/scala/tilelink/RegisterRouter.scala:82:24]
      if (out_woready_6 & auto_control_xing_in_a_bits_mask[3])	// @[generators/rocket-chip/src/main/scala/tilelink/RegisterRouter.scala:82:24]
        i_bpf_chp_0 <= auto_control_xing_in_a_bits_data[27:24];	// @[generators/baseband/src/main/scala/baseband/BasebandModem.scala:175:28, generators/rocket-chip/src/main/scala/tilelink/RegisterRouter.scala:82:24]
      if (out_woready_6 & auto_control_xing_in_a_bits_mask[3])	// @[generators/rocket-chip/src/main/scala/tilelink/RegisterRouter.scala:82:24]
        i_bpf_chp_1 <= auto_control_xing_in_a_bits_data[31:28];	// @[generators/baseband/src/main/scala/baseband/BasebandModem.scala:176:28, generators/rocket-chip/src/main/scala/tilelink/RegisterRouter.scala:82:24]
      if (out_woready_88 & auto_control_xing_in_a_bits_mask[0])	// @[generators/rocket-chip/src/main/scala/tilelink/RegisterRouter.scala:82:24]
        i_bpf_chp_2 <= auto_control_xing_in_a_bits_data[3:0];	// @[generators/baseband/src/main/scala/baseband/BasebandModem.scala:177:28, generators/rocket-chip/src/main/scala/tilelink/RegisterRouter.scala:82:24]
      if (out_woready_88 & auto_control_xing_in_a_bits_mask[0])	// @[generators/rocket-chip/src/main/scala/tilelink/RegisterRouter.scala:82:24]
        i_bpf_chp_3 <= auto_control_xing_in_a_bits_data[7:4];	// @[generators/baseband/src/main/scala/baseband/BasebandModem.scala:178:28, generators/rocket-chip/src/main/scala/tilelink/RegisterRouter.scala:82:24]
      if (out_woready_88 & auto_control_xing_in_a_bits_mask[1])	// @[generators/rocket-chip/src/main/scala/tilelink/RegisterRouter.scala:82:24]
        i_bpf_chp_4 <= auto_control_xing_in_a_bits_data[11:8];	// @[generators/baseband/src/main/scala/baseband/BasebandModem.scala:179:28, generators/rocket-chip/src/main/scala/tilelink/RegisterRouter.scala:82:24]
      if (out_woready_88 & auto_control_xing_in_a_bits_mask[1])	// @[generators/rocket-chip/src/main/scala/tilelink/RegisterRouter.scala:82:24]
        i_bpf_chp_5 <= auto_control_xing_in_a_bits_data[15:12];	// @[generators/baseband/src/main/scala/baseband/BasebandModem.scala:180:28, generators/rocket-chip/src/main/scala/tilelink/RegisterRouter.scala:82:24]
      if (out_woready_88 & auto_control_xing_in_a_bits_mask[2])	// @[generators/rocket-chip/src/main/scala/tilelink/RegisterRouter.scala:82:24]
        i_bpf_clp_0 <= auto_control_xing_in_a_bits_data[19:16];	// @[generators/baseband/src/main/scala/baseband/BasebandModem.scala:181:28, generators/rocket-chip/src/main/scala/tilelink/RegisterRouter.scala:82:24]
      if (out_woready_88 & auto_control_xing_in_a_bits_mask[2])	// @[generators/rocket-chip/src/main/scala/tilelink/RegisterRouter.scala:82:24]
        i_bpf_clp_1 <= auto_control_xing_in_a_bits_data[23:20];	// @[generators/baseband/src/main/scala/baseband/BasebandModem.scala:182:28, generators/rocket-chip/src/main/scala/tilelink/RegisterRouter.scala:82:24]
      if (out_woready_88 & auto_control_xing_in_a_bits_mask[3])	// @[generators/rocket-chip/src/main/scala/tilelink/RegisterRouter.scala:82:24]
        i_bpf_clp_2 <= auto_control_xing_in_a_bits_data[27:24];	// @[generators/baseband/src/main/scala/baseband/BasebandModem.scala:183:28, generators/rocket-chip/src/main/scala/tilelink/RegisterRouter.scala:82:24]
      if (out_woready_22 & (&_out_womask_T_99))	// @[generators/rocket-chip/src/main/scala/tilelink/RegisterRouter.scala:82:24]
        q_vga_gain_ctrl <= auto_control_xing_in_a_bits_data[9:0];	// @[generators/baseband/src/main/scala/baseband/BasebandModem.scala:185:32, generators/rocket-chip/src/main/scala/tilelink/RegisterRouter.scala:82:24]
      if (out_woready_22 & auto_control_xing_in_a_bits_mask[2])	// @[generators/rocket-chip/src/main/scala/tilelink/RegisterRouter.scala:82:24]
        q_vgaAtten_reset <= auto_control_xing_in_a_bits_data[16];	// @[generators/baseband/src/main/scala/baseband/BasebandModem.scala:186:33, generators/rocket-chip/src/main/scala/tilelink/RegisterRouter.scala:82:24]
      if (out_woready_22 & auto_control_xing_in_a_bits_mask[3])	// @[generators/rocket-chip/src/main/scala/tilelink/RegisterRouter.scala:82:24]
        q_vgaAtten_useAGC <= auto_control_xing_in_a_bits_data[24];	// @[generators/baseband/src/main/scala/baseband/BasebandModem.scala:187:34, generators/rocket-chip/src/main/scala/tilelink/RegisterRouter.scala:82:24]
      if (out_woready_60 & auto_control_xing_in_a_bits_mask[0])	// @[generators/rocket-chip/src/main/scala/tilelink/RegisterRouter.scala:82:24]
        q_vgaAtten_sampleWindow <= auto_control_xing_in_a_bits_data[7:0];	// @[generators/baseband/src/main/scala/baseband/BasebandModem.scala:190:40, generators/rocket-chip/src/main/scala/tilelink/RegisterRouter.scala:82:24]
      if (out_woready_60 & auto_control_xing_in_a_bits_mask[1])	// @[generators/rocket-chip/src/main/scala/tilelink/RegisterRouter.scala:82:24]
        q_vgaAtten_idealPeakToPeak <= auto_control_xing_in_a_bits_data[15:8];	// @[generators/baseband/src/main/scala/baseband/BasebandModem.scala:191:43, generators/rocket-chip/src/main/scala/tilelink/RegisterRouter.scala:82:24]
      if (out_woready_60 & auto_control_xing_in_a_bits_mask[2])	// @[generators/rocket-chip/src/main/scala/tilelink/RegisterRouter.scala:82:24]
        q_vgaAtten_toleranceP2P <= auto_control_xing_in_a_bits_data[23:16];	// @[generators/baseband/src/main/scala/baseband/BasebandModem.scala:192:40, generators/rocket-chip/src/main/scala/tilelink/RegisterRouter.scala:82:24]
      if (out_woready_46 & auto_control_xing_in_a_bits_mask[2])	// @[generators/rocket-chip/src/main/scala/tilelink/RegisterRouter.scala:82:24]
        q_vgaAtten_gainInc <= auto_control_xing_in_a_bits_data[23:16];	// @[generators/baseband/src/main/scala/baseband/BasebandModem.scala:193:35, generators/rocket-chip/src/main/scala/tilelink/RegisterRouter.scala:82:24]
      if (out_woready_46 & auto_control_xing_in_a_bits_mask[3])	// @[generators/rocket-chip/src/main/scala/tilelink/RegisterRouter.scala:82:24]
        q_vgaAtten_gainDec <= auto_control_xing_in_a_bits_data[31:24];	// @[generators/baseband/src/main/scala/baseband/BasebandModem.scala:194:35, generators/rocket-chip/src/main/scala/tilelink/RegisterRouter.scala:82:24]
      if (out_woready_60 & auto_control_xing_in_a_bits_mask[3])	// @[generators/rocket-chip/src/main/scala/tilelink/RegisterRouter.scala:82:24]
        q_bpf_chp_0 <= auto_control_xing_in_a_bits_data[27:24];	// @[generators/baseband/src/main/scala/baseband/BasebandModem.scala:197:28, generators/rocket-chip/src/main/scala/tilelink/RegisterRouter.scala:82:24]
      if (out_woready_60 & auto_control_xing_in_a_bits_mask[3])	// @[generators/rocket-chip/src/main/scala/tilelink/RegisterRouter.scala:82:24]
        q_bpf_chp_1 <= auto_control_xing_in_a_bits_data[31:28];	// @[generators/baseband/src/main/scala/baseband/BasebandModem.scala:198:28, generators/rocket-chip/src/main/scala/tilelink/RegisterRouter.scala:82:24]
      if (out_woready_13 & auto_control_xing_in_a_bits_mask[0])	// @[generators/rocket-chip/src/main/scala/tilelink/RegisterRouter.scala:82:24]
        q_bpf_chp_2 <= auto_control_xing_in_a_bits_data[3:0];	// @[generators/baseband/src/main/scala/baseband/BasebandModem.scala:199:28, generators/rocket-chip/src/main/scala/tilelink/RegisterRouter.scala:82:24]
      if (out_woready_13 & auto_control_xing_in_a_bits_mask[0])	// @[generators/rocket-chip/src/main/scala/tilelink/RegisterRouter.scala:82:24]
        q_bpf_chp_3 <= auto_control_xing_in_a_bits_data[7:4];	// @[generators/baseband/src/main/scala/baseband/BasebandModem.scala:200:28, generators/rocket-chip/src/main/scala/tilelink/RegisterRouter.scala:82:24]
      if (out_woready_13 & auto_control_xing_in_a_bits_mask[1])	// @[generators/rocket-chip/src/main/scala/tilelink/RegisterRouter.scala:82:24]
        q_bpf_chp_4 <= auto_control_xing_in_a_bits_data[11:8];	// @[generators/baseband/src/main/scala/baseband/BasebandModem.scala:201:28, generators/rocket-chip/src/main/scala/tilelink/RegisterRouter.scala:82:24]
      if (out_woready_13 & auto_control_xing_in_a_bits_mask[1])	// @[generators/rocket-chip/src/main/scala/tilelink/RegisterRouter.scala:82:24]
        q_bpf_chp_5 <= auto_control_xing_in_a_bits_data[15:12];	// @[generators/baseband/src/main/scala/baseband/BasebandModem.scala:202:28, generators/rocket-chip/src/main/scala/tilelink/RegisterRouter.scala:82:24]
      if (out_woready_13 & auto_control_xing_in_a_bits_mask[2])	// @[generators/rocket-chip/src/main/scala/tilelink/RegisterRouter.scala:82:24]
        q_bpf_clp_0 <= auto_control_xing_in_a_bits_data[19:16];	// @[generators/baseband/src/main/scala/baseband/BasebandModem.scala:203:28, generators/rocket-chip/src/main/scala/tilelink/RegisterRouter.scala:82:24]
      if (out_woready_13 & auto_control_xing_in_a_bits_mask[2])	// @[generators/rocket-chip/src/main/scala/tilelink/RegisterRouter.scala:82:24]
        q_bpf_clp_1 <= auto_control_xing_in_a_bits_data[23:20];	// @[generators/baseband/src/main/scala/baseband/BasebandModem.scala:204:28, generators/rocket-chip/src/main/scala/tilelink/RegisterRouter.scala:82:24]
      if (out_woready_13 & auto_control_xing_in_a_bits_mask[3])	// @[generators/rocket-chip/src/main/scala/tilelink/RegisterRouter.scala:82:24]
        q_bpf_clp_2 <= auto_control_xing_in_a_bits_data[27:24];	// @[generators/baseband/src/main/scala/baseband/BasebandModem.scala:205:28, generators/rocket-chip/src/main/scala/tilelink/RegisterRouter.scala:82:24]
      if (out_woready_104 & auto_control_xing_in_a_bits_mask[0])	// @[generators/rocket-chip/src/main/scala/tilelink/RegisterRouter.scala:82:24]
        i_DCO_useDCO <= auto_control_xing_in_a_bits_data[0];	// @[generators/baseband/src/main/scala/baseband/BasebandModem.scala:207:29, generators/rocket-chip/src/main/scala/tilelink/RegisterRouter.scala:82:24]
      if (out_woready_104 & auto_control_xing_in_a_bits_mask[1])	// @[generators/rocket-chip/src/main/scala/tilelink/RegisterRouter.scala:82:24]
        i_DCO_reset <= auto_control_xing_in_a_bits_data[8];	// @[generators/baseband/src/main/scala/baseband/BasebandModem.scala:208:28, generators/rocket-chip/src/main/scala/tilelink/RegisterRouter.scala:82:24]
      if (out_woready_104 & auto_control_xing_in_a_bits_mask[2])	// @[generators/rocket-chip/src/main/scala/tilelink/RegisterRouter.scala:82:24]
        i_DCO_gain <= auto_control_xing_in_a_bits_data[23:16];	// @[generators/baseband/src/main/scala/baseband/BasebandModem.scala:209:27, generators/rocket-chip/src/main/scala/tilelink/RegisterRouter.scala:82:24]
      if (out_woready_104 & auto_control_xing_in_a_bits_mask[3])	// @[generators/rocket-chip/src/main/scala/tilelink/RegisterRouter.scala:82:24]
        q_DCO_useDCO <= auto_control_xing_in_a_bits_data[24];	// @[generators/baseband/src/main/scala/baseband/BasebandModem.scala:211:29, generators/rocket-chip/src/main/scala/tilelink/RegisterRouter.scala:82:24]
      if (out_woready_80 & auto_control_xing_in_a_bits_mask[0])	// @[generators/rocket-chip/src/main/scala/tilelink/RegisterRouter.scala:82:24]
        q_DCO_reset <= auto_control_xing_in_a_bits_data[0];	// @[generators/baseband/src/main/scala/baseband/BasebandModem.scala:212:28, generators/rocket-chip/src/main/scala/tilelink/RegisterRouter.scala:82:24]
      if (out_woready_80 & auto_control_xing_in_a_bits_mask[1])	// @[generators/rocket-chip/src/main/scala/tilelink/RegisterRouter.scala:82:24]
        q_DCO_gain <= auto_control_xing_in_a_bits_data[15:8];	// @[generators/baseband/src/main/scala/baseband/BasebandModem.scala:213:27, generators/rocket-chip/src/main/scala/tilelink/RegisterRouter.scala:82:24]
      if (out_woready_80 & auto_control_xing_in_a_bits_mask[2])	// @[generators/rocket-chip/src/main/scala/tilelink/RegisterRouter.scala:82:24]
        i_current_dac_vga_s2 <= auto_control_xing_in_a_bits_data[21:16];	// @[generators/baseband/src/main/scala/baseband/BasebandModem.scala:216:37, generators/rocket-chip/src/main/scala/tilelink/RegisterRouter.scala:82:24]
      if (out_woready_80 & auto_control_xing_in_a_bits_mask[3])	// @[generators/rocket-chip/src/main/scala/tilelink/RegisterRouter.scala:82:24]
        q_current_dac_vga_s2 <= auto_control_xing_in_a_bits_data[29:24];	// @[generators/baseband/src/main/scala/baseband/BasebandModem.scala:217:37, generators/rocket-chip/src/main/scala/tilelink/RegisterRouter.scala:82:24]
      if (out_woready_64 & auto_control_xing_in_a_bits_mask[0])	// @[generators/rocket-chip/src/main/scala/tilelink/RegisterRouter.scala:82:24]
        current_dac_vco <= auto_control_xing_in_a_bits_data[5:0];	// @[generators/baseband/src/main/scala/baseband/BasebandModem.scala:220:32, generators/rocket-chip/src/main/scala/tilelink/RegisterRouter.scala:82:24]
      if (out_woready_64 & (&{{2{auto_control_xing_in_a_bits_mask[3]}}, _out_backMask_T_9}))	// @[generators/rocket-chip/src/main/scala/tilelink/RegisterRouter.scala:82:24]
        mux_dbg_in <= auto_control_xing_in_a_bits_data[25:16];	// @[generators/baseband/src/main/scala/baseband/BasebandModem.scala:222:27, generators/rocket-chip/src/main/scala/tilelink/RegisterRouter.scala:82:24]
      if (out_woready_33 & (&_out_womask_T_99))	// @[generators/rocket-chip/src/main/scala/tilelink/RegisterRouter.scala:82:24]
        mux_dbg_out <= auto_control_xing_in_a_bits_data[9:0];	// @[generators/baseband/src/main/scala/baseband/BasebandModem.scala:223:28, generators/rocket-chip/src/main/scala/tilelink/RegisterRouter.scala:82:24]
      if (out_woready_33 & auto_control_xing_in_a_bits_mask[2])	// @[generators/rocket-chip/src/main/scala/tilelink/RegisterRouter.scala:82:24]
        enable_i_mix <= auto_control_xing_in_a_bits_data[16];	// @[generators/baseband/src/main/scala/baseband/BasebandModem.scala:227:29, generators/rocket-chip/src/main/scala/tilelink/RegisterRouter.scala:82:24]
      if (out_woready_33 & auto_control_xing_in_a_bits_mask[2])	// @[generators/rocket-chip/src/main/scala/tilelink/RegisterRouter.scala:82:24]
        enable_i_buf <= auto_control_xing_in_a_bits_data[17];	// @[generators/baseband/src/main/scala/baseband/BasebandModem.scala:228:29, generators/rocket-chip/src/main/scala/tilelink/RegisterRouter.scala:82:24]
      if (out_woready_33 & auto_control_xing_in_a_bits_mask[2])	// @[generators/rocket-chip/src/main/scala/tilelink/RegisterRouter.scala:82:24]
        enable_i_tia <= auto_control_xing_in_a_bits_data[18];	// @[generators/baseband/src/main/scala/baseband/BasebandModem.scala:229:29, generators/rocket-chip/src/main/scala/tilelink/RegisterRouter.scala:82:24]
      if (out_woready_33 & auto_control_xing_in_a_bits_mask[2])	// @[generators/rocket-chip/src/main/scala/tilelink/RegisterRouter.scala:82:24]
        enable_i_vga <= auto_control_xing_in_a_bits_data[19];	// @[generators/baseband/src/main/scala/baseband/BasebandModem.scala:230:29, generators/rocket-chip/src/main/scala/tilelink/RegisterRouter.scala:82:24]
      if (out_woready_33 & auto_control_xing_in_a_bits_mask[2])	// @[generators/rocket-chip/src/main/scala/tilelink/RegisterRouter.scala:82:24]
        enable_i_bpf <= auto_control_xing_in_a_bits_data[20];	// @[generators/baseband/src/main/scala/baseband/BasebandModem.scala:231:29, generators/rocket-chip/src/main/scala/tilelink/RegisterRouter.scala:82:24]
      if (out_woready_33 & auto_control_xing_in_a_bits_mask[3])	// @[generators/rocket-chip/src/main/scala/tilelink/RegisterRouter.scala:82:24]
        enable_q_mix <= auto_control_xing_in_a_bits_data[24];	// @[generators/baseband/src/main/scala/baseband/BasebandModem.scala:233:29, generators/rocket-chip/src/main/scala/tilelink/RegisterRouter.scala:82:24]
      if (out_woready_33 & auto_control_xing_in_a_bits_mask[3])	// @[generators/rocket-chip/src/main/scala/tilelink/RegisterRouter.scala:82:24]
        enable_q_buf <= auto_control_xing_in_a_bits_data[25];	// @[generators/baseband/src/main/scala/baseband/BasebandModem.scala:234:29, generators/rocket-chip/src/main/scala/tilelink/RegisterRouter.scala:82:24]
      if (out_woready_33 & auto_control_xing_in_a_bits_mask[3])	// @[generators/rocket-chip/src/main/scala/tilelink/RegisterRouter.scala:82:24]
        enable_q_tia <= auto_control_xing_in_a_bits_data[26];	// @[generators/baseband/src/main/scala/baseband/BasebandModem.scala:235:29, generators/rocket-chip/src/main/scala/tilelink/RegisterRouter.scala:82:24]
      if (out_woready_33 & auto_control_xing_in_a_bits_mask[3])	// @[generators/rocket-chip/src/main/scala/tilelink/RegisterRouter.scala:82:24]
        enable_q_vga <= auto_control_xing_in_a_bits_data[27];	// @[generators/baseband/src/main/scala/baseband/BasebandModem.scala:236:29, generators/rocket-chip/src/main/scala/tilelink/RegisterRouter.scala:82:24]
      if (out_woready_33 & auto_control_xing_in_a_bits_mask[3])	// @[generators/rocket-chip/src/main/scala/tilelink/RegisterRouter.scala:82:24]
        enable_q_bpf <= auto_control_xing_in_a_bits_data[28];	// @[generators/baseband/src/main/scala/baseband/BasebandModem.scala:237:29, generators/rocket-chip/src/main/scala/tilelink/RegisterRouter.scala:82:24]
      if (out_woready_98 & auto_control_xing_in_a_bits_mask[0])	// @[generators/rocket-chip/src/main/scala/tilelink/RegisterRouter.scala:82:24]
        enable_rx1 <= auto_control_xing_in_a_bits_data[0];	// @[generators/baseband/src/main/scala/baseband/BasebandModem.scala:239:27, generators/rocket-chip/src/main/scala/tilelink/RegisterRouter.scala:82:24]
      if (out_woready_98 & auto_control_xing_in_a_bits_mask[0])	// @[generators/rocket-chip/src/main/scala/tilelink/RegisterRouter.scala:82:24]
        enable_rx2 <= auto_control_xing_in_a_bits_data[1];	// @[generators/baseband/src/main/scala/baseband/BasebandModem.scala:240:27, generators/rocket-chip/src/main/scala/tilelink/RegisterRouter.scala:82:24]
      if (out_woready_98 & auto_control_xing_in_a_bits_mask[0])	// @[generators/rocket-chip/src/main/scala/tilelink/RegisterRouter.scala:82:24]
        enable_vco_lo <= auto_control_xing_in_a_bits_data[2];	// @[generators/baseband/src/main/scala/baseband/BasebandModem.scala:241:30, generators/rocket-chip/src/main/scala/tilelink/RegisterRouter.scala:82:24]
      if (out_woready_98 & auto_control_xing_in_a_bits_mask[0])	// @[generators/rocket-chip/src/main/scala/tilelink/RegisterRouter.scala:82:24]
        enable_ext_lo <= auto_control_xing_in_a_bits_data[3];	// @[generators/baseband/src/main/scala/baseband/BasebandModem.scala:242:30, generators/rocket-chip/src/main/scala/tilelink/RegisterRouter.scala:82:24]
      if (_out_wofireMux_T_2 & auto_control_xing_in_a_bits_address[7:2] == 6'h1A & ~(|(auto_control_xing_in_a_bits_address[11:8])) & (&out_backMask))	// @[generators/rocket-chip/src/main/scala/tilelink/Edges.scala:192:34, generators/rocket-chip/src/main/scala/tilelink/RegisterRouter.scala:70:19, :82:24, src/main/scala/chisel3/util/OneHot.scala:58:35]
        ifCounter_ifTickThreshold <= auto_control_xing_in_a_bits_data;	// @[generators/baseband/src/main/scala/baseband/BasebandModem.scala:248:42]
      if (out_woready_68 & auto_control_xing_in_a_bits_mask[0])	// @[generators/rocket-chip/src/main/scala/tilelink/RegisterRouter.scala:82:24]
        ifCounter_control_restartCounter <= auto_control_xing_in_a_bits_data[0];	// @[generators/baseband/src/main/scala/baseband/BasebandModem.scala:249:49, generators/rocket-chip/src/main/scala/tilelink/RegisterRouter.scala:82:24]
      if (out_woready_68 & auto_control_xing_in_a_bits_mask[1])	// @[generators/rocket-chip/src/main/scala/tilelink/RegisterRouter.scala:82:24]
        adcClockTuning_restart <= auto_control_xing_in_a_bits_data[8];	// @[generators/baseband/src/main/scala/baseband/BasebandModem.scala:254:39, generators/rocket-chip/src/main/scala/tilelink/RegisterRouter.scala:82:24]
      if (out_woready_68 & auto_control_xing_in_a_bits_mask[2])	// @[generators/rocket-chip/src/main/scala/tilelink/RegisterRouter.scala:82:24]
        adcClockTuning_mode <= auto_control_xing_in_a_bits_data[16];	// @[generators/baseband/src/main/scala/baseband/BasebandModem.scala:255:36, generators/rocket-chip/src/main/scala/tilelink/RegisterRouter.scala:82:24]
      if (_out_wofireMux_T_2 & auto_control_xing_in_a_bits_address[7:2] == 6'h21 & ~(|(auto_control_xing_in_a_bits_address[11:8])) & auto_control_xing_in_a_bits_mask[0])	// @[generators/rocket-chip/src/main/scala/tilelink/Edges.scala:192:34, generators/rocket-chip/src/main/scala/tilelink/RegisterRouter.scala:70:19, :82:24, src/main/scala/chisel3/util/OneHot.scala:58:35]
        adcClockTuning_duration <= auto_control_xing_in_a_bits_data[7:0];	// @[generators/baseband/src/main/scala/baseband/BasebandModem.scala:256:40, generators/rocket-chip/src/main/scala/tilelink/RegisterRouter.scala:82:24]
      if (_out_wofireMux_T_2 & auto_control_xing_in_a_bits_address[7:2] == 6'h22 & ~(|(auto_control_xing_in_a_bits_address[11:8])) & (&out_backMask))	// @[generators/rocket-chip/src/main/scala/tilelink/Edges.scala:192:34, generators/rocket-chip/src/main/scala/tilelink/RegisterRouter.scala:70:19, :82:24, src/main/scala/chisel3/util/OneHot.scala:58:35]
        adcClockTuning_k_p <= auto_control_xing_in_a_bits_data;	// @[generators/baseband/src/main/scala/baseband/BasebandModem.scala:257:35]
      if (_out_wofireMux_T_2 & auto_control_xing_in_a_bits_address[7:2] == 6'h23 & ~(|(auto_control_xing_in_a_bits_address[11:8])) & (&out_backMask))	// @[generators/rocket-chip/src/main/scala/tilelink/Edges.scala:192:34, generators/rocket-chip/src/main/scala/tilelink/RegisterRouter.scala:70:19, :82:24, src/main/scala/chisel3/util/OneHot.scala:58:35]
        adcClockTuning_k_i <= auto_control_xing_in_a_bits_data;	// @[generators/baseband/src/main/scala/baseband/BasebandModem.scala:258:35]
      if (out_woready_68 & auto_control_xing_in_a_bits_mask[3])	// @[generators/rocket-chip/src/main/scala/tilelink/RegisterRouter.scala:82:24]
        adcClockTuning_p_control_only <= auto_control_xing_in_a_bits_data[24];	// @[generators/baseband/src/main/scala/baseband/BasebandModem.scala:263:46, generators/rocket-chip/src/main/scala/tilelink/RegisterRouter.scala:82:24]
      if (_out_wofireMux_T_2 & auto_control_xing_in_a_bits_address[7:2] == 6'h24 & ~(|(auto_control_xing_in_a_bits_address[11:8])) & (&out_backMask))	// @[generators/rocket-chip/src/main/scala/tilelink/Edges.scala:192:34, generators/rocket-chip/src/main/scala/tilelink/RegisterRouter.scala:70:19, :82:24, src/main/scala/chisel3/util/OneHot.scala:58:35]
        adcClockTuning_nominal_adc_clock_freq <= auto_control_xing_in_a_bits_data;	// @[generators/baseband/src/main/scala/baseband/BasebandModem.scala:264:54]
    end
  end // always @(posedge)
  `ifdef ENABLE_INITIAL_REG_
    `ifdef FIRRTL_BEFORE_INITIAL
      `FIRRTL_BEFORE_INITIAL
    `endif // FIRRTL_BEFORE_INITIAL
    logic [31:0] _RANDOM[0:13];
    initial begin
      `ifdef INIT_RANDOM_PROLOG_
        `INIT_RANDOM_PROLOG_
      `endif // INIT_RANDOM_PROLOG_
      `ifdef RANDOMIZE_REG_INIT
        for (logic [3:0] i = 4'h0; i < 4'hE; i += 4'h1) begin
          _RANDOM[i] = `RANDOM;
        end
        additionalData = _RANDOM[4'h0];	// @[generators/baseband/src/main/scala/baseband/BasebandModem.scala:124:27]
        trim_g0 = _RANDOM[4'h1][7:0];	// @[generators/baseband/src/main/scala/baseband/BasebandModem.scala:152:24]
        trim_g1 = _RANDOM[4'h1][15:8];	// @[generators/baseband/src/main/scala/baseband/BasebandModem.scala:152:24, :153:24]
        trim_g2 = _RANDOM[4'h1][23:16];	// @[generators/baseband/src/main/scala/baseband/BasebandModem.scala:152:24, :154:24]
        debug_enable = _RANDOM[4'h1][24];	// @[generators/baseband/src/main/scala/baseband/BasebandModem.scala:152:24, :161:29]
        i_vga_gain_ctrl = {_RANDOM[4'h1][31:25], _RANDOM[4'h2][2:0]};	// @[generators/baseband/src/main/scala/baseband/BasebandModem.scala:152:24, :163:32]
        i_vgaAtten_reset = _RANDOM[4'h2][3];	// @[generators/baseband/src/main/scala/baseband/BasebandModem.scala:163:32, :164:33]
        i_vgaAtten_useAGC = _RANDOM[4'h2][4];	// @[generators/baseband/src/main/scala/baseband/BasebandModem.scala:163:32, :165:34]
        i_vgaAtten_sampleWindow = _RANDOM[4'h2][12:5];	// @[generators/baseband/src/main/scala/baseband/BasebandModem.scala:163:32, :168:40]
        i_vgaAtten_idealPeakToPeak = _RANDOM[4'h2][20:13];	// @[generators/baseband/src/main/scala/baseband/BasebandModem.scala:163:32, :169:43]
        i_vgaAtten_toleranceP2P = _RANDOM[4'h2][28:21];	// @[generators/baseband/src/main/scala/baseband/BasebandModem.scala:163:32, :170:40]
        i_vgaAtten_gainInc = {_RANDOM[4'h2][31:29], _RANDOM[4'h3][4:0]};	// @[generators/baseband/src/main/scala/baseband/BasebandModem.scala:163:32, :171:35]
        i_vgaAtten_gainDec = _RANDOM[4'h3][12:5];	// @[generators/baseband/src/main/scala/baseband/BasebandModem.scala:171:35, :172:35]
        i_bpf_chp_0 = _RANDOM[4'h3][16:13];	// @[generators/baseband/src/main/scala/baseband/BasebandModem.scala:171:35, :175:28]
        i_bpf_chp_1 = _RANDOM[4'h3][20:17];	// @[generators/baseband/src/main/scala/baseband/BasebandModem.scala:171:35, :176:28]
        i_bpf_chp_2 = _RANDOM[4'h3][24:21];	// @[generators/baseband/src/main/scala/baseband/BasebandModem.scala:171:35, :177:28]
        i_bpf_chp_3 = _RANDOM[4'h3][28:25];	// @[generators/baseband/src/main/scala/baseband/BasebandModem.scala:171:35, :178:28]
        i_bpf_chp_4 = {_RANDOM[4'h3][31:29], _RANDOM[4'h4][0]};	// @[generators/baseband/src/main/scala/baseband/BasebandModem.scala:171:35, :179:28]
        i_bpf_chp_5 = _RANDOM[4'h4][4:1];	// @[generators/baseband/src/main/scala/baseband/BasebandModem.scala:179:28, :180:28]
        i_bpf_clp_0 = _RANDOM[4'h4][8:5];	// @[generators/baseband/src/main/scala/baseband/BasebandModem.scala:179:28, :181:28]
        i_bpf_clp_1 = _RANDOM[4'h4][12:9];	// @[generators/baseband/src/main/scala/baseband/BasebandModem.scala:179:28, :182:28]
        i_bpf_clp_2 = _RANDOM[4'h4][16:13];	// @[generators/baseband/src/main/scala/baseband/BasebandModem.scala:179:28, :183:28]
        q_vga_gain_ctrl = _RANDOM[4'h4][26:17];	// @[generators/baseband/src/main/scala/baseband/BasebandModem.scala:179:28, :185:32]
        q_vgaAtten_reset = _RANDOM[4'h4][27];	// @[generators/baseband/src/main/scala/baseband/BasebandModem.scala:179:28, :186:33]
        q_vgaAtten_useAGC = _RANDOM[4'h4][28];	// @[generators/baseband/src/main/scala/baseband/BasebandModem.scala:179:28, :187:34]
        q_vgaAtten_sampleWindow = {_RANDOM[4'h4][31:29], _RANDOM[4'h5][4:0]};	// @[generators/baseband/src/main/scala/baseband/BasebandModem.scala:179:28, :190:40]
        q_vgaAtten_idealPeakToPeak = _RANDOM[4'h5][12:5];	// @[generators/baseband/src/main/scala/baseband/BasebandModem.scala:190:40, :191:43]
        q_vgaAtten_toleranceP2P = _RANDOM[4'h5][20:13];	// @[generators/baseband/src/main/scala/baseband/BasebandModem.scala:190:40, :192:40]
        q_vgaAtten_gainInc = _RANDOM[4'h5][28:21];	// @[generators/baseband/src/main/scala/baseband/BasebandModem.scala:190:40, :193:35]
        q_vgaAtten_gainDec = {_RANDOM[4'h5][31:29], _RANDOM[4'h6][4:0]};	// @[generators/baseband/src/main/scala/baseband/BasebandModem.scala:190:40, :194:35]
        q_bpf_chp_0 = _RANDOM[4'h6][8:5];	// @[generators/baseband/src/main/scala/baseband/BasebandModem.scala:194:35, :197:28]
        q_bpf_chp_1 = _RANDOM[4'h6][12:9];	// @[generators/baseband/src/main/scala/baseband/BasebandModem.scala:194:35, :198:28]
        q_bpf_chp_2 = _RANDOM[4'h6][16:13];	// @[generators/baseband/src/main/scala/baseband/BasebandModem.scala:194:35, :199:28]
        q_bpf_chp_3 = _RANDOM[4'h6][20:17];	// @[generators/baseband/src/main/scala/baseband/BasebandModem.scala:194:35, :200:28]
        q_bpf_chp_4 = _RANDOM[4'h6][24:21];	// @[generators/baseband/src/main/scala/baseband/BasebandModem.scala:194:35, :201:28]
        q_bpf_chp_5 = _RANDOM[4'h6][28:25];	// @[generators/baseband/src/main/scala/baseband/BasebandModem.scala:194:35, :202:28]
        q_bpf_clp_0 = {_RANDOM[4'h6][31:29], _RANDOM[4'h7][0]};	// @[generators/baseband/src/main/scala/baseband/BasebandModem.scala:194:35, :203:28]
        q_bpf_clp_1 = _RANDOM[4'h7][4:1];	// @[generators/baseband/src/main/scala/baseband/BasebandModem.scala:203:28, :204:28]
        q_bpf_clp_2 = _RANDOM[4'h7][8:5];	// @[generators/baseband/src/main/scala/baseband/BasebandModem.scala:203:28, :205:28]
        i_DCO_useDCO = _RANDOM[4'h7][9];	// @[generators/baseband/src/main/scala/baseband/BasebandModem.scala:203:28, :207:29]
        i_DCO_reset = _RANDOM[4'h7][10];	// @[generators/baseband/src/main/scala/baseband/BasebandModem.scala:203:28, :208:28]
        i_DCO_gain = _RANDOM[4'h7][18:11];	// @[generators/baseband/src/main/scala/baseband/BasebandModem.scala:203:28, :209:27]
        q_DCO_useDCO = _RANDOM[4'h7][19];	// @[generators/baseband/src/main/scala/baseband/BasebandModem.scala:203:28, :211:29]
        q_DCO_reset = _RANDOM[4'h7][20];	// @[generators/baseband/src/main/scala/baseband/BasebandModem.scala:203:28, :212:28]
        q_DCO_gain = _RANDOM[4'h7][28:21];	// @[generators/baseband/src/main/scala/baseband/BasebandModem.scala:203:28, :213:27]
        i_current_dac_vga_s2 = {_RANDOM[4'h7][31:29], _RANDOM[4'h8][2:0]};	// @[generators/baseband/src/main/scala/baseband/BasebandModem.scala:203:28, :216:37]
        q_current_dac_vga_s2 = _RANDOM[4'h8][8:3];	// @[generators/baseband/src/main/scala/baseband/BasebandModem.scala:216:37, :217:37]
        current_dac_vco = _RANDOM[4'h8][14:9];	// @[generators/baseband/src/main/scala/baseband/BasebandModem.scala:216:37, :220:32]
        mux_dbg_in = _RANDOM[4'h8][24:15];	// @[generators/baseband/src/main/scala/baseband/BasebandModem.scala:216:37, :222:27]
        mux_dbg_out = {_RANDOM[4'h8][31:25], _RANDOM[4'h9][2:0]};	// @[generators/baseband/src/main/scala/baseband/BasebandModem.scala:216:37, :223:28]
        enable_i_mix = _RANDOM[4'h9][3];	// @[generators/baseband/src/main/scala/baseband/BasebandModem.scala:223:28, :227:29]
        enable_i_buf = _RANDOM[4'h9][4];	// @[generators/baseband/src/main/scala/baseband/BasebandModem.scala:223:28, :228:29]
        enable_i_tia = _RANDOM[4'h9][5];	// @[generators/baseband/src/main/scala/baseband/BasebandModem.scala:223:28, :229:29]
        enable_i_vga = _RANDOM[4'h9][6];	// @[generators/baseband/src/main/scala/baseband/BasebandModem.scala:223:28, :230:29]
        enable_i_bpf = _RANDOM[4'h9][7];	// @[generators/baseband/src/main/scala/baseband/BasebandModem.scala:223:28, :231:29]
        enable_q_mix = _RANDOM[4'h9][8];	// @[generators/baseband/src/main/scala/baseband/BasebandModem.scala:223:28, :233:29]
        enable_q_buf = _RANDOM[4'h9][9];	// @[generators/baseband/src/main/scala/baseband/BasebandModem.scala:223:28, :234:29]
        enable_q_tia = _RANDOM[4'h9][10];	// @[generators/baseband/src/main/scala/baseband/BasebandModem.scala:223:28, :235:29]
        enable_q_vga = _RANDOM[4'h9][11];	// @[generators/baseband/src/main/scala/baseband/BasebandModem.scala:223:28, :236:29]
        enable_q_bpf = _RANDOM[4'h9][12];	// @[generators/baseband/src/main/scala/baseband/BasebandModem.scala:223:28, :237:29]
        enable_rx1 = _RANDOM[4'h9][13];	// @[generators/baseband/src/main/scala/baseband/BasebandModem.scala:223:28, :239:27]
        enable_rx2 = _RANDOM[4'h9][14];	// @[generators/baseband/src/main/scala/baseband/BasebandModem.scala:223:28, :240:27]
        enable_vco_lo = _RANDOM[4'h9][15];	// @[generators/baseband/src/main/scala/baseband/BasebandModem.scala:223:28, :241:30]
        enable_ext_lo = _RANDOM[4'h9][16];	// @[generators/baseband/src/main/scala/baseband/BasebandModem.scala:223:28, :242:30]
        ifCounter_ifTickThreshold = {_RANDOM[4'h9][31:17], _RANDOM[4'hA][16:0]};	// @[generators/baseband/src/main/scala/baseband/BasebandModem.scala:223:28, :248:42]
        ifCounter_control_restartCounter = _RANDOM[4'hA][17];	// @[generators/baseband/src/main/scala/baseband/BasebandModem.scala:248:42, :249:49]
        adcClockTuning_restart = _RANDOM[4'hA][18];	// @[generators/baseband/src/main/scala/baseband/BasebandModem.scala:248:42, :254:39]
        adcClockTuning_mode = _RANDOM[4'hA][19];	// @[generators/baseband/src/main/scala/baseband/BasebandModem.scala:248:42, :255:36]
        adcClockTuning_duration = _RANDOM[4'hA][27:20];	// @[generators/baseband/src/main/scala/baseband/BasebandModem.scala:248:42, :256:40]
        adcClockTuning_k_p = {_RANDOM[4'hA][31:28], _RANDOM[4'hB][27:0]};	// @[generators/baseband/src/main/scala/baseband/BasebandModem.scala:248:42, :257:35]
        adcClockTuning_k_i = {_RANDOM[4'hB][31:28], _RANDOM[4'hC][27:0]};	// @[generators/baseband/src/main/scala/baseband/BasebandModem.scala:257:35, :258:35]
        adcClockTuning_p_control_only = _RANDOM[4'hC][28];	// @[generators/baseband/src/main/scala/baseband/BasebandModem.scala:258:35, :263:46]
        adcClockTuning_nominal_adc_clock_freq = {_RANDOM[4'hC][31:29], _RANDOM[4'hD][28:0]};	// @[generators/baseband/src/main/scala/baseband/BasebandModem.scala:258:35, :264:54]
      `endif // RANDOMIZE_REG_INIT
    end // initial
    `ifdef FIRRTL_AFTER_INITIAL
      `FIRRTL_AFTER_INITIAL
    `endif // FIRRTL_AFTER_INITIAL
  `endif // ENABLE_INITIAL_REG_
  IntSyncCrossingSource_9 intsource (	// @[generators/rocket-chip/src/main/scala/interrupts/Crossing.scala:28:31]
    .clock           (clock),
    .reset           (reset),
    .auto_in_0       (io_back_interrupt_rxError),
    .auto_in_1       (io_back_interrupt_rxStart),
    .auto_in_2       (io_back_interrupt_rxFinish),
    .auto_in_3       (io_back_interrupt_txError),
    .auto_in_4       (io_back_interrupt_txFinish),
    .auto_in_5       (io_back_ifCounter_output_thresholdInterrupt),
    .auto_out_sync_0 (auto_int_xing_out_sync_0),
    .auto_out_sync_1 (auto_int_xing_out_sync_1),
    .auto_out_sync_2 (auto_int_xing_out_sync_2),
    .auto_out_sync_3 (auto_int_xing_out_sync_3),
    .auto_out_sync_4 (auto_int_xing_out_sync_4),
    .auto_out_sync_5 (auto_int_xing_out_sync_5)
  );
  TLMonitor_66 monitor (	// @[generators/rocket-chip/src/main/scala/tilelink/Nodes.scala:24:25]
    .clock                (clock),
    .reset                (reset),
    .io_in_a_ready        (out_front_ready),	// @[generators/rocket-chip/src/main/scala/tilelink/RegisterRouter.scala:82:24]
    .io_in_a_valid        (auto_control_xing_in_a_valid),
    .io_in_a_bits_opcode  (auto_control_xing_in_a_bits_opcode),
    .io_in_a_bits_param   (auto_control_xing_in_a_bits_param),
    .io_in_a_bits_size    (auto_control_xing_in_a_bits_size),
    .io_in_a_bits_source  (auto_control_xing_in_a_bits_source),
    .io_in_a_bits_address (auto_control_xing_in_a_bits_address),
    .io_in_a_bits_mask    (auto_control_xing_in_a_bits_mask),
    .io_in_a_bits_corrupt (auto_control_xing_in_a_bits_corrupt),
    .io_in_d_ready        (auto_control_xing_in_d_ready),
    .io_in_d_valid        (out_valid),	// @[generators/rocket-chip/src/main/scala/tilelink/RegisterRouter.scala:82:24]
    .io_in_d_bits_opcode  (controlXingIn_d_bits_opcode),	// @[generators/rocket-chip/src/main/scala/tilelink/RegisterRouter.scala:100:19]
    .io_in_d_bits_size    (auto_control_xing_in_a_bits_size),
    .io_in_d_bits_source  (auto_control_xing_in_a_bits_source)
  );
  assign auto_control_xing_in_a_ready = out_front_ready;	// @[generators/rocket-chip/src/main/scala/tilelink/RegisterRouter.scala:82:24]
  assign auto_control_xing_in_d_valid = out_valid;	// @[generators/rocket-chip/src/main/scala/tilelink/RegisterRouter.scala:82:24]
  assign auto_control_xing_in_d_bits_opcode = controlXingIn_d_bits_opcode;	// @[generators/rocket-chip/src/main/scala/tilelink/RegisterRouter.scala:100:19]
  assign auto_control_xing_in_d_bits_size = auto_control_xing_in_a_bits_size;
  assign auto_control_xing_in_d_bits_source = auto_control_xing_in_a_bits_source;
  assign auto_control_xing_in_d_bits_data = _GEN_1[auto_control_xing_in_a_bits_address[7:2]] ? _GEN_2[auto_control_xing_in_a_bits_address[7:2]] : 32'h0;	// @[generators/rocket-chip/src/main/scala/tilelink/RegisterRouter.scala:82:24, generators/rocket-chip/src/main/scala/util/MuxLiteral.scala:49:{10,48}]
  assign io_back_cmd_valid = _out_wofireMux_T_2 & out_backSel_0 & ~(|(auto_control_xing_in_a_bits_address[11:8])) & (&out_backMask);	// @[generators/rocket-chip/src/main/scala/tilelink/Edges.scala:192:34, generators/rocket-chip/src/main/scala/tilelink/RegisterRouter.scala:70:19, :82:24]
  assign io_back_cmd_bits_inst_primaryInst = auto_control_xing_in_a_bits_data[3:0];	// @[generators/baseband/src/main/scala/baseband/BasebandModem.scala:130:49]
  assign io_back_cmd_bits_inst_secondaryInst = auto_control_xing_in_a_bits_data[7:4];	// @[generators/baseband/src/main/scala/baseband/BasebandModem.scala:131:51]
  assign io_back_cmd_bits_inst_data = auto_control_xing_in_a_bits_data[31:8];	// @[generators/baseband/src/main/scala/baseband/BasebandModem.scala:132:42]
  assign io_back_cmd_bits_additionalData = additionalData;	// @[generators/baseband/src/main/scala/baseband/BasebandModem.scala:124:27]
  assign io_back_lutCmd_valid = _out_wofireMux_T_2 & out_backSel_20 & ~(|(auto_control_xing_in_a_bits_address[11:8])) & (&out_backMask);	// @[generators/rocket-chip/src/main/scala/tilelink/Edges.scala:192:34, generators/rocket-chip/src/main/scala/tilelink/RegisterRouter.scala:70:19, :82:24]
  assign io_back_lutCmd_bits_lut = auto_control_xing_in_a_bits_data[3:0];	// @[generators/baseband/src/main/scala/baseband/BasebandModem.scala:138:41]
  assign io_back_lutCmd_bits_address = auto_control_xing_in_a_bits_data[9:4];	// @[generators/baseband/src/main/scala/baseband/BasebandModem.scala:139:45]
  assign io_back_lutCmd_bits_value = auto_control_xing_in_a_bits_data[31:10];	// @[generators/baseband/src/main/scala/baseband/BasebandModem.scala:140:43]
  assign io_back_firCmd_valid = _out_wofireMux_T_2 & out_backSel_24 & ~(|(auto_control_xing_in_a_bits_address[11:8])) & (&out_backMask);	// @[generators/rocket-chip/src/main/scala/tilelink/Edges.scala:192:34, generators/rocket-chip/src/main/scala/tilelink/RegisterRouter.scala:70:19, :82:24]
  assign io_back_firCmd_bits_fir = auto_control_xing_in_a_bits_data[3:0];	// @[generators/baseband/src/main/scala/baseband/BasebandModem.scala:146:41]
  assign io_back_firCmd_bits_coeff = auto_control_xing_in_a_bits_data[9:4];	// @[generators/baseband/src/main/scala/baseband/BasebandModem.scala:147:43]
  assign io_back_firCmd_bits_value = auto_control_xing_in_a_bits_data[31:10];	// @[generators/baseband/src/main/scala/baseband/BasebandModem.scala:148:43]
  assign io_back_messages_rxErrorMessage_ready = _out_rofireMux_T_1 & out_backSel_21 & ~(|(auto_control_xing_in_a_bits_address[11:8])) & (|out_backMask);	// @[generators/rocket-chip/src/main/scala/tilelink/Edges.scala:192:34, generators/rocket-chip/src/main/scala/tilelink/RegisterRouter.scala:70:19, :82:24]
  assign io_back_messages_rxFinishMessage_ready = _out_rofireMux_T_1 & out_backSel_22 & ~(|(auto_control_xing_in_a_bits_address[11:8])) & (|out_backMask);	// @[generators/rocket-chip/src/main/scala/tilelink/Edges.scala:192:34, generators/rocket-chip/src/main/scala/tilelink/RegisterRouter.scala:70:19, :82:24]
  assign io_back_messages_txErrorMessage_ready = _out_rofireMux_T_1 & out_backSel_23 & ~(|(auto_control_xing_in_a_bits_address[11:8])) & (|out_backMask);	// @[generators/rocket-chip/src/main/scala/tilelink/Edges.scala:192:34, generators/rocket-chip/src/main/scala/tilelink/RegisterRouter.scala:70:19, :82:24]
  assign io_back_ifCounter_input_ifTickThreshold = ifCounter_ifTickThreshold;	// @[generators/baseband/src/main/scala/baseband/BasebandModem.scala:248:42]
  assign io_back_ifCounter_input_control_restartCounter = ifCounter_control_restartCounter;	// @[generators/baseband/src/main/scala/baseband/BasebandModem.scala:249:49]
  assign io_back_adcClockTuning_input_restart = adcClockTuning_restart;	// @[generators/baseband/src/main/scala/baseband/BasebandModem.scala:254:39]
  assign io_back_adcClockTuning_input_mode = adcClockTuning_mode;	// @[generators/baseband/src/main/scala/baseband/BasebandModem.scala:255:36]
  assign io_back_adcClockTuning_input_duration = adcClockTuning_duration;	// @[generators/baseband/src/main/scala/baseband/BasebandModem.scala:256:40]
  assign io_back_adcClockTuning_input_k_p = adcClockTuning_k_p;	// @[generators/baseband/src/main/scala/baseband/BasebandModem.scala:257:35]
  assign io_back_adcClockTuning_input_k_i = adcClockTuning_k_i;	// @[generators/baseband/src/main/scala/baseband/BasebandModem.scala:258:35]
  assign io_back_adcClockTuning_input_p_control_only = adcClockTuning_p_control_only;	// @[generators/baseband/src/main/scala/baseband/BasebandModem.scala:263:46]
  assign io_back_adcClockTuning_input_nominal_adc_clock_freq = adcClockTuning_nominal_adc_clock_freq;	// @[generators/baseband/src/main/scala/baseband/BasebandModem.scala:264:54]
  assign io_tuning_trim_g0 = trim_g0;	// @[generators/baseband/src/main/scala/baseband/BasebandModem.scala:152:24]
  assign io_tuning_trim_g2 = trim_g2;	// @[generators/baseband/src/main/scala/baseband/BasebandModem.scala:154:24]
  assign io_tuning_i_vga_gain_ctrl = i_vga_gain_ctrl;	// @[generators/baseband/src/main/scala/baseband/BasebandModem.scala:163:32]
  assign io_tuning_i_bpf_chp_0 = i_bpf_chp_0;	// @[generators/baseband/src/main/scala/baseband/BasebandModem.scala:175:28]
  assign io_tuning_i_bpf_chp_1 = i_bpf_chp_1;	// @[generators/baseband/src/main/scala/baseband/BasebandModem.scala:176:28]
  assign io_tuning_i_bpf_chp_2 = i_bpf_chp_2;	// @[generators/baseband/src/main/scala/baseband/BasebandModem.scala:177:28]
  assign io_tuning_i_bpf_chp_3 = i_bpf_chp_3;	// @[generators/baseband/src/main/scala/baseband/BasebandModem.scala:178:28]
  assign io_tuning_i_bpf_chp_4 = i_bpf_chp_4;	// @[generators/baseband/src/main/scala/baseband/BasebandModem.scala:179:28]
  assign io_tuning_i_bpf_chp_5 = i_bpf_chp_5;	// @[generators/baseband/src/main/scala/baseband/BasebandModem.scala:180:28]
  assign io_tuning_i_bpf_clp_0 = i_bpf_clp_0;	// @[generators/baseband/src/main/scala/baseband/BasebandModem.scala:181:28]
  assign io_tuning_i_bpf_clp_1 = i_bpf_clp_1;	// @[generators/baseband/src/main/scala/baseband/BasebandModem.scala:182:28]
  assign io_tuning_i_bpf_clp_2 = i_bpf_clp_2;	// @[generators/baseband/src/main/scala/baseband/BasebandModem.scala:183:28]
  assign io_tuning_q_vga_gain_ctrl = q_vga_gain_ctrl;	// @[generators/baseband/src/main/scala/baseband/BasebandModem.scala:185:32]
  assign io_tuning_q_bpf_chp_0 = q_bpf_chp_0;	// @[generators/baseband/src/main/scala/baseband/BasebandModem.scala:197:28]
  assign io_tuning_q_bpf_chp_1 = q_bpf_chp_1;	// @[generators/baseband/src/main/scala/baseband/BasebandModem.scala:198:28]
  assign io_tuning_q_bpf_chp_2 = q_bpf_chp_2;	// @[generators/baseband/src/main/scala/baseband/BasebandModem.scala:199:28]
  assign io_tuning_q_bpf_chp_3 = q_bpf_chp_3;	// @[generators/baseband/src/main/scala/baseband/BasebandModem.scala:200:28]
  assign io_tuning_q_bpf_chp_4 = q_bpf_chp_4;	// @[generators/baseband/src/main/scala/baseband/BasebandModem.scala:201:28]
  assign io_tuning_q_bpf_chp_5 = q_bpf_chp_5;	// @[generators/baseband/src/main/scala/baseband/BasebandModem.scala:202:28]
  assign io_tuning_q_bpf_clp_0 = q_bpf_clp_0;	// @[generators/baseband/src/main/scala/baseband/BasebandModem.scala:203:28]
  assign io_tuning_q_bpf_clp_1 = q_bpf_clp_1;	// @[generators/baseband/src/main/scala/baseband/BasebandModem.scala:204:28]
  assign io_tuning_q_bpf_clp_2 = q_bpf_clp_2;	// @[generators/baseband/src/main/scala/baseband/BasebandModem.scala:205:28]
  assign io_tuning_current_dac_i_vga_s2 = i_current_dac_vga_s2;	// @[generators/baseband/src/main/scala/baseband/BasebandModem.scala:216:37]
  assign io_tuning_current_dac_q_vga_s2 = q_current_dac_vga_s2;	// @[generators/baseband/src/main/scala/baseband/BasebandModem.scala:217:37]
  assign io_tuning_current_dac_vco = current_dac_vco;	// @[generators/baseband/src/main/scala/baseband/BasebandModem.scala:220:32]
  assign io_tuning_enable_i_mix = enable_i_mix;	// @[generators/baseband/src/main/scala/baseband/BasebandModem.scala:227:29]
  assign io_tuning_enable_i_buf = enable_i_buf;	// @[generators/baseband/src/main/scala/baseband/BasebandModem.scala:228:29]
  assign io_tuning_enable_i_tia = enable_i_tia;	// @[generators/baseband/src/main/scala/baseband/BasebandModem.scala:229:29]
  assign io_tuning_enable_i_vga = enable_i_vga;	// @[generators/baseband/src/main/scala/baseband/BasebandModem.scala:230:29]
  assign io_tuning_enable_i_bpf = enable_i_bpf;	// @[generators/baseband/src/main/scala/baseband/BasebandModem.scala:231:29]
  assign io_tuning_enable_q_mix = enable_q_mix;	// @[generators/baseband/src/main/scala/baseband/BasebandModem.scala:233:29]
  assign io_tuning_enable_q_buf = enable_q_buf;	// @[generators/baseband/src/main/scala/baseband/BasebandModem.scala:234:29]
  assign io_tuning_enable_q_tia = enable_q_tia;	// @[generators/baseband/src/main/scala/baseband/BasebandModem.scala:235:29]
  assign io_tuning_enable_q_vga = enable_q_vga;	// @[generators/baseband/src/main/scala/baseband/BasebandModem.scala:236:29]
  assign io_tuning_enable_q_bpf = enable_q_bpf;	// @[generators/baseband/src/main/scala/baseband/BasebandModem.scala:237:29]
  assign io_tuning_enable_rx1 = enable_rx1;	// @[generators/baseband/src/main/scala/baseband/BasebandModem.scala:239:27]
  assign io_tuning_enable_rx2 = enable_rx2;	// @[generators/baseband/src/main/scala/baseband/BasebandModem.scala:240:27]
  assign io_tuning_enable_vco_lo = enable_vco_lo;	// @[generators/baseband/src/main/scala/baseband/BasebandModem.scala:241:30]
  assign io_tuning_enable_ext_lo = enable_ext_lo;	// @[generators/baseband/src/main/scala/baseband/BasebandModem.scala:242:30]
  assign io_tuning_mux_dbg_in = mux_dbg_in;	// @[generators/baseband/src/main/scala/baseband/BasebandModem.scala:222:27]
  assign io_tuning_mux_dbg_out = mux_dbg_out;	// @[generators/baseband/src/main/scala/baseband/BasebandModem.scala:223:28]
  assign io_tuning_adc_clk_tuning = {1'h0, io_back_adcClockTuning_output_control_word};	// @[generators/baseband/src/main/scala/baseband/BasebandModem.scala:341:34, generators/rocket-chip/src/main/scala/tilelink/Bundles.scala:259:74]
  assign io_tuningControl_i_AGC_control_sampleWindow = i_vgaAtten_sampleWindow;	// @[generators/baseband/src/main/scala/baseband/BasebandModem.scala:168:40]
  assign io_tuningControl_i_AGC_control_idealPeakToPeak = i_vgaAtten_idealPeakToPeak;	// @[generators/baseband/src/main/scala/baseband/BasebandModem.scala:169:43]
  assign io_tuningControl_i_AGC_control_toleranceP2P = i_vgaAtten_toleranceP2P;	// @[generators/baseband/src/main/scala/baseband/BasebandModem.scala:170:40]
  assign io_tuningControl_i_AGC_control_gainInc = i_vgaAtten_gainInc;	// @[generators/baseband/src/main/scala/baseband/BasebandModem.scala:171:35]
  assign io_tuningControl_i_AGC_control_gainDec = i_vgaAtten_gainDec;	// @[generators/baseband/src/main/scala/baseband/BasebandModem.scala:172:35]
  assign io_tuningControl_i_AGC_control_reset = i_vgaAtten_reset;	// @[generators/baseband/src/main/scala/baseband/BasebandModem.scala:164:33]
  assign io_tuningControl_i_AGC_useAGC = i_vgaAtten_useAGC;	// @[generators/baseband/src/main/scala/baseband/BasebandModem.scala:165:34]
  assign io_tuningControl_i_DCO_control_gain = {1'h0, i_DCO_gain};	// @[generators/baseband/src/main/scala/baseband/BasebandModem.scala:209:27, :327:45, generators/rocket-chip/src/main/scala/tilelink/Bundles.scala:259:74]
  assign io_tuningControl_i_DCO_control_reset = i_DCO_reset;	// @[generators/baseband/src/main/scala/baseband/BasebandModem.scala:208:28]
  assign io_tuningControl_i_DCO_useDCO = i_DCO_useDCO;	// @[generators/baseband/src/main/scala/baseband/BasebandModem.scala:207:29]
  assign io_tuningControl_q_AGC_control_sampleWindow = q_vgaAtten_sampleWindow;	// @[generators/baseband/src/main/scala/baseband/BasebandModem.scala:190:40]
  assign io_tuningControl_q_AGC_control_idealPeakToPeak = q_vgaAtten_idealPeakToPeak;	// @[generators/baseband/src/main/scala/baseband/BasebandModem.scala:191:43]
  assign io_tuningControl_q_AGC_control_toleranceP2P = q_vgaAtten_toleranceP2P;	// @[generators/baseband/src/main/scala/baseband/BasebandModem.scala:192:40]
  assign io_tuningControl_q_AGC_control_gainInc = q_vgaAtten_gainInc;	// @[generators/baseband/src/main/scala/baseband/BasebandModem.scala:193:35]
  assign io_tuningControl_q_AGC_control_gainDec = q_vgaAtten_gainDec;	// @[generators/baseband/src/main/scala/baseband/BasebandModem.scala:194:35]
  assign io_tuningControl_q_AGC_control_reset = q_vgaAtten_reset;	// @[generators/baseband/src/main/scala/baseband/BasebandModem.scala:186:33]
  assign io_tuningControl_q_AGC_useAGC = q_vgaAtten_useAGC;	// @[generators/baseband/src/main/scala/baseband/BasebandModem.scala:187:34]
  assign io_tuningControl_q_DCO_control_gain = {1'h0, q_DCO_gain};	// @[generators/baseband/src/main/scala/baseband/BasebandModem.scala:213:27, :331:45, generators/rocket-chip/src/main/scala/tilelink/Bundles.scala:259:74]
  assign io_tuningControl_q_DCO_control_reset = q_DCO_reset;	// @[generators/baseband/src/main/scala/baseband/BasebandModem.scala:212:28]
  assign io_tuningControl_q_DCO_useDCO = q_DCO_useDCO;	// @[generators/baseband/src/main/scala/baseband/BasebandModem.scala:211:29]
  assign io_tuningControl_debug_enabled = debug_enable;	// @[generators/baseband/src/main/scala/baseband/BasebandModem.scala:161:29]
endmodule

