// Generated by CIRCT unknown git version
// Standard header to adapt well known macros for register randomization.
`ifndef RANDOMIZE
  `ifdef RANDOMIZE_MEM_INIT
    `define RANDOMIZE
  `endif // RANDOMIZE_MEM_INIT
`endif // not def RANDOMIZE
`ifndef RANDOMIZE
  `ifdef RANDOMIZE_REG_INIT
    `define RANDOMIZE
  `endif // RANDOMIZE_REG_INIT
`endif // not def RANDOMIZE

// RANDOM may be set to an expression that produces a 32-bit random unsigned value.
`ifndef RANDOM
  `define RANDOM $random
`endif // not def RANDOM

// Users can define INIT_RANDOM as general code that gets injected into the
// initializer block for modules with registers.
`ifndef INIT_RANDOM
  `define INIT_RANDOM
`endif // not def INIT_RANDOM

// If using random initialization, you can also define RANDOMIZE_DELAY to
// customize the delay used, otherwise 0.002 is used.
`ifndef RANDOMIZE_DELAY
  `define RANDOMIZE_DELAY 0.002
`endif // not def RANDOMIZE_DELAY

// Define INIT_RANDOM_PROLOG_ for use in our modules below.
`ifndef INIT_RANDOM_PROLOG_
  `ifdef RANDOMIZE
    `ifdef VERILATOR
      `define INIT_RANDOM_PROLOG_ `INIT_RANDOM
    `else  // VERILATOR
      `define INIT_RANDOM_PROLOG_ `INIT_RANDOM #`RANDOMIZE_DELAY begin end
    `endif // VERILATOR
  `else  // RANDOMIZE
    `define INIT_RANDOM_PROLOG_
  `endif // RANDOMIZE
`endif // not def INIT_RANDOM_PROLOG_

// Include register initializers in init blocks unless synthesis is set
`ifndef SYNTHESIS
  `ifndef ENABLE_INITIAL_REG_
    `define ENABLE_INITIAL_REG_
  `endif // not def ENABLE_INITIAL_REG_
`endif // not def SYNTHESIS

// Include rmemory initializers in init blocks unless synthesis is set
`ifndef SYNTHESIS
  `ifndef ENABLE_INITIAL_MEM_
    `define ENABLE_INITIAL_MEM_
  `endif // not def ENABLE_INITIAL_MEM_
`endif // not def SYNTHESIS

// Standard header to adapt well known macros for prints and assertions.

// Users can define 'PRINTF_COND' to add an extra gate to prints.
`ifndef PRINTF_COND_
  `ifdef PRINTF_COND
    `define PRINTF_COND_ (`PRINTF_COND)
  `else  // PRINTF_COND
    `define PRINTF_COND_ 1
  `endif // PRINTF_COND
`endif // not def PRINTF_COND_

// Users can define 'ASSERT_VERBOSE_COND' to add an extra gate to assert error printing.
`ifndef ASSERT_VERBOSE_COND_
  `ifdef ASSERT_VERBOSE_COND
    `define ASSERT_VERBOSE_COND_ (`ASSERT_VERBOSE_COND)
  `else  // ASSERT_VERBOSE_COND
    `define ASSERT_VERBOSE_COND_ 1
  `endif // ASSERT_VERBOSE_COND
`endif // not def ASSERT_VERBOSE_COND_

// Users can define 'STOP_COND' to add an extra gate to stop conditions.
`ifndef STOP_COND_
  `ifdef STOP_COND
    `define STOP_COND_ (`STOP_COND)
  `else  // STOP_COND
    `define STOP_COND_ 1
  `endif // STOP_COND
`endif // not def STOP_COND_

module DMAPacketAssembler(
  input         clock,
                reset,
  output        io_producer_data_ready,	// @[generators/dma/src/main/scala/dma/DMA.scala:35:14]
  input         io_producer_data_valid,	// @[generators/dma/src/main/scala/dma/DMA.scala:35:14]
  input  [7:0]  io_producer_data_bits,	// @[generators/dma/src/main/scala/dma/DMA.scala:35:14]
  input         io_producer_done,	// @[generators/dma/src/main/scala/dma/DMA.scala:35:14]
                io_dmaOut_ready,	// @[generators/dma/src/main/scala/dma/DMA.scala:35:14]
  output        io_dmaOut_valid,	// @[generators/dma/src/main/scala/dma/DMA.scala:35:14]
  output [31:0] io_dmaOut_bits_data,	// @[generators/dma/src/main/scala/dma/DMA.scala:35:14]
  output [2:0]  io_dmaOut_bits_size	// @[generators/dma/src/main/scala/dma/DMA.scala:35:14]
);

  reg  [2:0]  counter;	// @[generators/dma/src/main/scala/dma/DMA.scala:43:24]
  reg  [31:0] packedData;	// @[generators/dma/src/main/scala/dma/DMA.scala:44:27]
  wire        io_dmaOut_valid_0 = counter == 3'h4 | (|counter) & io_producer_done;	// @[generators/dma/src/main/scala/dma/DMA.scala:43:24, :56:{30,46,57,65}]
  wire        _GEN = ~io_dmaOut_valid_0 & io_producer_data_valid;	// @[generators/dma/src/main/scala/dma/DMA.scala:56:46, :60:29, src/main/scala/chisel3/util/Decoupled.scala:52:35]
  wire [70:0] _packedData_T_1 = {63'h0, io_producer_data_bits} << {65'h0, counter, 3'h0};	// @[generators/dma/src/main/scala/dma/DMA.scala:43:24, :47:55]
  always @(posedge clock) begin
    if (reset) begin
      counter <= 3'h0;	// @[generators/dma/src/main/scala/dma/DMA.scala:43:24]
      packedData <= 32'h0;	// @[generators/dma/src/main/scala/dma/DMA.scala:44:27]
    end
    else if (io_dmaOut_ready & io_dmaOut_valid_0) begin	// @[generators/dma/src/main/scala/dma/DMA.scala:56:46, src/main/scala/chisel3/util/Decoupled.scala:52:35]
      counter <= 3'h0;	// @[generators/dma/src/main/scala/dma/DMA.scala:43:24]
      packedData <= 32'h0;	// @[generators/dma/src/main/scala/dma/DMA.scala:44:27]
    end
    else begin	// @[src/main/scala/chisel3/util/Decoupled.scala:52:35]
      if (_GEN)	// @[src/main/scala/chisel3/util/Decoupled.scala:52:35]
        counter <= counter + 3'h1;	// @[generators/dma/src/main/scala/dma/DMA.scala:43:24, :48:24]
      packedData <= {32{_GEN}} & _packedData_T_1[31:0] | packedData;	// @[generators/dma/src/main/scala/dma/DMA.scala:44:27, :46:34, :47:{16,55}, src/main/scala/chisel3/util/Decoupled.scala:52:35]
    end
  end // always @(posedge)
  `ifdef ENABLE_INITIAL_REG_
    `ifdef FIRRTL_BEFORE_INITIAL
      `FIRRTL_BEFORE_INITIAL
    `endif // FIRRTL_BEFORE_INITIAL
    logic [31:0] _RANDOM[0:1];
    initial begin
      `ifdef INIT_RANDOM_PROLOG_
        `INIT_RANDOM_PROLOG_
      `endif // INIT_RANDOM_PROLOG_
      `ifdef RANDOMIZE_REG_INIT
        for (logic [1:0] i = 2'h0; i < 2'h2; i += 2'h1) begin
          _RANDOM[i[0]] = `RANDOM;
        end
        counter = _RANDOM[1'h0][2:0];	// @[generators/dma/src/main/scala/dma/DMA.scala:43:24]
        packedData = {_RANDOM[1'h0][31:3], _RANDOM[1'h1][2:0]};	// @[generators/dma/src/main/scala/dma/DMA.scala:43:24, :44:27]
      `endif // RANDOMIZE_REG_INIT
    end // initial
    `ifdef FIRRTL_AFTER_INITIAL
      `FIRRTL_AFTER_INITIAL
    `endif // FIRRTL_AFTER_INITIAL
  `endif // ENABLE_INITIAL_REG_
  assign io_producer_data_ready = ~io_dmaOut_valid_0;	// @[generators/dma/src/main/scala/dma/DMA.scala:56:46, :60:29]
  assign io_dmaOut_valid = io_dmaOut_valid_0;	// @[generators/dma/src/main/scala/dma/DMA.scala:56:46]
  assign io_dmaOut_bits_data = packedData;	// @[generators/dma/src/main/scala/dma/DMA.scala:44:27]
  assign io_dmaOut_bits_size = counter;	// @[generators/dma/src/main/scala/dma/DMA.scala:43:24]
endmodule

