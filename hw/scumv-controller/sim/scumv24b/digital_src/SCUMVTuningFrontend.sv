// Generated by CIRCT unknown git version
// Standard header to adapt well known macros for register randomization.
`ifndef RANDOMIZE
  `ifdef RANDOMIZE_MEM_INIT
    `define RANDOMIZE
  `endif // RANDOMIZE_MEM_INIT
`endif // not def RANDOMIZE
`ifndef RANDOMIZE
  `ifdef RANDOMIZE_REG_INIT
    `define RANDOMIZE
  `endif // RANDOMIZE_REG_INIT
`endif // not def RANDOMIZE

// RANDOM may be set to an expression that produces a 32-bit random unsigned value.
`ifndef RANDOM
  `define RANDOM $random
`endif // not def RANDOM

// Users can define INIT_RANDOM as general code that gets injected into the
// initializer block for modules with registers.
`ifndef INIT_RANDOM
  `define INIT_RANDOM
`endif // not def INIT_RANDOM

// If using random initialization, you can also define RANDOMIZE_DELAY to
// customize the delay used, otherwise 0.002 is used.
`ifndef RANDOMIZE_DELAY
  `define RANDOMIZE_DELAY 0.002
`endif // not def RANDOMIZE_DELAY

// Define INIT_RANDOM_PROLOG_ for use in our modules below.
`ifndef INIT_RANDOM_PROLOG_
  `ifdef RANDOMIZE
    `ifdef VERILATOR
      `define INIT_RANDOM_PROLOG_ `INIT_RANDOM
    `else  // VERILATOR
      `define INIT_RANDOM_PROLOG_ `INIT_RANDOM #`RANDOMIZE_DELAY begin end
    `endif // VERILATOR
  `else  // RANDOMIZE
    `define INIT_RANDOM_PROLOG_
  `endif // RANDOMIZE
`endif // not def INIT_RANDOM_PROLOG_

// Include register initializers in init blocks unless synthesis is set
`ifndef SYNTHESIS
  `ifndef ENABLE_INITIAL_REG_
    `define ENABLE_INITIAL_REG_
  `endif // not def ENABLE_INITIAL_REG_
`endif // not def SYNTHESIS

// Include rmemory initializers in init blocks unless synthesis is set
`ifndef SYNTHESIS
  `ifndef ENABLE_INITIAL_MEM_
    `define ENABLE_INITIAL_MEM_
  `endif // not def ENABLE_INITIAL_MEM_
`endif // not def SYNTHESIS

// Standard header to adapt well known macros for prints and assertions.

// Users can define 'PRINTF_COND' to add an extra gate to prints.
`ifndef PRINTF_COND_
  `ifdef PRINTF_COND
    `define PRINTF_COND_ (`PRINTF_COND)
  `else  // PRINTF_COND
    `define PRINTF_COND_ 1
  `endif // PRINTF_COND
`endif // not def PRINTF_COND_

// Users can define 'ASSERT_VERBOSE_COND' to add an extra gate to assert error printing.
`ifndef ASSERT_VERBOSE_COND_
  `ifdef ASSERT_VERBOSE_COND
    `define ASSERT_VERBOSE_COND_ (`ASSERT_VERBOSE_COND)
  `else  // ASSERT_VERBOSE_COND
    `define ASSERT_VERBOSE_COND_ 1
  `endif // ASSERT_VERBOSE_COND
`endif // not def ASSERT_VERBOSE_COND_

// Users can define 'STOP_COND' to add an extra gate to stop conditions.
`ifndef STOP_COND_
  `ifdef STOP_COND
    `define STOP_COND_ (`STOP_COND)
  `else  // STOP_COND
    `define STOP_COND_ 1
  `endif // STOP_COND
`endif // not def STOP_COND_

module SCUMVTuningFrontend(
  input         clock,
                reset,
  output        auto_control_xing_in_a_ready,	// @[generators/rocket-chip/src/main/scala/diplomacy/LazyModule.scala:366:18]
  input         auto_control_xing_in_a_valid,	// @[generators/rocket-chip/src/main/scala/diplomacy/LazyModule.scala:366:18]
  input  [2:0]  auto_control_xing_in_a_bits_opcode,	// @[generators/rocket-chip/src/main/scala/diplomacy/LazyModule.scala:366:18]
                auto_control_xing_in_a_bits_param,	// @[generators/rocket-chip/src/main/scala/diplomacy/LazyModule.scala:366:18]
  input  [1:0]  auto_control_xing_in_a_bits_size,	// @[generators/rocket-chip/src/main/scala/diplomacy/LazyModule.scala:366:18]
  input  [15:0] auto_control_xing_in_a_bits_source,	// @[generators/rocket-chip/src/main/scala/diplomacy/LazyModule.scala:366:18]
                auto_control_xing_in_a_bits_address,	// @[generators/rocket-chip/src/main/scala/diplomacy/LazyModule.scala:366:18]
  input  [3:0]  auto_control_xing_in_a_bits_mask,	// @[generators/rocket-chip/src/main/scala/diplomacy/LazyModule.scala:366:18]
  input  [31:0] auto_control_xing_in_a_bits_data,	// @[generators/rocket-chip/src/main/scala/diplomacy/LazyModule.scala:366:18]
  input         auto_control_xing_in_a_bits_corrupt,	// @[generators/rocket-chip/src/main/scala/diplomacy/LazyModule.scala:366:18]
                auto_control_xing_in_d_ready,	// @[generators/rocket-chip/src/main/scala/diplomacy/LazyModule.scala:366:18]
  output        auto_control_xing_in_d_valid,	// @[generators/rocket-chip/src/main/scala/diplomacy/LazyModule.scala:366:18]
  output [2:0]  auto_control_xing_in_d_bits_opcode,	// @[generators/rocket-chip/src/main/scala/diplomacy/LazyModule.scala:366:18]
  output [1:0]  auto_control_xing_in_d_bits_size,	// @[generators/rocket-chip/src/main/scala/diplomacy/LazyModule.scala:366:18]
  output [15:0] auto_control_xing_in_d_bits_source,	// @[generators/rocket-chip/src/main/scala/diplomacy/LazyModule.scala:366:18]
  output [31:0] auto_control_xing_in_d_bits_data,	// @[generators/rocket-chip/src/main/scala/diplomacy/LazyModule.scala:366:18]
  output [8:0]  io_oscillator_tuneOut_adc_coarse,	// @[generators/scumvtuning/src/main/scala/SCUMVTuning.scala:114:13]
  output [5:0]  io_oscillator_tuneOut_dig,	// @[generators/scumvtuning/src/main/scala/SCUMVTuning.scala:114:13]
  output [1:0]  io_oscillator_tuneOut_cpuSel,	// @[generators/scumvtuning/src/main/scala/SCUMVTuning.scala:114:13]
  output        io_oscillator_reset_adc,	// @[generators/scumvtuning/src/main/scala/SCUMVTuning.scala:114:13]
                io_oscillator_reset_dig,	// @[generators/scumvtuning/src/main/scala/SCUMVTuning.scala:114:13]
  output [4:0]  io_supply_bgr_tempCtrl,	// @[generators/scumvtuning/src/main/scala/SCUMVTuning.scala:114:13]
                io_supply_bgr_vrefCtrl,	// @[generators/scumvtuning/src/main/scala/SCUMVTuning.scala:114:13]
                io_supply_currentSrc_leftCtrl,	// @[generators/scumvtuning/src/main/scala/SCUMVTuning.scala:114:13]
                io_supply_currentSrc_rightCtrl,	// @[generators/scumvtuning/src/main/scala/SCUMVTuning.scala:114:13]
  output        io_supply_clkOvrd,	// @[generators/scumvtuning/src/main/scala/SCUMVTuning.scala:114:13]
                io_radar_rampGenerator_clkMuxSel,	// @[generators/scumvtuning/src/main/scala/SCUMVTuning.scala:114:13]
                io_radar_rampGenerator_enable,	// @[generators/scumvtuning/src/main/scala/SCUMVTuning.scala:114:13]
  output [7:0]  io_radar_rampGenerator_frequencyStepStart,	// @[generators/scumvtuning/src/main/scala/SCUMVTuning.scala:114:13]
                io_radar_rampGenerator_numFrequencySteps,	// @[generators/scumvtuning/src/main/scala/SCUMVTuning.scala:114:13]
  output [23:0] io_radar_rampGenerator_numCyclesPerFrequency,	// @[generators/scumvtuning/src/main/scala/SCUMVTuning.scala:114:13]
  output [31:0] io_radar_rampGenerator_numIdleCycles,	// @[generators/scumvtuning/src/main/scala/SCUMVTuning.scala:114:13]
  output        io_radar_rampGenerator_rst,	// @[generators/scumvtuning/src/main/scala/SCUMVTuning.scala:114:13]
  output [5:0]  io_radar_rampGenerator_idac_control,	// @[generators/scumvtuning/src/main/scala/SCUMVTuning.scala:114:13]
  output [1:0]  io_radar_rampGenerator_rx_out_sel,	// @[generators/scumvtuning/src/main/scala/SCUMVTuning.scala:114:13]
  output [4:0]  io_radar_vco_capTuning,	// @[generators/scumvtuning/src/main/scala/SCUMVTuning.scala:114:13]
  output        io_radar_vco_enable,	// @[generators/scumvtuning/src/main/scala/SCUMVTuning.scala:114:13]
                io_radar_vco_divEnable,	// @[generators/scumvtuning/src/main/scala/SCUMVTuning.scala:114:13]
                io_radar_pa_enable,	// @[generators/scumvtuning/src/main/scala/SCUMVTuning.scala:114:13]
                io_radar_pa_bypass,	// @[generators/scumvtuning/src/main/scala/SCUMVTuning.scala:114:13]
                io_radar_pa_inputMuxSel,	// @[generators/scumvtuning/src/main/scala/SCUMVTuning.scala:114:13]
                io_radar_clkOvrd	// @[generators/scumvtuning/src/main/scala/SCUMVTuning.scala:114:13]
);

  reg  [8:0]       adc_tune_out_coarse;	// @[generators/scumvtuning/src/main/scala/SCUMVTuning.scala:120:39]
  reg  [5:0]       dig_tune_out;	// @[generators/scumvtuning/src/main/scala/SCUMVTuning.scala:122:32]
  reg  [1:0]       cpu_sel;	// @[generators/scumvtuning/src/main/scala/SCUMVTuning.scala:123:26]
  reg              adc_reset;	// @[generators/scumvtuning/src/main/scala/SCUMVTuning.scala:125:28]
  reg              dig_reset;	// @[generators/scumvtuning/src/main/scala/SCUMVTuning.scala:126:28]
  reg  [4:0]       bgr_temp_ctrl;	// @[generators/scumvtuning/src/main/scala/SCUMVTuning.scala:129:42]
  reg  [4:0]       bgr_vref_ctrl;	// @[generators/scumvtuning/src/main/scala/SCUMVTuning.scala:130:42]
  reg  [4:0]       current_src_left_ctrl;	// @[generators/scumvtuning/src/main/scala/SCUMVTuning.scala:131:42]
  reg  [4:0]       current_src_right_ctrl;	// @[generators/scumvtuning/src/main/scala/SCUMVTuning.scala:132:42]
  reg              clk_ovrd;	// @[generators/scumvtuning/src/main/scala/SCUMVTuning.scala:133:42]
  reg  [5:0]       ramp_generator_idac_control;	// @[generators/scumvtuning/src/main/scala/SCUMVTuning.scala:135:48]
  reg  [1:0]       ramp_generator_rx_out_sel;	// @[generators/scumvtuning/src/main/scala/SCUMVTuning.scala:136:44]
  reg              ramp_generator_clk_mux_sel;	// @[generators/scumvtuning/src/main/scala/SCUMVTuning.scala:137:45]
  reg              ramp_generator_enable;	// @[generators/scumvtuning/src/main/scala/SCUMVTuning.scala:138:40]
  reg  [7:0]       ramp_generator_frequency_step_start;	// @[generators/scumvtuning/src/main/scala/SCUMVTuning.scala:139:54]
  reg  [7:0]       ramp_generator_num_frequency_steps;	// @[generators/scumvtuning/src/main/scala/SCUMVTuning.scala:140:53]
  reg  [23:0]      ramp_generator_num_cycles_per_frequency;	// @[generators/scumvtuning/src/main/scala/SCUMVTuning.scala:141:58]
  reg  [31:0]      ramp_generator_num_idle_cycles;	// @[generators/scumvtuning/src/main/scala/SCUMVTuning.scala:142:49]
  reg              ramp_generator_rst;	// @[generators/scumvtuning/src/main/scala/SCUMVTuning.scala:143:37]
  reg  [4:0]       vco_cap_tuning;	// @[generators/scumvtuning/src/main/scala/SCUMVTuning.scala:144:42]
  reg              vco_enable;	// @[generators/scumvtuning/src/main/scala/SCUMVTuning.scala:145:42]
  reg              vco_div_enable;	// @[generators/scumvtuning/src/main/scala/SCUMVTuning.scala:146:42]
  reg              pa_enable;	// @[generators/scumvtuning/src/main/scala/SCUMVTuning.scala:147:42]
  reg              pa_bypass;	// @[generators/scumvtuning/src/main/scala/SCUMVTuning.scala:148:42]
  reg              pa_input_mux_sel;	// @[generators/scumvtuning/src/main/scala/SCUMVTuning.scala:149:42]
  wire             out_front_bits_read = auto_control_xing_in_a_bits_opcode == 3'h4;	// @[generators/rocket-chip/src/main/scala/tilelink/RegisterRouter.scala:69:36]
  wire             _out_out_bits_data_WIRE_7 = auto_control_xing_in_a_bits_address[11:5] == 7'h0;	// @[generators/rocket-chip/src/main/scala/tilelink/Bundles.scala:259:74, generators/rocket-chip/src/main/scala/tilelink/Edges.scala:192:34, generators/rocket-chip/src/main/scala/tilelink/RegisterRouter.scala:70:19, :82:24]
  wire             _out_wofireMux_T_2 = auto_control_xing_in_a_valid & auto_control_xing_in_d_ready & ~out_front_bits_read;	// @[generators/rocket-chip/src/main/scala/tilelink/RegisterRouter.scala:69:36, :82:24]
  wire             out_woready_2 = _out_wofireMux_T_2 & auto_control_xing_in_a_bits_address[4:2] == 3'h0 & _out_out_bits_data_WIRE_7;	// @[generators/rocket-chip/src/main/scala/tilelink/RegisterRouter.scala:82:24]
  wire             out_woready_7 = _out_wofireMux_T_2 & auto_control_xing_in_a_bits_address[4:2] == 3'h1 & _out_out_bits_data_WIRE_7;	// @[generators/rocket-chip/src/main/scala/tilelink/RegisterRouter.scala:82:24]
  wire             out_woready_15 = _out_wofireMux_T_2 & auto_control_xing_in_a_bits_address[4:2] == 3'h2 & _out_out_bits_data_WIRE_7;	// @[generators/rocket-chip/src/main/scala/tilelink/RegisterRouter.scala:82:24]
  wire             out_woready_22 = _out_wofireMux_T_2 & auto_control_xing_in_a_bits_address[4:2] == 3'h3 & _out_out_bits_data_WIRE_7;	// @[generators/rocket-chip/src/main/scala/tilelink/RegisterRouter.scala:82:24]
  wire             out_woready_24 = _out_wofireMux_T_2 & auto_control_xing_in_a_bits_address[4:2] == 3'h4 & _out_out_bits_data_WIRE_7;	// @[generators/rocket-chip/src/main/scala/tilelink/RegisterRouter.scala:82:24]
  wire             out_woready_11 = _out_wofireMux_T_2 & auto_control_xing_in_a_bits_address[4:2] == 3'h6 & _out_out_bits_data_WIRE_7;	// @[generators/rocket-chip/src/main/scala/tilelink/RegisterRouter.scala:82:24, src/main/scala/chisel3/util/OneHot.scala:58:35]
  wire             out_woready_18 = _out_wofireMux_T_2 & (&(auto_control_xing_in_a_bits_address[4:2])) & _out_out_bits_data_WIRE_7;	// @[generators/rocket-chip/src/main/scala/tilelink/RegisterRouter.scala:82:24]
  wire [7:0][31:0] _GEN = {{{15'h0, pa_input_mux_sel, 7'h0, pa_bypass, 7'h0, pa_enable}}, {{7'h0, vco_div_enable, 7'h0, vco_enable, 3'h0, vco_cap_tuning, 7'h0, ramp_generator_rst}}, {ramp_generator_num_idle_cycles}, {{ramp_generator_num_cycles_per_frequency, ramp_generator_num_frequency_steps}}, {{ramp_generator_frequency_step_start, 7'h0, ramp_generator_enable, 7'h0, ramp_generator_clk_mux_sel, 7'h0, clk_ovrd}}, {{3'h0, current_src_right_ctrl, 3'h0, current_src_left_ctrl, 3'h0, bgr_vref_ctrl, 3'h0, bgr_temp_ctrl}}, {{7'h0, dig_reset, 7'h0, adc_reset, 6'h0, cpu_sel, 2'h0, dig_tune_out}}, {{6'h0, ramp_generator_rx_out_sel, 2'h0, ramp_generator_idac_control, 7'h0, adc_tune_out_coarse}}};	// @[generators/rocket-chip/src/main/scala/tilelink/Bundles.scala:259:74, generators/rocket-chip/src/main/scala/tilelink/RegisterRouter.scala:82:24, generators/rocket-chip/src/main/scala/util/MuxLiteral.scala:49:{10,48}, generators/scumvtuning/src/main/scala/SCUMVTuning.scala:120:39, :122:32, :123:26, :125:28, :126:28, :129:42, :130:42, :131:42, :132:42, :133:42, :135:48, :136:44, :137:45, :138:40, :139:54, :140:53, :141:58, :142:49, :143:37, :144:42, :145:42, :146:42, :147:42, :148:42, :149:42]
  wire [2:0]       controlXingIn_d_bits_opcode = {2'h0, out_front_bits_read};	// @[generators/rocket-chip/src/main/scala/tilelink/Bundles.scala:259:74, generators/rocket-chip/src/main/scala/tilelink/RegisterRouter.scala:69:36, :100:19]
  wire [7:0]       _out_backMask_T_5 = {8{auto_control_xing_in_a_bits_mask[0]}};	// @[generators/rocket-chip/src/main/scala/tilelink/RegisterRouter.scala:82:24]
  wire [7:0]       _out_backMask_T_7 = {8{auto_control_xing_in_a_bits_mask[1]}};	// @[generators/rocket-chip/src/main/scala/tilelink/RegisterRouter.scala:82:24]
  wire [7:0]       _out_backMask_T_9 = {8{auto_control_xing_in_a_bits_mask[2]}};	// @[generators/rocket-chip/src/main/scala/tilelink/RegisterRouter.scala:82:24]
  wire [7:0]       _out_backMask_T_11 = {8{auto_control_xing_in_a_bits_mask[3]}};	// @[generators/rocket-chip/src/main/scala/tilelink/RegisterRouter.scala:82:24]
  always @(posedge clock) begin
    if (reset) begin
      adc_tune_out_coarse <= 9'h40;	// @[generators/scumvtuning/src/main/scala/SCUMVTuning.scala:120:39]
      dig_tune_out <= 6'h1;	// @[generators/scumvtuning/src/main/scala/SCUMVTuning.scala:122:32]
      cpu_sel <= 2'h2;	// @[generators/scumvtuning/src/main/scala/SCUMVTuning.scala:123:26]
      adc_reset <= 1'h0;	// @[generators/rocket-chip/src/main/scala/tilelink/Bundles.scala:259:74, generators/scumvtuning/src/main/scala/SCUMVTuning.scala:125:28]
      dig_reset <= 1'h0;	// @[generators/rocket-chip/src/main/scala/tilelink/Bundles.scala:259:74, generators/scumvtuning/src/main/scala/SCUMVTuning.scala:126:28]
      bgr_temp_ctrl <= 5'h15;	// @[generators/scumvtuning/src/main/scala/SCUMVTuning.scala:129:42]
      bgr_vref_ctrl <= 5'hF;	// @[generators/scumvtuning/src/main/scala/SCUMVTuning.scala:130:42]
      current_src_left_ctrl <= 5'h0;	// @[generators/scumvtuning/src/main/scala/SCUMVTuning.scala:131:42]
      current_src_right_ctrl <= 5'h0;	// @[generators/scumvtuning/src/main/scala/SCUMVTuning.scala:131:42, :132:42]
      clk_ovrd <= 1'h0;	// @[generators/rocket-chip/src/main/scala/tilelink/Bundles.scala:259:74, generators/scumvtuning/src/main/scala/SCUMVTuning.scala:133:42]
      ramp_generator_idac_control <= 6'h0;	// @[generators/scumvtuning/src/main/scala/SCUMVTuning.scala:135:48]
      ramp_generator_rx_out_sel <= 2'h0;	// @[generators/rocket-chip/src/main/scala/tilelink/Bundles.scala:259:74, generators/scumvtuning/src/main/scala/SCUMVTuning.scala:136:44]
      ramp_generator_clk_mux_sel <= 1'h0;	// @[generators/rocket-chip/src/main/scala/tilelink/Bundles.scala:259:74, generators/scumvtuning/src/main/scala/SCUMVTuning.scala:137:45]
      ramp_generator_enable <= 1'h0;	// @[generators/rocket-chip/src/main/scala/tilelink/Bundles.scala:259:74, generators/scumvtuning/src/main/scala/SCUMVTuning.scala:138:40]
      ramp_generator_frequency_step_start <= 8'h0;	// @[generators/scumvtuning/src/main/scala/SCUMVTuning.scala:139:54]
      ramp_generator_num_frequency_steps <= 8'h0;	// @[generators/scumvtuning/src/main/scala/SCUMVTuning.scala:139:54, :140:53]
      ramp_generator_num_cycles_per_frequency <= 24'h0;	// @[generators/scumvtuning/src/main/scala/SCUMVTuning.scala:141:58]
      ramp_generator_num_idle_cycles <= 32'h0;	// @[generators/rocket-chip/src/main/scala/tilelink/Bundles.scala:259:74, generators/scumvtuning/src/main/scala/SCUMVTuning.scala:142:49]
      ramp_generator_rst <= 1'h1;	// @[generators/rocket-chip/src/main/scala/tilelink/Buffer.scala:47:20, generators/scumvtuning/src/main/scala/SCUMVTuning.scala:143:37]
      vco_cap_tuning <= 5'h0;	// @[generators/scumvtuning/src/main/scala/SCUMVTuning.scala:131:42, :144:42]
      vco_enable <= 1'h1;	// @[generators/rocket-chip/src/main/scala/tilelink/Buffer.scala:47:20, generators/scumvtuning/src/main/scala/SCUMVTuning.scala:145:42]
      vco_div_enable <= 1'h1;	// @[generators/rocket-chip/src/main/scala/tilelink/Buffer.scala:47:20, generators/scumvtuning/src/main/scala/SCUMVTuning.scala:146:42]
      pa_enable <= 1'h1;	// @[generators/rocket-chip/src/main/scala/tilelink/Buffer.scala:47:20, generators/scumvtuning/src/main/scala/SCUMVTuning.scala:147:42]
      pa_bypass <= 1'h0;	// @[generators/rocket-chip/src/main/scala/tilelink/Bundles.scala:259:74, generators/scumvtuning/src/main/scala/SCUMVTuning.scala:148:42]
      pa_input_mux_sel <= 1'h0;	// @[generators/rocket-chip/src/main/scala/tilelink/Bundles.scala:259:74, generators/scumvtuning/src/main/scala/SCUMVTuning.scala:149:42]
    end
    else begin
      if (out_woready_2 & (&{auto_control_xing_in_a_bits_mask[1], _out_backMask_T_5}))	// @[generators/rocket-chip/src/main/scala/tilelink/RegisterRouter.scala:82:24]
        adc_tune_out_coarse <= auto_control_xing_in_a_bits_data[8:0];	// @[generators/rocket-chip/src/main/scala/tilelink/RegisterRouter.scala:82:24, generators/scumvtuning/src/main/scala/SCUMVTuning.scala:120:39]
      if (out_woready_7 & auto_control_xing_in_a_bits_mask[0])	// @[generators/rocket-chip/src/main/scala/tilelink/RegisterRouter.scala:82:24]
        dig_tune_out <= auto_control_xing_in_a_bits_data[5:0];	// @[generators/rocket-chip/src/main/scala/tilelink/RegisterRouter.scala:82:24, generators/scumvtuning/src/main/scala/SCUMVTuning.scala:122:32]
      if (out_woready_7 & auto_control_xing_in_a_bits_mask[1])	// @[generators/rocket-chip/src/main/scala/tilelink/RegisterRouter.scala:82:24]
        cpu_sel <= auto_control_xing_in_a_bits_data[9:8];	// @[generators/rocket-chip/src/main/scala/tilelink/RegisterRouter.scala:82:24, generators/scumvtuning/src/main/scala/SCUMVTuning.scala:123:26]
      if (out_woready_7 & auto_control_xing_in_a_bits_mask[2])	// @[generators/rocket-chip/src/main/scala/tilelink/RegisterRouter.scala:82:24]
        adc_reset <= auto_control_xing_in_a_bits_data[16];	// @[generators/rocket-chip/src/main/scala/tilelink/RegisterRouter.scala:82:24, generators/scumvtuning/src/main/scala/SCUMVTuning.scala:125:28]
      if (out_woready_7 & auto_control_xing_in_a_bits_mask[3])	// @[generators/rocket-chip/src/main/scala/tilelink/RegisterRouter.scala:82:24]
        dig_reset <= auto_control_xing_in_a_bits_data[24];	// @[generators/rocket-chip/src/main/scala/tilelink/RegisterRouter.scala:82:24, generators/scumvtuning/src/main/scala/SCUMVTuning.scala:126:28]
      if (out_woready_15 & auto_control_xing_in_a_bits_mask[0])	// @[generators/rocket-chip/src/main/scala/tilelink/RegisterRouter.scala:82:24]
        bgr_temp_ctrl <= auto_control_xing_in_a_bits_data[4:0];	// @[generators/rocket-chip/src/main/scala/tilelink/RegisterRouter.scala:82:24, generators/scumvtuning/src/main/scala/SCUMVTuning.scala:129:42]
      if (out_woready_15 & auto_control_xing_in_a_bits_mask[1])	// @[generators/rocket-chip/src/main/scala/tilelink/RegisterRouter.scala:82:24]
        bgr_vref_ctrl <= auto_control_xing_in_a_bits_data[12:8];	// @[generators/rocket-chip/src/main/scala/tilelink/RegisterRouter.scala:82:24, generators/scumvtuning/src/main/scala/SCUMVTuning.scala:130:42]
      if (out_woready_15 & auto_control_xing_in_a_bits_mask[2])	// @[generators/rocket-chip/src/main/scala/tilelink/RegisterRouter.scala:82:24]
        current_src_left_ctrl <= auto_control_xing_in_a_bits_data[20:16];	// @[generators/rocket-chip/src/main/scala/tilelink/RegisterRouter.scala:82:24, generators/scumvtuning/src/main/scala/SCUMVTuning.scala:131:42]
      if (out_woready_15 & auto_control_xing_in_a_bits_mask[3])	// @[generators/rocket-chip/src/main/scala/tilelink/RegisterRouter.scala:82:24]
        current_src_right_ctrl <= auto_control_xing_in_a_bits_data[28:24];	// @[generators/rocket-chip/src/main/scala/tilelink/RegisterRouter.scala:82:24, generators/scumvtuning/src/main/scala/SCUMVTuning.scala:132:42]
      if (out_woready_22 & auto_control_xing_in_a_bits_mask[0])	// @[generators/rocket-chip/src/main/scala/tilelink/RegisterRouter.scala:82:24]
        clk_ovrd <= auto_control_xing_in_a_bits_data[0];	// @[generators/rocket-chip/src/main/scala/tilelink/RegisterRouter.scala:82:24, generators/scumvtuning/src/main/scala/SCUMVTuning.scala:133:42]
      if (out_woready_2 & auto_control_xing_in_a_bits_mask[2])	// @[generators/rocket-chip/src/main/scala/tilelink/RegisterRouter.scala:82:24]
        ramp_generator_idac_control <= auto_control_xing_in_a_bits_data[21:16];	// @[generators/rocket-chip/src/main/scala/tilelink/RegisterRouter.scala:82:24, generators/scumvtuning/src/main/scala/SCUMVTuning.scala:135:48]
      if (out_woready_2 & auto_control_xing_in_a_bits_mask[3])	// @[generators/rocket-chip/src/main/scala/tilelink/RegisterRouter.scala:82:24]
        ramp_generator_rx_out_sel <= auto_control_xing_in_a_bits_data[25:24];	// @[generators/rocket-chip/src/main/scala/tilelink/RegisterRouter.scala:82:24, generators/scumvtuning/src/main/scala/SCUMVTuning.scala:136:44]
      if (out_woready_22 & auto_control_xing_in_a_bits_mask[1])	// @[generators/rocket-chip/src/main/scala/tilelink/RegisterRouter.scala:82:24]
        ramp_generator_clk_mux_sel <= auto_control_xing_in_a_bits_data[8];	// @[generators/rocket-chip/src/main/scala/tilelink/RegisterRouter.scala:82:24, generators/scumvtuning/src/main/scala/SCUMVTuning.scala:137:45]
      if (out_woready_22 & auto_control_xing_in_a_bits_mask[2])	// @[generators/rocket-chip/src/main/scala/tilelink/RegisterRouter.scala:82:24]
        ramp_generator_enable <= auto_control_xing_in_a_bits_data[16];	// @[generators/rocket-chip/src/main/scala/tilelink/RegisterRouter.scala:82:24, generators/scumvtuning/src/main/scala/SCUMVTuning.scala:138:40]
      if (out_woready_22 & auto_control_xing_in_a_bits_mask[3])	// @[generators/rocket-chip/src/main/scala/tilelink/RegisterRouter.scala:82:24]
        ramp_generator_frequency_step_start <= auto_control_xing_in_a_bits_data[31:24];	// @[generators/rocket-chip/src/main/scala/tilelink/RegisterRouter.scala:82:24, generators/scumvtuning/src/main/scala/SCUMVTuning.scala:139:54]
      if (out_woready_24 & auto_control_xing_in_a_bits_mask[0])	// @[generators/rocket-chip/src/main/scala/tilelink/RegisterRouter.scala:82:24]
        ramp_generator_num_frequency_steps <= auto_control_xing_in_a_bits_data[7:0];	// @[generators/rocket-chip/src/main/scala/tilelink/RegisterRouter.scala:82:24, generators/scumvtuning/src/main/scala/SCUMVTuning.scala:140:53]
      if (out_woready_24 & (&{_out_backMask_T_11, _out_backMask_T_9, _out_backMask_T_7}))	// @[generators/rocket-chip/src/main/scala/tilelink/RegisterRouter.scala:82:24]
        ramp_generator_num_cycles_per_frequency <= auto_control_xing_in_a_bits_data[31:8];	// @[generators/rocket-chip/src/main/scala/tilelink/RegisterRouter.scala:82:24, generators/scumvtuning/src/main/scala/SCUMVTuning.scala:141:58]
      if (_out_wofireMux_T_2 & auto_control_xing_in_a_bits_address[4:2] == 3'h5 & _out_out_bits_data_WIRE_7 & (&{_out_backMask_T_11, _out_backMask_T_9, _out_backMask_T_7, _out_backMask_T_5}))	// @[generators/rocket-chip/src/main/scala/tilelink/RegisterRouter.scala:82:24]
        ramp_generator_num_idle_cycles <= auto_control_xing_in_a_bits_data;	// @[generators/scumvtuning/src/main/scala/SCUMVTuning.scala:142:49]
      if (out_woready_11 & auto_control_xing_in_a_bits_mask[0])	// @[generators/rocket-chip/src/main/scala/tilelink/RegisterRouter.scala:82:24]
        ramp_generator_rst <= auto_control_xing_in_a_bits_data[0];	// @[generators/rocket-chip/src/main/scala/tilelink/RegisterRouter.scala:82:24, generators/scumvtuning/src/main/scala/SCUMVTuning.scala:143:37]
      if (out_woready_11 & auto_control_xing_in_a_bits_mask[1])	// @[generators/rocket-chip/src/main/scala/tilelink/RegisterRouter.scala:82:24]
        vco_cap_tuning <= auto_control_xing_in_a_bits_data[12:8];	// @[generators/rocket-chip/src/main/scala/tilelink/RegisterRouter.scala:82:24, generators/scumvtuning/src/main/scala/SCUMVTuning.scala:144:42]
      if (out_woready_11 & auto_control_xing_in_a_bits_mask[2])	// @[generators/rocket-chip/src/main/scala/tilelink/RegisterRouter.scala:82:24]
        vco_enable <= auto_control_xing_in_a_bits_data[16];	// @[generators/rocket-chip/src/main/scala/tilelink/RegisterRouter.scala:82:24, generators/scumvtuning/src/main/scala/SCUMVTuning.scala:145:42]
      if (out_woready_11 & auto_control_xing_in_a_bits_mask[3])	// @[generators/rocket-chip/src/main/scala/tilelink/RegisterRouter.scala:82:24]
        vco_div_enable <= auto_control_xing_in_a_bits_data[24];	// @[generators/rocket-chip/src/main/scala/tilelink/RegisterRouter.scala:82:24, generators/scumvtuning/src/main/scala/SCUMVTuning.scala:146:42]
      if (out_woready_18 & auto_control_xing_in_a_bits_mask[0])	// @[generators/rocket-chip/src/main/scala/tilelink/RegisterRouter.scala:82:24]
        pa_enable <= auto_control_xing_in_a_bits_data[0];	// @[generators/rocket-chip/src/main/scala/tilelink/RegisterRouter.scala:82:24, generators/scumvtuning/src/main/scala/SCUMVTuning.scala:147:42]
      if (out_woready_18 & auto_control_xing_in_a_bits_mask[1])	// @[generators/rocket-chip/src/main/scala/tilelink/RegisterRouter.scala:82:24]
        pa_bypass <= auto_control_xing_in_a_bits_data[8];	// @[generators/rocket-chip/src/main/scala/tilelink/RegisterRouter.scala:82:24, generators/scumvtuning/src/main/scala/SCUMVTuning.scala:148:42]
      if (out_woready_18 & auto_control_xing_in_a_bits_mask[2])	// @[generators/rocket-chip/src/main/scala/tilelink/RegisterRouter.scala:82:24]
        pa_input_mux_sel <= auto_control_xing_in_a_bits_data[16];	// @[generators/rocket-chip/src/main/scala/tilelink/RegisterRouter.scala:82:24, generators/scumvtuning/src/main/scala/SCUMVTuning.scala:149:42]
    end
  end // always @(posedge)
  `ifdef ENABLE_INITIAL_REG_
    `ifdef FIRRTL_BEFORE_INITIAL
      `FIRRTL_BEFORE_INITIAL
    `endif // FIRRTL_BEFORE_INITIAL
    logic [31:0] _RANDOM[0:4];
    initial begin
      `ifdef INIT_RANDOM_PROLOG_
        `INIT_RANDOM_PROLOG_
      `endif // INIT_RANDOM_PROLOG_
      `ifdef RANDOMIZE_REG_INIT
        for (logic [2:0] i = 3'h0; i < 3'h5; i += 3'h1) begin
          _RANDOM[i] = `RANDOM;
        end
        adc_tune_out_coarse = _RANDOM[3'h0][8:0];	// @[generators/scumvtuning/src/main/scala/SCUMVTuning.scala:120:39]
        dig_tune_out = _RANDOM[3'h0][14:9];	// @[generators/scumvtuning/src/main/scala/SCUMVTuning.scala:120:39, :122:32]
        cpu_sel = _RANDOM[3'h0][16:15];	// @[generators/scumvtuning/src/main/scala/SCUMVTuning.scala:120:39, :123:26]
        adc_reset = _RANDOM[3'h0][17];	// @[generators/scumvtuning/src/main/scala/SCUMVTuning.scala:120:39, :125:28]
        dig_reset = _RANDOM[3'h0][18];	// @[generators/scumvtuning/src/main/scala/SCUMVTuning.scala:120:39, :126:28]
        bgr_temp_ctrl = _RANDOM[3'h0][23:19];	// @[generators/scumvtuning/src/main/scala/SCUMVTuning.scala:120:39, :129:42]
        bgr_vref_ctrl = _RANDOM[3'h0][28:24];	// @[generators/scumvtuning/src/main/scala/SCUMVTuning.scala:120:39, :130:42]
        current_src_left_ctrl = {_RANDOM[3'h0][31:29], _RANDOM[3'h1][1:0]};	// @[generators/scumvtuning/src/main/scala/SCUMVTuning.scala:120:39, :131:42]
        current_src_right_ctrl = _RANDOM[3'h1][6:2];	// @[generators/scumvtuning/src/main/scala/SCUMVTuning.scala:131:42, :132:42]
        clk_ovrd = _RANDOM[3'h1][7];	// @[generators/scumvtuning/src/main/scala/SCUMVTuning.scala:131:42, :133:42]
        ramp_generator_idac_control = _RANDOM[3'h1][13:8];	// @[generators/scumvtuning/src/main/scala/SCUMVTuning.scala:131:42, :135:48]
        ramp_generator_rx_out_sel = _RANDOM[3'h1][15:14];	// @[generators/scumvtuning/src/main/scala/SCUMVTuning.scala:131:42, :136:44]
        ramp_generator_clk_mux_sel = _RANDOM[3'h1][16];	// @[generators/scumvtuning/src/main/scala/SCUMVTuning.scala:131:42, :137:45]
        ramp_generator_enable = _RANDOM[3'h1][17];	// @[generators/scumvtuning/src/main/scala/SCUMVTuning.scala:131:42, :138:40]
        ramp_generator_frequency_step_start = _RANDOM[3'h1][25:18];	// @[generators/scumvtuning/src/main/scala/SCUMVTuning.scala:131:42, :139:54]
        ramp_generator_num_frequency_steps = {_RANDOM[3'h1][31:26], _RANDOM[3'h2][1:0]};	// @[generators/scumvtuning/src/main/scala/SCUMVTuning.scala:131:42, :140:53]
        ramp_generator_num_cycles_per_frequency = _RANDOM[3'h2][25:2];	// @[generators/scumvtuning/src/main/scala/SCUMVTuning.scala:140:53, :141:58]
        ramp_generator_num_idle_cycles = {_RANDOM[3'h2][31:26], _RANDOM[3'h3][25:0]};	// @[generators/scumvtuning/src/main/scala/SCUMVTuning.scala:140:53, :142:49]
        ramp_generator_rst = _RANDOM[3'h3][26];	// @[generators/scumvtuning/src/main/scala/SCUMVTuning.scala:142:49, :143:37]
        vco_cap_tuning = _RANDOM[3'h3][31:27];	// @[generators/scumvtuning/src/main/scala/SCUMVTuning.scala:142:49, :144:42]
        vco_enable = _RANDOM[3'h4][0];	// @[generators/scumvtuning/src/main/scala/SCUMVTuning.scala:145:42]
        vco_div_enable = _RANDOM[3'h4][1];	// @[generators/scumvtuning/src/main/scala/SCUMVTuning.scala:145:42, :146:42]
        pa_enable = _RANDOM[3'h4][2];	// @[generators/scumvtuning/src/main/scala/SCUMVTuning.scala:145:42, :147:42]
        pa_bypass = _RANDOM[3'h4][3];	// @[generators/scumvtuning/src/main/scala/SCUMVTuning.scala:145:42, :148:42]
        pa_input_mux_sel = _RANDOM[3'h4][4];	// @[generators/scumvtuning/src/main/scala/SCUMVTuning.scala:145:42, :149:42]
      `endif // RANDOMIZE_REG_INIT
    end // initial
    `ifdef FIRRTL_AFTER_INITIAL
      `FIRRTL_AFTER_INITIAL
    `endif // FIRRTL_AFTER_INITIAL
  `endif // ENABLE_INITIAL_REG_
  TLMonitor_67 monitor (	// @[generators/rocket-chip/src/main/scala/tilelink/Nodes.scala:24:25]
    .clock                (clock),
    .reset                (reset),
    .io_in_a_ready        (auto_control_xing_in_d_ready),
    .io_in_a_valid        (auto_control_xing_in_a_valid),
    .io_in_a_bits_opcode  (auto_control_xing_in_a_bits_opcode),
    .io_in_a_bits_param   (auto_control_xing_in_a_bits_param),
    .io_in_a_bits_size    (auto_control_xing_in_a_bits_size),
    .io_in_a_bits_source  (auto_control_xing_in_a_bits_source),
    .io_in_a_bits_address (auto_control_xing_in_a_bits_address),
    .io_in_a_bits_mask    (auto_control_xing_in_a_bits_mask),
    .io_in_a_bits_corrupt (auto_control_xing_in_a_bits_corrupt),
    .io_in_d_ready        (auto_control_xing_in_d_ready),
    .io_in_d_valid        (auto_control_xing_in_a_valid),
    .io_in_d_bits_opcode  (controlXingIn_d_bits_opcode),	// @[generators/rocket-chip/src/main/scala/tilelink/RegisterRouter.scala:100:19]
    .io_in_d_bits_size    (auto_control_xing_in_a_bits_size),
    .io_in_d_bits_source  (auto_control_xing_in_a_bits_source)
  );
  assign auto_control_xing_in_a_ready = auto_control_xing_in_d_ready;
  assign auto_control_xing_in_d_valid = auto_control_xing_in_a_valid;
  assign auto_control_xing_in_d_bits_opcode = controlXingIn_d_bits_opcode;	// @[generators/rocket-chip/src/main/scala/tilelink/RegisterRouter.scala:100:19]
  assign auto_control_xing_in_d_bits_size = auto_control_xing_in_a_bits_size;
  assign auto_control_xing_in_d_bits_source = auto_control_xing_in_a_bits_source;
  assign auto_control_xing_in_d_bits_data = _out_out_bits_data_WIRE_7 ? _GEN[auto_control_xing_in_a_bits_address[4:2]] : 32'h0;	// @[generators/rocket-chip/src/main/scala/tilelink/Bundles.scala:259:74, generators/rocket-chip/src/main/scala/tilelink/RegisterRouter.scala:82:24, generators/rocket-chip/src/main/scala/util/MuxLiteral.scala:49:10]
  assign io_oscillator_tuneOut_adc_coarse = adc_tune_out_coarse;	// @[generators/scumvtuning/src/main/scala/SCUMVTuning.scala:120:39]
  assign io_oscillator_tuneOut_dig = dig_tune_out;	// @[generators/scumvtuning/src/main/scala/SCUMVTuning.scala:122:32]
  assign io_oscillator_tuneOut_cpuSel = cpu_sel;	// @[generators/scumvtuning/src/main/scala/SCUMVTuning.scala:123:26]
  assign io_oscillator_reset_adc = adc_reset;	// @[generators/scumvtuning/src/main/scala/SCUMVTuning.scala:125:28]
  assign io_oscillator_reset_dig = dig_reset;	// @[generators/scumvtuning/src/main/scala/SCUMVTuning.scala:126:28]
  assign io_supply_bgr_tempCtrl = bgr_temp_ctrl;	// @[generators/scumvtuning/src/main/scala/SCUMVTuning.scala:129:42]
  assign io_supply_bgr_vrefCtrl = bgr_vref_ctrl;	// @[generators/scumvtuning/src/main/scala/SCUMVTuning.scala:130:42]
  assign io_supply_currentSrc_leftCtrl = current_src_left_ctrl;	// @[generators/scumvtuning/src/main/scala/SCUMVTuning.scala:131:42]
  assign io_supply_currentSrc_rightCtrl = current_src_right_ctrl;	// @[generators/scumvtuning/src/main/scala/SCUMVTuning.scala:132:42]
  assign io_supply_clkOvrd = clk_ovrd;	// @[generators/scumvtuning/src/main/scala/SCUMVTuning.scala:133:42]
  assign io_radar_rampGenerator_clkMuxSel = ramp_generator_clk_mux_sel;	// @[generators/scumvtuning/src/main/scala/SCUMVTuning.scala:137:45]
  assign io_radar_rampGenerator_enable = ramp_generator_enable;	// @[generators/scumvtuning/src/main/scala/SCUMVTuning.scala:138:40]
  assign io_radar_rampGenerator_frequencyStepStart = ramp_generator_frequency_step_start;	// @[generators/scumvtuning/src/main/scala/SCUMVTuning.scala:139:54]
  assign io_radar_rampGenerator_numFrequencySteps = ramp_generator_num_frequency_steps;	// @[generators/scumvtuning/src/main/scala/SCUMVTuning.scala:140:53]
  assign io_radar_rampGenerator_numCyclesPerFrequency = ramp_generator_num_cycles_per_frequency;	// @[generators/scumvtuning/src/main/scala/SCUMVTuning.scala:141:58]
  assign io_radar_rampGenerator_numIdleCycles = ramp_generator_num_idle_cycles;	// @[generators/scumvtuning/src/main/scala/SCUMVTuning.scala:142:49]
  assign io_radar_rampGenerator_rst = ramp_generator_rst;	// @[generators/scumvtuning/src/main/scala/SCUMVTuning.scala:143:37]
  assign io_radar_rampGenerator_idac_control = ramp_generator_idac_control;	// @[generators/scumvtuning/src/main/scala/SCUMVTuning.scala:135:48]
  assign io_radar_rampGenerator_rx_out_sel = ramp_generator_rx_out_sel;	// @[generators/scumvtuning/src/main/scala/SCUMVTuning.scala:136:44]
  assign io_radar_vco_capTuning = vco_cap_tuning;	// @[generators/scumvtuning/src/main/scala/SCUMVTuning.scala:144:42]
  assign io_radar_vco_enable = vco_enable;	// @[generators/scumvtuning/src/main/scala/SCUMVTuning.scala:145:42]
  assign io_radar_vco_divEnable = vco_div_enable;	// @[generators/scumvtuning/src/main/scala/SCUMVTuning.scala:146:42]
  assign io_radar_pa_enable = pa_enable;	// @[generators/scumvtuning/src/main/scala/SCUMVTuning.scala:147:42]
  assign io_radar_pa_bypass = pa_bypass;	// @[generators/scumvtuning/src/main/scala/SCUMVTuning.scala:148:42]
  assign io_radar_pa_inputMuxSel = pa_input_mux_sel;	// @[generators/scumvtuning/src/main/scala/SCUMVTuning.scala:149:42]
  assign io_radar_clkOvrd = clk_ovrd;	// @[generators/scumvtuning/src/main/scala/SCUMVTuning.scala:133:42]
endmodule

