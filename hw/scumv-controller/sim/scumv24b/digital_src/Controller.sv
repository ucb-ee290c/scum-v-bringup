// Generated by CIRCT unknown git version
// Standard header to adapt well known macros for register randomization.
`ifndef RANDOMIZE
  `ifdef RANDOMIZE_MEM_INIT
    `define RANDOMIZE
  `endif // RANDOMIZE_MEM_INIT
`endif // not def RANDOMIZE
`ifndef RANDOMIZE
  `ifdef RANDOMIZE_REG_INIT
    `define RANDOMIZE
  `endif // RANDOMIZE_REG_INIT
`endif // not def RANDOMIZE

// RANDOM may be set to an expression that produces a 32-bit random unsigned value.
`ifndef RANDOM
  `define RANDOM $random
`endif // not def RANDOM

// Users can define INIT_RANDOM as general code that gets injected into the
// initializer block for modules with registers.
`ifndef INIT_RANDOM
  `define INIT_RANDOM
`endif // not def INIT_RANDOM

// If using random initialization, you can also define RANDOMIZE_DELAY to
// customize the delay used, otherwise 0.002 is used.
`ifndef RANDOMIZE_DELAY
  `define RANDOMIZE_DELAY 0.002
`endif // not def RANDOMIZE_DELAY

// Define INIT_RANDOM_PROLOG_ for use in our modules below.
`ifndef INIT_RANDOM_PROLOG_
  `ifdef RANDOMIZE
    `ifdef VERILATOR
      `define INIT_RANDOM_PROLOG_ `INIT_RANDOM
    `else  // VERILATOR
      `define INIT_RANDOM_PROLOG_ `INIT_RANDOM #`RANDOMIZE_DELAY begin end
    `endif // VERILATOR
  `else  // RANDOMIZE
    `define INIT_RANDOM_PROLOG_
  `endif // RANDOMIZE
`endif // not def INIT_RANDOM_PROLOG_

// Include register initializers in init blocks unless synthesis is set
`ifndef SYNTHESIS
  `ifndef ENABLE_INITIAL_REG_
    `define ENABLE_INITIAL_REG_
  `endif // not def ENABLE_INITIAL_REG_
`endif // not def SYNTHESIS

// Include rmemory initializers in init blocks unless synthesis is set
`ifndef SYNTHESIS
  `ifndef ENABLE_INITIAL_MEM_
    `define ENABLE_INITIAL_MEM_
  `endif // not def ENABLE_INITIAL_MEM_
`endif // not def SYNTHESIS

// Standard header to adapt well known macros for prints and assertions.

// Users can define 'PRINTF_COND' to add an extra gate to prints.
`ifndef PRINTF_COND_
  `ifdef PRINTF_COND
    `define PRINTF_COND_ (`PRINTF_COND)
  `else  // PRINTF_COND
    `define PRINTF_COND_ 1
  `endif // PRINTF_COND
`endif // not def PRINTF_COND_

// Users can define 'ASSERT_VERBOSE_COND' to add an extra gate to assert error printing.
`ifndef ASSERT_VERBOSE_COND_
  `ifdef ASSERT_VERBOSE_COND
    `define ASSERT_VERBOSE_COND_ (`ASSERT_VERBOSE_COND)
  `else  // ASSERT_VERBOSE_COND
    `define ASSERT_VERBOSE_COND_ 1
  `endif // ASSERT_VERBOSE_COND
`endif // not def ASSERT_VERBOSE_COND_

// Users can define 'STOP_COND' to add an extra gate to stop conditions.
`ifndef STOP_COND_
  `ifdef STOP_COND
    `define STOP_COND_ (`STOP_COND)
  `else  // STOP_COND
    `define STOP_COND_ 1
  `endif // STOP_COND
`endif // not def STOP_COND_

module Controller(
  input         clock,
                reset,
  output        io_interrupt_rxError,	// @[generators/baseband/src/main/scala/baseband/Controller.scala:438:14]
                io_interrupt_rxStart,	// @[generators/baseband/src/main/scala/baseband/Controller.scala:438:14]
                io_interrupt_rxFinish,	// @[generators/baseband/src/main/scala/baseband/Controller.scala:438:14]
                io_interrupt_txError,	// @[generators/baseband/src/main/scala/baseband/Controller.scala:438:14]
                io_interrupt_txFinish,	// @[generators/baseband/src/main/scala/baseband/Controller.scala:438:14]
                io_analog_offChipMode_rx,	// @[generators/baseband/src/main/scala/baseband/Controller.scala:438:14]
                io_analog_offChipMode_tx,	// @[generators/baseband/src/main/scala/baseband/Controller.scala:438:14]
                io_analog_enable_rx_mix,	// @[generators/baseband/src/main/scala/baseband/Controller.scala:438:14]
                io_analog_enable_rx_buf,	// @[generators/baseband/src/main/scala/baseband/Controller.scala:438:14]
                io_analog_enable_rx_tia,	// @[generators/baseband/src/main/scala/baseband/Controller.scala:438:14]
                io_analog_enable_rx_vga,	// @[generators/baseband/src/main/scala/baseband/Controller.scala:438:14]
                io_analog_enable_rx_bpf,	// @[generators/baseband/src/main/scala/baseband/Controller.scala:438:14]
  input         io_bleBasebandControl_bleAssembler_in_ready,	// @[generators/baseband/src/main/scala/baseband/Controller.scala:438:14]
  output        io_bleBasebandControl_bleAssembler_in_valid,	// @[generators/baseband/src/main/scala/baseband/Controller.scala:438:14]
  output [31:0] io_bleBasebandControl_bleAssembler_in_bits_aa,	// @[generators/baseband/src/main/scala/baseband/Controller.scala:438:14]
  output [7:0]  io_bleBasebandControl_bleAssembler_in_bits_pduLength,	// @[generators/baseband/src/main/scala/baseband/Controller.scala:438:14]
  input         io_bleBasebandControl_bleAssembler_out_done,	// @[generators/baseband/src/main/scala/baseband/Controller.scala:438:14]
  output        io_bleBasebandControl_bleDisassembler_in_valid,	// @[generators/baseband/src/main/scala/baseband/Controller.scala:438:14]
  output [1:0]  io_bleBasebandControl_bleDisassembler_in_bits_command,	// @[generators/baseband/src/main/scala/baseband/Controller.scala:438:14]
  input  [7:0]  io_bleBasebandControl_bleDisassembler_out_length,	// @[generators/baseband/src/main/scala/baseband/Controller.scala:438:14]
  input         io_bleBasebandControl_bleDisassembler_out_flag_crc,	// @[generators/baseband/src/main/scala/baseband/Controller.scala:438:14]
                io_bleBasebandControl_bleDisassembler_out_done,	// @[generators/baseband/src/main/scala/baseband/Controller.scala:438:14]
                io_bleBasebandControl_bleDisassembler_out_busy,	// @[generators/baseband/src/main/scala/baseband/Controller.scala:438:14]
  output        io_bleBasebandControl_baseAddr_valid,	// @[generators/baseband/src/main/scala/baseband/Controller.scala:438:14]
  output [31:0] io_bleBasebandControl_baseAddr_bits,	// @[generators/baseband/src/main/scala/baseband/Controller.scala:438:14]
  output        io_bleBasebandControl_loopback_1,	// @[generators/baseband/src/main/scala/baseband/Controller.scala:438:14]
  input         io_lrwpanBasebandControl_lrwpanAssembler_in_ready,	// @[generators/baseband/src/main/scala/baseband/Controller.scala:438:14]
  output        io_lrwpanBasebandControl_lrwpanAssembler_in_valid,	// @[generators/baseband/src/main/scala/baseband/Controller.scala:438:14]
  output [7:0]  io_lrwpanBasebandControl_lrwpanAssembler_in_bits_pduLength,	// @[generators/baseband/src/main/scala/baseband/Controller.scala:438:14]
  input         io_lrwpanBasebandControl_lrwpanAssembler_out_done,	// @[generators/baseband/src/main/scala/baseband/Controller.scala:438:14]
  output        io_lrwpanBasebandControl_lrwpanDisassembler_in_valid,	// @[generators/baseband/src/main/scala/baseband/Controller.scala:438:14]
  output [1:0]  io_lrwpanBasebandControl_lrwpanDisassembler_in_bits_command,	// @[generators/baseband/src/main/scala/baseband/Controller.scala:438:14]
  input  [7:0]  io_lrwpanBasebandControl_lrwpanDisassembler_out_length,	// @[generators/baseband/src/main/scala/baseband/Controller.scala:438:14]
  input         io_lrwpanBasebandControl_lrwpanDisassembler_out_flag_crc,	// @[generators/baseband/src/main/scala/baseband/Controller.scala:438:14]
                io_lrwpanBasebandControl_lrwpanDisassembler_out_done,	// @[generators/baseband/src/main/scala/baseband/Controller.scala:438:14]
                io_lrwpanBasebandControl_lrwpanDisassembler_out_busy,	// @[generators/baseband/src/main/scala/baseband/Controller.scala:438:14]
  output        io_lrwpanBasebandControl_baseAddr_valid,	// @[generators/baseband/src/main/scala/baseband/Controller.scala:438:14]
  output [31:0] io_lrwpanBasebandControl_baseAddr_bits,	// @[generators/baseband/src/main/scala/baseband/Controller.scala:438:14]
  output        io_lrwpanBasebandControl_loopback_1,	// @[generators/baseband/src/main/scala/baseband/Controller.scala:438:14]
                io_cmd_ready,	// @[generators/baseband/src/main/scala/baseband/Controller.scala:438:14]
  input         io_cmd_valid,	// @[generators/baseband/src/main/scala/baseband/Controller.scala:438:14]
  input  [3:0]  io_cmd_bits_inst_primaryInst,	// @[generators/baseband/src/main/scala/baseband/Controller.scala:438:14]
                io_cmd_bits_inst_secondaryInst,	// @[generators/baseband/src/main/scala/baseband/Controller.scala:438:14]
  input  [23:0] io_cmd_bits_inst_data,	// @[generators/baseband/src/main/scala/baseband/Controller.scala:438:14]
  input  [31:0] io_cmd_bits_additionalData,	// @[generators/baseband/src/main/scala/baseband/Controller.scala:438:14]
  output        io_constants_radioMode,	// @[generators/baseband/src/main/scala/baseband/Controller.scala:438:14]
  output [5:0]  io_constants_bleChannelIndex,	// @[generators/baseband/src/main/scala/baseband/Controller.scala:438:14]
                io_constants_lrwpanChannelIndex,	// @[generators/baseband/src/main/scala/baseband/Controller.scala:438:14]
  output [23:0] io_constants_crcSeed,	// @[generators/baseband/src/main/scala/baseband/Controller.scala:438:14]
  output [31:0] io_constants_accessAddress,	// @[generators/baseband/src/main/scala/baseband/Controller.scala:438:14]
  output [15:0] io_constants_shr,	// @[generators/baseband/src/main/scala/baseband/Controller.scala:438:14]
  input         io_dma_readReq_ready,	// @[generators/baseband/src/main/scala/baseband/Controller.scala:438:14]
  output        io_dma_readReq_valid,	// @[generators/baseband/src/main/scala/baseband/Controller.scala:438:14]
  output [31:0] io_dma_readReq_bits_addr,	// @[generators/baseband/src/main/scala/baseband/Controller.scala:438:14]
  output [8:0]  io_dma_readReq_bits_totalBytes,	// @[generators/baseband/src/main/scala/baseband/Controller.scala:438:14]
  input         io_dma_readResp_valid,	// @[generators/baseband/src/main/scala/baseband/Controller.scala:438:14]
  input  [8:0]  io_dma_readResp_bits_bytesRead,	// @[generators/baseband/src/main/scala/baseband/Controller.scala:438:14]
  output        io_modemControl_gfskTX_in_valid,	// @[generators/baseband/src/main/scala/baseband/Controller.scala:438:14]
  output [8:0]  io_modemControl_gfskTX_in_bits_totalBytes,	// @[generators/baseband/src/main/scala/baseband/Controller.scala:438:14]
  input         io_modemControl_mskTX_in_ready,	// @[generators/baseband/src/main/scala/baseband/Controller.scala:438:14]
  output        io_modemControl_mskTX_in_valid,	// @[generators/baseband/src/main/scala/baseband/Controller.scala:438:14]
  output [8:0]  io_modemControl_mskTX_in_bits_totalBytes,	// @[generators/baseband/src/main/scala/baseband/Controller.scala:438:14]
  input         io_modemControl_mskTX_out_done,	// @[generators/baseband/src/main/scala/baseband/Controller.scala:438:14]
                io_messages_rxErrorMessage_ready,	// @[generators/baseband/src/main/scala/baseband/Controller.scala:438:14]
  output        io_messages_rxErrorMessage_valid,	// @[generators/baseband/src/main/scala/baseband/Controller.scala:438:14]
  output [31:0] io_messages_rxErrorMessage_bits,	// @[generators/baseband/src/main/scala/baseband/Controller.scala:438:14]
  input         io_messages_rxFinishMessage_ready,	// @[generators/baseband/src/main/scala/baseband/Controller.scala:438:14]
  output        io_messages_rxFinishMessage_valid,	// @[generators/baseband/src/main/scala/baseband/Controller.scala:438:14]
  output [31:0] io_messages_rxFinishMessage_bits,	// @[generators/baseband/src/main/scala/baseband/Controller.scala:438:14]
  input         io_messages_txErrorMessage_ready,	// @[generators/baseband/src/main/scala/baseband/Controller.scala:438:14]
  output        io_messages_txErrorMessage_valid,	// @[generators/baseband/src/main/scala/baseband/Controller.scala:438:14]
  output [31:0] io_messages_txErrorMessage_bits,	// @[generators/baseband/src/main/scala/baseband/Controller.scala:438:14]
  output [2:0]  io_state_rxControllerState,	// @[generators/baseband/src/main/scala/baseband/Controller.scala:438:14]
  output [1:0]  io_state_txControllerState,	// @[generators/baseband/src/main/scala/baseband/Controller.scala:438:14]
  output [2:0]  io_state_mainControllerState	// @[generators/baseband/src/main/scala/baseband/Controller.scala:438:14]
);

  wire        _rxController_io_control_cmd_ready;	// @[generators/baseband/src/main/scala/baseband/Controller.scala:503:28]
  wire        _rxController_io_control_baseAddr_valid;	// @[generators/baseband/src/main/scala/baseband/Controller.scala:503:28]
  wire [31:0] _rxController_io_control_baseAddr_bits;	// @[generators/baseband/src/main/scala/baseband/Controller.scala:503:28]
  wire        _rxController_io_control_done;	// @[generators/baseband/src/main/scala/baseband/Controller.scala:503:28]
  wire        _txController_io_modemTXControl_in_valid;	// @[generators/baseband/src/main/scala/baseband/Controller.scala:484:28]
  wire [8:0]  _txController_io_modemTXControl_in_bits_totalBytes;	// @[generators/baseband/src/main/scala/baseband/Controller.scala:484:28]
  wire        _txController_io_control_done;	// @[generators/baseband/src/main/scala/baseband/Controller.scala:484:28]
  reg         constants_radioMode;	// @[generators/baseband/src/main/scala/baseband/Controller.scala:467:26]
  reg  [5:0]  constants_bleChannelIndex;	// @[generators/baseband/src/main/scala/baseband/Controller.scala:467:26]
  reg  [5:0]  constants_lrwpanChannelIndex;	// @[generators/baseband/src/main/scala/baseband/Controller.scala:467:26]
  reg  [23:0] constants_crcSeed;	// @[generators/baseband/src/main/scala/baseband/Controller.scala:467:26]
  reg  [31:0] constants_accessAddress;	// @[generators/baseband/src/main/scala/baseband/Controller.scala:467:26]
  reg  [15:0] constants_shr;	// @[generators/baseband/src/main/scala/baseband/Controller.scala:467:26]
  reg  [1:0]  state;	// @[generators/baseband/src/main/scala/baseband/Controller.scala:481:22]
  reg         txControllerCmdValid;	// @[generators/baseband/src/main/scala/baseband/Controller.scala:493:37]
  reg         txControllerCmd_command;	// @[generators/baseband/src/main/scala/baseband/Controller.scala:494:28]
  reg  [31:0] txControllerCmd_addr;	// @[generators/baseband/src/main/scala/baseband/Controller.scala:494:28]
  reg  [8:0]  txControllerCmd_totalBytes;	// @[generators/baseband/src/main/scala/baseband/Controller.scala:494:28]
  reg         txControllerDone;	// @[generators/baseband/src/main/scala/baseband/Controller.scala:500:33]
  reg         rxControllerCmdValid;	// @[generators/baseband/src/main/scala/baseband/Controller.scala:512:37]
  reg  [1:0]  rxControllerCmd_command;	// @[generators/baseband/src/main/scala/baseband/Controller.scala:513:28]
  reg  [31:0] rxControllerCmd_addr;	// @[generators/baseband/src/main/scala/baseband/Controller.scala:513:28]
  reg         rxControllerDone;	// @[generators/baseband/src/main/scala/baseband/Controller.scala:517:33]
  reg  [3:0]  loopbackMask;	// @[generators/baseband/src/main/scala/baseband/Controller.scala:520:29]
  wire        io_analog_offChipMode_rx_0 = state == 2'h2;	// @[generators/baseband/src/main/scala/baseband/Controller.scala:481:22, :525:40]
  wire        io_cmd_ready_0 = ~(|state) | io_analog_offChipMode_rx_0;	// @[generators/baseband/src/main/scala/baseband/Controller.scala:481:22, :525:40, :552:{25,36}]
  wire        _GEN = _rxController_io_control_cmd_ready & rxControllerCmdValid;	// @[generators/baseband/src/main/scala/baseband/Controller.scala:503:28, :512:37, src/main/scala/chisel3/util/Decoupled.scala:52:35]
  wire        _GEN_0 = io_cmd_bits_inst_secondaryInst == 4'h0;	// @[generators/baseband/src/main/scala/baseband/Controller.scala:477:19, :559:53]
  wire        _GEN_1 = io_cmd_bits_inst_secondaryInst == 4'h1;	// @[generators/baseband/src/main/scala/baseband/Controller.scala:559:53]
  wire        _GEN_2 = io_cmd_bits_inst_secondaryInst == 4'h2;	// @[generators/baseband/src/main/scala/baseband/Controller.scala:559:53]
  wire        _GEN_3 = io_cmd_bits_inst_secondaryInst == 4'h3;	// @[generators/baseband/src/main/scala/baseband/Controller.scala:559:53]
  wire        _GEN_4 = io_cmd_bits_inst_secondaryInst == 4'h4;	// @[generators/baseband/src/main/scala/baseband/Controller.scala:559:53]
  wire        _GEN_5 = rxControllerDone & txControllerDone;	// @[generators/baseband/src/main/scala/baseband/Controller.scala:500:33, :517:33, :650:30]
  wire        _GEN_6 = (&state) & _GEN_5;	// @[generators/baseband/src/main/scala/baseband/Controller.scala:481:22, :520:29, :554:17, :650:{30,50}, :651:22]
  wire        _GEN_7 = io_cmd_ready_0 & io_cmd_valid;	// @[generators/baseband/src/main/scala/baseband/Controller.scala:552:36, src/main/scala/chisel3/util/Decoupled.scala:52:35]
  wire        _GEN_8 = io_cmd_bits_inst_primaryInst == 4'h0;	// @[generators/baseband/src/main/scala/baseband/Controller.scala:477:19, :557:47]
  wire        _GEN_9 = io_cmd_bits_inst_primaryInst == 4'h1;	// @[generators/baseband/src/main/scala/baseband/Controller.scala:557:47, :559:53]
  wire        _GEN_10 = io_cmd_bits_inst_primaryInst == 4'h2;	// @[generators/baseband/src/main/scala/baseband/Controller.scala:557:47, :559:53]
  wire        _GEN_11 = ~_GEN_10 & (&io_cmd_bits_inst_primaryInst);	// @[generators/baseband/src/main/scala/baseband/Controller.scala:493:37, :557:47]
  wire        _GEN_12 = ~(|state) & _GEN_7;	// @[generators/baseband/src/main/scala/baseband/Controller.scala:481:22, :494:28, :552:25, :554:17, :556:26, :557:47, src/main/scala/chisel3/util/Decoupled.scala:52:35]
  wire        _GEN_13 = _GEN_8 | _GEN_9;	// @[generators/baseband/src/main/scala/baseband/Controller.scala:512:37, :557:47]
  wire        _GEN_14 = state == 2'h1;	// @[generators/baseband/src/main/scala/baseband/Controller.scala:481:22, :533:37, :554:17]
  wire        _GEN_15 = state == 2'h2;	// @[generators/baseband/src/main/scala/baseband/Controller.scala:481:22, :525:40, :554:17]
  wire        _GEN_16 = _GEN_7 & io_cmd_bits_inst_primaryInst == 4'h3;	// @[generators/baseband/src/main/scala/baseband/Controller.scala:559:53, :620:{25,56}, src/main/scala/chisel3/util/Decoupled.scala:52:35]
  wire        _GEN_17 = ~(|state) & _GEN_7 & _GEN_8;	// @[generators/baseband/src/main/scala/baseband/Controller.scala:467:26, :481:22, :552:25, :554:17, :556:26, :557:47, :559:53, src/main/scala/chisel3/util/Decoupled.scala:52:35]
  wire        _GEN_18 = _GEN_14 | _GEN_15;	// @[generators/baseband/src/main/scala/baseband/Controller.scala:520:29, :554:17]
  always @(posedge clock) begin
    if (reset) begin
      constants_radioMode <= 1'h0;	// @[generators/baseband/src/main/scala/baseband/Controller.scala:467:{26,58}]
      constants_bleChannelIndex <= 6'h13;	// @[generators/baseband/src/main/scala/baseband/Controller.scala:467:{26,58}]
      constants_lrwpanChannelIndex <= 6'h0;	// @[generators/baseband/src/main/scala/baseband/Controller.scala:467:26, :477:19]
      constants_crcSeed <= 24'h555555;	// @[generators/baseband/src/main/scala/baseband/Controller.scala:467:{26,58}]
      constants_accessAddress <= 32'h8E89BED6;	// @[generators/baseband/src/main/scala/baseband/Controller.scala:467:{26,58}]
      constants_shr <= 16'hA700;	// @[generators/baseband/src/main/scala/baseband/Controller.scala:467:{26,58}]
      state <= 2'h0;	// @[generators/baseband/src/main/scala/baseband/Controller.scala:481:22]
      txControllerCmdValid <= 1'h0;	// @[generators/baseband/src/main/scala/baseband/Controller.scala:467:58, :493:37]
      txControllerDone <= 1'h0;	// @[generators/baseband/src/main/scala/baseband/Controller.scala:467:58, :500:33]
      rxControllerCmdValid <= 1'h0;	// @[generators/baseband/src/main/scala/baseband/Controller.scala:467:58, :512:37]
      rxControllerDone <= 1'h0;	// @[generators/baseband/src/main/scala/baseband/Controller.scala:467:58, :517:33]
      loopbackMask <= 4'h0;	// @[generators/baseband/src/main/scala/baseband/Controller.scala:477:19, :520:29]
    end
    else begin
      if (~(|state) & _GEN_7 & _GEN_8 & _GEN_0)	// @[generators/baseband/src/main/scala/baseband/Controller.scala:467:26, :481:22, :552:25, :554:17, :556:26, :557:47, :559:53, :561:37, src/main/scala/chisel3/util/Decoupled.scala:52:35]
        constants_radioMode <= io_cmd_bits_additionalData[0];	// @[generators/baseband/src/main/scala/baseband/Controller.scala:467:26, :561:66]
      if (~_GEN_17 | _GEN_0 | _GEN_1 | _GEN_2 | _GEN_3 | ~_GEN_4) begin	// @[generators/baseband/src/main/scala/baseband/Controller.scala:467:26, :554:17, :556:26, :557:47, :559:53]
      end
      else	// @[generators/baseband/src/main/scala/baseband/Controller.scala:467:26, :554:17, :556:26, :557:47, :559:53]
        constants_bleChannelIndex <= io_cmd_bits_additionalData[5:0];	// @[generators/baseband/src/main/scala/baseband/Controller.scala:467:26, :573:72]
      if (~_GEN_17 | _GEN_0 | _GEN_1 | _GEN_2 | _GEN_3 | _GEN_4 | io_cmd_bits_inst_secondaryInst != 4'h5) begin	// @[generators/baseband/src/main/scala/baseband/Controller.scala:467:26, :554:17, :556:26, :557:47, :559:53]
      end
      else	// @[generators/baseband/src/main/scala/baseband/Controller.scala:467:26, :554:17, :556:26, :557:47, :559:53]
        constants_lrwpanChannelIndex <= io_cmd_bits_additionalData[5:0];	// @[generators/baseband/src/main/scala/baseband/Controller.scala:467:26, :576:75]
      if (~_GEN_17 | _GEN_0 | ~_GEN_1) begin	// @[generators/baseband/src/main/scala/baseband/Controller.scala:467:26, :554:17, :556:26, :557:47, :559:53]
      end
      else	// @[generators/baseband/src/main/scala/baseband/Controller.scala:467:26, :554:17, :556:26, :557:47, :559:53]
        constants_crcSeed <= io_cmd_bits_additionalData[23:0];	// @[generators/baseband/src/main/scala/baseband/Controller.scala:467:26, :564:64]
      if (~_GEN_17 | _GEN_0 | _GEN_1 | ~_GEN_2) begin	// @[generators/baseband/src/main/scala/baseband/Controller.scala:467:26, :554:17, :556:26, :557:47, :559:53]
      end
      else	// @[generators/baseband/src/main/scala/baseband/Controller.scala:467:26, :554:17, :556:26, :557:47, :559:53]
        constants_accessAddress <= io_cmd_bits_additionalData;	// @[generators/baseband/src/main/scala/baseband/Controller.scala:467:26]
      if (~_GEN_17 | _GEN_0 | _GEN_1 | _GEN_2 | ~_GEN_3) begin	// @[generators/baseband/src/main/scala/baseband/Controller.scala:467:26, :554:17, :556:26, :557:47, :559:53]
      end
      else	// @[generators/baseband/src/main/scala/baseband/Controller.scala:467:26, :554:17, :556:26, :557:47, :559:53]
        constants_shr <= io_cmd_bits_additionalData[15:0];	// @[generators/baseband/src/main/scala/baseband/Controller.scala:467:26, :570:60]
      if (|state) begin	// @[generators/baseband/src/main/scala/baseband/Controller.scala:481:22, :552:25]
        if (_GEN_14) begin	// @[generators/baseband/src/main/scala/baseband/Controller.scala:554:17]
          if (_txController_io_control_done)	// @[generators/baseband/src/main/scala/baseband/Controller.scala:484:28]
            state <= 2'h0;	// @[generators/baseband/src/main/scala/baseband/Controller.scala:481:22]
        end
        else if (_GEN_15) begin	// @[generators/baseband/src/main/scala/baseband/Controller.scala:554:17]
          if (_GEN_16 | ~_rxController_io_control_done) begin	// @[generators/baseband/src/main/scala/baseband/Controller.scala:481:22, :503:28, :620:{25,90}, :628:44]
          end
          else	// @[generators/baseband/src/main/scala/baseband/Controller.scala:481:22, :620:90, :628:44]
            state <= 2'h0;	// @[generators/baseband/src/main/scala/baseband/Controller.scala:481:22]
          rxControllerCmdValid <= _GEN_16 | ~_GEN & rxControllerCmdValid;	// @[generators/baseband/src/main/scala/baseband/Controller.scala:512:37, :620:{25,90}, :622:30, :624:48, :625:32, src/main/scala/chisel3/util/Decoupled.scala:52:35]
        end
        else begin	// @[generators/baseband/src/main/scala/baseband/Controller.scala:554:17]
          if (_GEN_6)	// @[generators/baseband/src/main/scala/baseband/Controller.scala:520:29, :554:17, :650:50, :651:22]
            state <= 2'h0;	// @[generators/baseband/src/main/scala/baseband/Controller.scala:481:22]
          rxControllerCmdValid <= ~((&state) & _GEN) & rxControllerCmdValid;	// @[generators/baseband/src/main/scala/baseband/Controller.scala:481:22, :512:37, :554:17, :634:47, :635:30, src/main/scala/chisel3/util/Decoupled.scala:52:35]
        end
        txControllerCmdValid <= ~_GEN_14 & (_GEN_15 | ~((&state) & txControllerCmdValid)) & txControllerCmdValid;	// @[generators/baseband/src/main/scala/baseband/Controller.scala:481:22, :493:37, :554:17, :611:47, :638:47, :639:30]
        if (_GEN_18 | ~_GEN_6) begin	// @[generators/baseband/src/main/scala/baseband/Controller.scala:520:29, :554:17, :650:50, :651:22]
        end
        else	// @[generators/baseband/src/main/scala/baseband/Controller.scala:520:29, :554:17]
          loopbackMask <= 4'h0;	// @[generators/baseband/src/main/scala/baseband/Controller.scala:477:19, :520:29]
      end
      else begin	// @[generators/baseband/src/main/scala/baseband/Controller.scala:552:25]
        if (~_GEN_7 | _GEN_8) begin	// @[generators/baseband/src/main/scala/baseband/Controller.scala:481:22, :520:29, :556:26, :557:47, src/main/scala/chisel3/util/Decoupled.scala:52:35]
        end
        else if (_GEN_9)	// @[generators/baseband/src/main/scala/baseband/Controller.scala:557:47]
          state <= 2'h1;	// @[generators/baseband/src/main/scala/baseband/Controller.scala:481:22, :533:37]
        else if (_GEN_10)	// @[generators/baseband/src/main/scala/baseband/Controller.scala:557:47]
          state <= 2'h2;	// @[generators/baseband/src/main/scala/baseband/Controller.scala:481:22, :525:40]
        else if (&io_cmd_bits_inst_primaryInst)	// @[generators/baseband/src/main/scala/baseband/Controller.scala:557:47]
          state <= 2'h3;	// @[generators/baseband/src/main/scala/baseband/Controller.scala:481:22, :525:57]
        txControllerCmdValid <= _GEN_7 & ~_GEN_8 & (_GEN_9 | _GEN_11) | txControllerCmdValid;	// @[generators/baseband/src/main/scala/baseband/Controller.scala:493:37, :556:26, :557:47, :581:34, src/main/scala/chisel3/util/Decoupled.scala:52:35]
        rxControllerCmdValid <= _GEN_7 & ~_GEN_13 & (_GEN_10 | (&io_cmd_bits_inst_primaryInst)) | rxControllerCmdValid;	// @[generators/baseband/src/main/scala/baseband/Controller.scala:512:37, :556:26, :557:47, :589:34, :602:34, src/main/scala/chisel3/util/Decoupled.scala:52:35]
        if (~_GEN_7 | _GEN_8 | _GEN_9 | _GEN_10 | ~(&io_cmd_bits_inst_primaryInst)) begin	// @[generators/baseband/src/main/scala/baseband/Controller.scala:520:29, :556:26, :557:47, src/main/scala/chisel3/util/Decoupled.scala:52:35]
        end
        else	// @[generators/baseband/src/main/scala/baseband/Controller.scala:520:29, :556:26, :557:47]
          loopbackMask <= io_cmd_bits_inst_secondaryInst;	// @[generators/baseband/src/main/scala/baseband/Controller.scala:520:29]
      end
      if (~(|state) | _GEN_18 | ~(&state)) begin	// @[generators/baseband/src/main/scala/baseband/Controller.scala:481:22, :500:33, :517:33, :520:29, :552:25, :554:17]
      end
      else begin	// @[generators/baseband/src/main/scala/baseband/Controller.scala:517:33, :554:17]
        txControllerDone <= ~_GEN_5 & (_txController_io_control_done | txControllerDone);	// @[generators/baseband/src/main/scala/baseband/Controller.scala:484:28, :500:33, :642:43, :643:26, :650:{30,50}, :653:26]
        rxControllerDone <= ~_GEN_5 & (_rxController_io_control_done | rxControllerDone);	// @[generators/baseband/src/main/scala/baseband/Controller.scala:503:28, :517:33, :642:43, :646:43, :647:26, :650:{30,50}, :653:26, :654:26]
      end
    end
    if (~_GEN_12 | _GEN_8) begin	// @[generators/baseband/src/main/scala/baseband/Controller.scala:494:28, :554:17, :556:26, :557:47]
    end
    else	// @[generators/baseband/src/main/scala/baseband/Controller.scala:494:28, :554:17, :556:26, :557:47]
      txControllerCmd_command <= ~_GEN_9 & (_GEN_11 | txControllerCmd_command);	// @[generators/baseband/src/main/scala/baseband/Controller.scala:493:37, :494:28, :557:47, :584:37]
    if (~_GEN_12 | _GEN_8 | ~(_GEN_9 | ~(_GEN_10 | ~(&io_cmd_bits_inst_primaryInst)))) begin	// @[generators/baseband/src/main/scala/baseband/Controller.scala:494:28, :520:29, :554:17, :556:26, :557:47, :582:40]
    end
    else begin	// @[generators/baseband/src/main/scala/baseband/Controller.scala:494:28, :554:17, :556:26, :557:47]
      txControllerCmd_addr <= io_cmd_bits_additionalData;	// @[generators/baseband/src/main/scala/baseband/Controller.scala:494:28]
      txControllerCmd_totalBytes <= io_cmd_bits_inst_data[8:0];	// @[generators/baseband/src/main/scala/baseband/Controller.scala:494:28, :582:40]
    end
    if (|state) begin	// @[generators/baseband/src/main/scala/baseband/Controller.scala:481:22, :552:25]
      if (_GEN_14 | ~(_GEN_15 & _GEN_16)) begin	// @[generators/baseband/src/main/scala/baseband/Controller.scala:513:28, :554:17, :620:{25,90}, :621:33]
      end
      else	// @[generators/baseband/src/main/scala/baseband/Controller.scala:513:28, :554:17]
        rxControllerCmd_command <= 2'h2;	// @[generators/baseband/src/main/scala/baseband/Controller.scala:513:28, :525:40]
    end
    else if (~_GEN_7 | _GEN_13) begin	// @[generators/baseband/src/main/scala/baseband/Controller.scala:512:37, :513:28, :520:29, :556:26, :557:47, src/main/scala/chisel3/util/Decoupled.scala:52:35]
    end
    else if (_GEN_10)	// @[generators/baseband/src/main/scala/baseband/Controller.scala:557:47]
      rxControllerCmd_command <= 2'h0;	// @[generators/baseband/src/main/scala/baseband/Controller.scala:481:22, :513:28]
    else if (&io_cmd_bits_inst_primaryInst)	// @[generators/baseband/src/main/scala/baseband/Controller.scala:557:47]
      rxControllerCmd_command <= 2'h1;	// @[generators/baseband/src/main/scala/baseband/Controller.scala:513:28, :533:37]
    if (~_GEN_12 | _GEN_13) begin	// @[generators/baseband/src/main/scala/baseband/Controller.scala:494:28, :512:37, :513:28, :554:17, :556:26, :557:47]
    end
    else if (_GEN_10)	// @[generators/baseband/src/main/scala/baseband/Controller.scala:557:47]
      rxControllerCmd_addr <= io_cmd_bits_additionalData;	// @[generators/baseband/src/main/scala/baseband/Controller.scala:513:28]
    else if (&io_cmd_bits_inst_primaryInst)	// @[generators/baseband/src/main/scala/baseband/Controller.scala:557:47]
      rxControllerCmd_addr <= io_cmd_bits_additionalData + {8'h0, io_cmd_bits_inst_data} + 32'h4 & 32'hFFFFFFFC;	// @[generators/baseband/src/main/scala/baseband/Controller.scala:513:28, :604:{65,89,104,107}]
  end // always @(posedge)
  `ifdef ENABLE_INITIAL_REG_
    `ifdef FIRRTL_BEFORE_INITIAL
      `FIRRTL_BEFORE_INITIAL
    `endif // FIRRTL_BEFORE_INITIAL
    logic [31:0] _RANDOM[0:5];
    initial begin
      `ifdef INIT_RANDOM_PROLOG_
        `INIT_RANDOM_PROLOG_
      `endif // INIT_RANDOM_PROLOG_
      `ifdef RANDOMIZE_REG_INIT
        for (logic [2:0] i = 3'h0; i < 3'h6; i += 3'h1) begin
          _RANDOM[i] = `RANDOM;
        end
        constants_radioMode = _RANDOM[3'h0][0];	// @[generators/baseband/src/main/scala/baseband/Controller.scala:467:26]
        constants_bleChannelIndex = _RANDOM[3'h0][6:1];	// @[generators/baseband/src/main/scala/baseband/Controller.scala:467:26]
        constants_lrwpanChannelIndex = _RANDOM[3'h0][12:7];	// @[generators/baseband/src/main/scala/baseband/Controller.scala:467:26]
        constants_crcSeed = {_RANDOM[3'h0][31:13], _RANDOM[3'h1][4:0]};	// @[generators/baseband/src/main/scala/baseband/Controller.scala:467:26]
        constants_accessAddress = {_RANDOM[3'h1][31:5], _RANDOM[3'h2][4:0]};	// @[generators/baseband/src/main/scala/baseband/Controller.scala:467:26]
        constants_shr = _RANDOM[3'h2][20:5];	// @[generators/baseband/src/main/scala/baseband/Controller.scala:467:26]
        state = _RANDOM[3'h2][22:21];	// @[generators/baseband/src/main/scala/baseband/Controller.scala:467:26, :481:22]
        txControllerCmdValid = _RANDOM[3'h2][23];	// @[generators/baseband/src/main/scala/baseband/Controller.scala:467:26, :493:37]
        txControllerCmd_command = _RANDOM[3'h2][24];	// @[generators/baseband/src/main/scala/baseband/Controller.scala:467:26, :494:28]
        txControllerCmd_addr = {_RANDOM[3'h2][31:25], _RANDOM[3'h3][24:0]};	// @[generators/baseband/src/main/scala/baseband/Controller.scala:467:26, :494:28]
        txControllerCmd_totalBytes = {_RANDOM[3'h3][31:25], _RANDOM[3'h4][1:0]};	// @[generators/baseband/src/main/scala/baseband/Controller.scala:494:28]
        txControllerDone = _RANDOM[3'h4][2];	// @[generators/baseband/src/main/scala/baseband/Controller.scala:494:28, :500:33]
        rxControllerCmdValid = _RANDOM[3'h4][3];	// @[generators/baseband/src/main/scala/baseband/Controller.scala:494:28, :512:37]
        rxControllerCmd_command = _RANDOM[3'h4][5:4];	// @[generators/baseband/src/main/scala/baseband/Controller.scala:494:28, :513:28]
        rxControllerCmd_addr = {_RANDOM[3'h4][31:6], _RANDOM[3'h5][5:0]};	// @[generators/baseband/src/main/scala/baseband/Controller.scala:494:28, :513:28]
        rxControllerDone = _RANDOM[3'h5][6];	// @[generators/baseband/src/main/scala/baseband/Controller.scala:513:28, :517:33]
        loopbackMask = _RANDOM[3'h5][10:7];	// @[generators/baseband/src/main/scala/baseband/Controller.scala:513:28, :520:29]
      `endif // RANDOMIZE_REG_INIT
    end // initial
    `ifdef FIRRTL_AFTER_INITIAL
      `FIRRTL_AFTER_INITIAL
    `endif // FIRRTL_AFTER_INITIAL
  `endif // ENABLE_INITIAL_REG_
  TXChainController txController (	// @[generators/baseband/src/main/scala/baseband/Controller.scala:484:28]
    .clock                                       (clock),
    .reset                                       (reset),
    .io_interrupt_error                          (io_interrupt_txError),
    .io_interrupt_txFinish                       (io_interrupt_txFinish),
    .io_bleAssemblerControl_in_ready             (io_bleBasebandControl_bleAssembler_in_ready),
    .io_bleAssemblerControl_in_valid             (io_bleBasebandControl_bleAssembler_in_valid),
    .io_bleAssemblerControl_in_bits_aa           (io_bleBasebandControl_bleAssembler_in_bits_aa),
    .io_bleAssemblerControl_in_bits_pduLength    (io_bleBasebandControl_bleAssembler_in_bits_pduLength),
    .io_bleAssemblerControl_out_done             (io_bleBasebandControl_bleAssembler_out_done),
    .io_lrwpanAssemblerControl_in_ready          (io_lrwpanBasebandControl_lrwpanAssembler_in_ready),
    .io_lrwpanAssemblerControl_in_valid          (io_lrwpanBasebandControl_lrwpanAssembler_in_valid),
    .io_lrwpanAssemblerControl_in_bits_pduLength (io_lrwpanBasebandControl_lrwpanAssembler_in_bits_pduLength),
    .io_lrwpanAssemblerControl_out_done          (io_lrwpanBasebandControl_lrwpanAssembler_out_done),
    .io_modemTXControl_in_ready                  (io_modemControl_mskTX_in_ready),
    .io_modemTXControl_in_valid                  (_txController_io_modemTXControl_in_valid),
    .io_modemTXControl_in_bits_totalBytes        (_txController_io_modemTXControl_in_bits_totalBytes),
    .io_modemTXControl_out_done                  (io_modemControl_mskTX_out_done),
    .io_dma_readReq_ready                        (io_dma_readReq_ready),
    .io_dma_readReq_valid                        (io_dma_readReq_valid),
    .io_dma_readReq_bits_addr                    (io_dma_readReq_bits_addr),
    .io_dma_readReq_bits_totalBytes              (io_dma_readReq_bits_totalBytes),
    .io_dma_readResp_valid                       (io_dma_readResp_valid),
    .io_dma_readResp_bits_bytesRead              (io_dma_readResp_bits_bytesRead),
    .io_constants_radioMode                      (constants_radioMode),	// @[generators/baseband/src/main/scala/baseband/Controller.scala:467:26]
    .io_constants_accessAddress                  (constants_accessAddress),	// @[generators/baseband/src/main/scala/baseband/Controller.scala:467:26]
    .io_control_cmd_valid                        (txControllerCmdValid),	// @[generators/baseband/src/main/scala/baseband/Controller.scala:493:37]
    .io_control_cmd_bits_command                 (txControllerCmd_command),	// @[generators/baseband/src/main/scala/baseband/Controller.scala:494:28]
    .io_control_cmd_bits_addr                    (txControllerCmd_addr),	// @[generators/baseband/src/main/scala/baseband/Controller.scala:494:28]
    .io_control_cmd_bits_totalBytes              (txControllerCmd_totalBytes),	// @[generators/baseband/src/main/scala/baseband/Controller.scala:494:28]
    .io_control_done                             (_txController_io_control_done),
    .io_messages_txErrorMessage_ready            (io_messages_txErrorMessage_ready),
    .io_messages_txErrorMessage_valid            (io_messages_txErrorMessage_valid),
    .io_messages_txErrorMessage_bits             (io_messages_txErrorMessage_bits),
    .io_state                                    (io_state_txControllerState)
  );
  RXChainController rxController (	// @[generators/baseband/src/main/scala/baseband/Controller.scala:503:28]
    .clock                                        (clock),
    .reset                                        (reset),
    .io_interrupt_error                           (io_interrupt_rxError),
    .io_interrupt_rxStart                         (io_interrupt_rxStart),
    .io_interrupt_rxFinish                        (io_interrupt_rxFinish),
    .io_bleDisassemblerControl_in_valid           (io_bleBasebandControl_bleDisassembler_in_valid),
    .io_bleDisassemblerControl_in_bits_command    (io_bleBasebandControl_bleDisassembler_in_bits_command),
    .io_bleDisassemblerControl_out_length         (io_bleBasebandControl_bleDisassembler_out_length),
    .io_bleDisassemblerControl_out_flag_crc       (io_bleBasebandControl_bleDisassembler_out_flag_crc),
    .io_bleDisassemblerControl_out_done           (io_bleBasebandControl_bleDisassembler_out_done),
    .io_bleDisassemblerControl_out_busy           (io_bleBasebandControl_bleDisassembler_out_busy),
    .io_lrwpanDisassemblerControl_in_valid        (io_lrwpanBasebandControl_lrwpanDisassembler_in_valid),
    .io_lrwpanDisassemblerControl_in_bits_command (io_lrwpanBasebandControl_lrwpanDisassembler_in_bits_command),
    .io_lrwpanDisassemblerControl_out_length      (io_lrwpanBasebandControl_lrwpanDisassembler_out_length),
    .io_lrwpanDisassemblerControl_out_flag_crc    (io_lrwpanBasebandControl_lrwpanDisassembler_out_flag_crc),
    .io_lrwpanDisassemblerControl_out_done        (io_lrwpanBasebandControl_lrwpanDisassembler_out_done),
    .io_lrwpanDisassemblerControl_out_busy        (io_lrwpanBasebandControl_lrwpanDisassembler_out_busy),
    .io_constants_radioMode                       (constants_radioMode),	// @[generators/baseband/src/main/scala/baseband/Controller.scala:467:26]
    .io_control_cmd_ready                         (_rxController_io_control_cmd_ready),
    .io_control_cmd_valid                         (rxControllerCmdValid),	// @[generators/baseband/src/main/scala/baseband/Controller.scala:512:37]
    .io_control_cmd_bits_command                  (rxControllerCmd_command),	// @[generators/baseband/src/main/scala/baseband/Controller.scala:513:28]
    .io_control_cmd_bits_addr                     (rxControllerCmd_addr),	// @[generators/baseband/src/main/scala/baseband/Controller.scala:513:28]
    .io_control_baseAddr_valid                    (_rxController_io_control_baseAddr_valid),
    .io_control_baseAddr_bits                     (_rxController_io_control_baseAddr_bits),
    .io_control_done                              (_rxController_io_control_done),
    .io_messages_rxErrorMessage_ready             (io_messages_rxErrorMessage_ready),
    .io_messages_rxErrorMessage_valid             (io_messages_rxErrorMessage_valid),
    .io_messages_rxErrorMessage_bits              (io_messages_rxErrorMessage_bits),
    .io_messages_rxFinishMessage_ready            (io_messages_rxFinishMessage_ready),
    .io_messages_rxFinishMessage_valid            (io_messages_rxFinishMessage_valid),
    .io_messages_rxFinishMessage_bits             (io_messages_rxFinishMessage_bits),
    .io_state                                     (io_state_rxControllerState)
  );
  assign io_analog_offChipMode_rx = io_analog_offChipMode_rx_0;	// @[generators/baseband/src/main/scala/baseband/Controller.scala:525:40]
  assign io_analog_offChipMode_tx = state == 2'h1;	// @[generators/baseband/src/main/scala/baseband/Controller.scala:481:22, :533:37]
  assign io_analog_enable_rx_mix = io_analog_offChipMode_rx_0 | (&state);	// @[generators/baseband/src/main/scala/baseband/Controller.scala:481:22, :525:{40,49,57}]
  assign io_analog_enable_rx_buf = io_analog_offChipMode_rx_0 | (&state);	// @[generators/baseband/src/main/scala/baseband/Controller.scala:481:22, :525:{40,57}, :526:49]
  assign io_analog_enable_rx_tia = io_analog_offChipMode_rx_0 | (&state);	// @[generators/baseband/src/main/scala/baseband/Controller.scala:481:22, :525:{40,57}, :527:49]
  assign io_analog_enable_rx_vga = io_analog_offChipMode_rx_0 | (&state);	// @[generators/baseband/src/main/scala/baseband/Controller.scala:481:22, :525:{40,57}, :528:49]
  assign io_analog_enable_rx_bpf = io_analog_offChipMode_rx_0 | (&state);	// @[generators/baseband/src/main/scala/baseband/Controller.scala:481:22, :525:{40,57}, :529:49]
  assign io_bleBasebandControl_baseAddr_valid = _rxController_io_control_baseAddr_valid;	// @[generators/baseband/src/main/scala/baseband/Controller.scala:503:28]
  assign io_bleBasebandControl_baseAddr_bits = _rxController_io_control_baseAddr_bits;	// @[generators/baseband/src/main/scala/baseband/Controller.scala:503:28]
  assign io_bleBasebandControl_loopback_1 = loopbackMask[1];	// @[generators/baseband/src/main/scala/baseband/Controller.scala:520:29, :521:{49,55}]
  assign io_lrwpanBasebandControl_baseAddr_valid = _rxController_io_control_baseAddr_valid;	// @[generators/baseband/src/main/scala/baseband/Controller.scala:503:28]
  assign io_lrwpanBasebandControl_baseAddr_bits = _rxController_io_control_baseAddr_bits;	// @[generators/baseband/src/main/scala/baseband/Controller.scala:503:28]
  assign io_lrwpanBasebandControl_loopback_1 = loopbackMask[1];	// @[generators/baseband/src/main/scala/baseband/Controller.scala:520:29, :521:{49,55}]
  assign io_cmd_ready = io_cmd_ready_0;	// @[generators/baseband/src/main/scala/baseband/Controller.scala:552:36]
  assign io_constants_radioMode = constants_radioMode;	// @[generators/baseband/src/main/scala/baseband/Controller.scala:467:26]
  assign io_constants_bleChannelIndex = constants_bleChannelIndex;	// @[generators/baseband/src/main/scala/baseband/Controller.scala:467:26]
  assign io_constants_lrwpanChannelIndex = constants_lrwpanChannelIndex;	// @[generators/baseband/src/main/scala/baseband/Controller.scala:467:26]
  assign io_constants_crcSeed = constants_crcSeed;	// @[generators/baseband/src/main/scala/baseband/Controller.scala:467:26]
  assign io_constants_accessAddress = constants_accessAddress;	// @[generators/baseband/src/main/scala/baseband/Controller.scala:467:26]
  assign io_constants_shr = constants_shr;	// @[generators/baseband/src/main/scala/baseband/Controller.scala:467:26]
  assign io_modemControl_gfskTX_in_valid = _txController_io_modemTXControl_in_valid;	// @[generators/baseband/src/main/scala/baseband/Controller.scala:484:28]
  assign io_modemControl_gfskTX_in_bits_totalBytes = _txController_io_modemTXControl_in_bits_totalBytes;	// @[generators/baseband/src/main/scala/baseband/Controller.scala:484:28]
  assign io_modemControl_mskTX_in_valid = _txController_io_modemTXControl_in_valid;	// @[generators/baseband/src/main/scala/baseband/Controller.scala:484:28]
  assign io_modemControl_mskTX_in_bits_totalBytes = _txController_io_modemTXControl_in_bits_totalBytes;	// @[generators/baseband/src/main/scala/baseband/Controller.scala:484:28]
  assign io_state_mainControllerState = {1'h0, state};	// @[generators/baseband/src/main/scala/baseband/Controller.scala:467:58, :481:22, :538:32]
endmodule

