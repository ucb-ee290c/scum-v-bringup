// Generated by CIRCT unknown git version
// Standard header to adapt well known macros for register randomization.
`ifndef RANDOMIZE
  `ifdef RANDOMIZE_MEM_INIT
    `define RANDOMIZE
  `endif // RANDOMIZE_MEM_INIT
`endif // not def RANDOMIZE
`ifndef RANDOMIZE
  `ifdef RANDOMIZE_REG_INIT
    `define RANDOMIZE
  `endif // RANDOMIZE_REG_INIT
`endif // not def RANDOMIZE

// RANDOM may be set to an expression that produces a 32-bit random unsigned value.
`ifndef RANDOM
  `define RANDOM $random
`endif // not def RANDOM

// Users can define INIT_RANDOM as general code that gets injected into the
// initializer block for modules with registers.
`ifndef INIT_RANDOM
  `define INIT_RANDOM
`endif // not def INIT_RANDOM

// If using random initialization, you can also define RANDOMIZE_DELAY to
// customize the delay used, otherwise 0.002 is used.
`ifndef RANDOMIZE_DELAY
  `define RANDOMIZE_DELAY 0.002
`endif // not def RANDOMIZE_DELAY

// Define INIT_RANDOM_PROLOG_ for use in our modules below.
`ifndef INIT_RANDOM_PROLOG_
  `ifdef RANDOMIZE
    `ifdef VERILATOR
      `define INIT_RANDOM_PROLOG_ `INIT_RANDOM
    `else  // VERILATOR
      `define INIT_RANDOM_PROLOG_ `INIT_RANDOM #`RANDOMIZE_DELAY begin end
    `endif // VERILATOR
  `else  // RANDOMIZE
    `define INIT_RANDOM_PROLOG_
  `endif // RANDOMIZE
`endif // not def INIT_RANDOM_PROLOG_

// Include register initializers in init blocks unless synthesis is set
`ifndef SYNTHESIS
  `ifndef ENABLE_INITIAL_REG_
    `define ENABLE_INITIAL_REG_
  `endif // not def ENABLE_INITIAL_REG_
`endif // not def SYNTHESIS

// Include rmemory initializers in init blocks unless synthesis is set
`ifndef SYNTHESIS
  `ifndef ENABLE_INITIAL_MEM_
    `define ENABLE_INITIAL_MEM_
  `endif // not def ENABLE_INITIAL_MEM_
`endif // not def SYNTHESIS

// Standard header to adapt well known macros for prints and assertions.

// Users can define 'PRINTF_COND' to add an extra gate to prints.
`ifndef PRINTF_COND_
  `ifdef PRINTF_COND
    `define PRINTF_COND_ (`PRINTF_COND)
  `else  // PRINTF_COND
    `define PRINTF_COND_ 1
  `endif // PRINTF_COND
`endif // not def PRINTF_COND_

// Users can define 'ASSERT_VERBOSE_COND' to add an extra gate to assert error printing.
`ifndef ASSERT_VERBOSE_COND_
  `ifdef ASSERT_VERBOSE_COND
    `define ASSERT_VERBOSE_COND_ (`ASSERT_VERBOSE_COND)
  `else  // ASSERT_VERBOSE_COND
    `define ASSERT_VERBOSE_COND_ 1
  `endif // ASSERT_VERBOSE_COND
`endif // not def ASSERT_VERBOSE_COND_

// Users can define 'STOP_COND' to add an extra gate to stop conditions.
`ifndef STOP_COND_
  `ifdef STOP_COND
    `define STOP_COND_ (`STOP_COND)
  `else  // STOP_COND
    `define STOP_COND_ 1
  `endif // STOP_COND
`endif // not def STOP_COND_

module TLBroadcast(
  input         clock,
                reset,
  output        auto_in_a_ready,	// @[generators/rocket-chip/src/main/scala/diplomacy/LazyModule.scala:366:18]
  input         auto_in_a_valid,	// @[generators/rocket-chip/src/main/scala/diplomacy/LazyModule.scala:366:18]
  input  [2:0]  auto_in_a_bits_opcode,	// @[generators/rocket-chip/src/main/scala/diplomacy/LazyModule.scala:366:18]
                auto_in_a_bits_param,	// @[generators/rocket-chip/src/main/scala/diplomacy/LazyModule.scala:366:18]
                auto_in_a_bits_size,	// @[generators/rocket-chip/src/main/scala/diplomacy/LazyModule.scala:366:18]
  input  [9:0]  auto_in_a_bits_source,	// @[generators/rocket-chip/src/main/scala/diplomacy/LazyModule.scala:366:18]
  input  [31:0] auto_in_a_bits_address,	// @[generators/rocket-chip/src/main/scala/diplomacy/LazyModule.scala:366:18]
  input  [3:0]  auto_in_a_bits_mask,	// @[generators/rocket-chip/src/main/scala/diplomacy/LazyModule.scala:366:18]
  input  [31:0] auto_in_a_bits_data,	// @[generators/rocket-chip/src/main/scala/diplomacy/LazyModule.scala:366:18]
  input         auto_in_a_bits_corrupt,	// @[generators/rocket-chip/src/main/scala/diplomacy/LazyModule.scala:366:18]
                auto_in_b_ready,	// @[generators/rocket-chip/src/main/scala/diplomacy/LazyModule.scala:366:18]
  output        auto_in_b_valid,	// @[generators/rocket-chip/src/main/scala/diplomacy/LazyModule.scala:366:18]
  output [1:0]  auto_in_b_bits_param,	// @[generators/rocket-chip/src/main/scala/diplomacy/LazyModule.scala:366:18]
  output [31:0] auto_in_b_bits_address,	// @[generators/rocket-chip/src/main/scala/diplomacy/LazyModule.scala:366:18]
  output        auto_in_c_ready,	// @[generators/rocket-chip/src/main/scala/diplomacy/LazyModule.scala:366:18]
  input         auto_in_c_valid,	// @[generators/rocket-chip/src/main/scala/diplomacy/LazyModule.scala:366:18]
  input  [2:0]  auto_in_c_bits_opcode,	// @[generators/rocket-chip/src/main/scala/diplomacy/LazyModule.scala:366:18]
                auto_in_c_bits_param,	// @[generators/rocket-chip/src/main/scala/diplomacy/LazyModule.scala:366:18]
                auto_in_c_bits_size,	// @[generators/rocket-chip/src/main/scala/diplomacy/LazyModule.scala:366:18]
  input  [9:0]  auto_in_c_bits_source,	// @[generators/rocket-chip/src/main/scala/diplomacy/LazyModule.scala:366:18]
  input  [31:0] auto_in_c_bits_address,	// @[generators/rocket-chip/src/main/scala/diplomacy/LazyModule.scala:366:18]
                auto_in_c_bits_data,	// @[generators/rocket-chip/src/main/scala/diplomacy/LazyModule.scala:366:18]
  input         auto_in_c_bits_corrupt,	// @[generators/rocket-chip/src/main/scala/diplomacy/LazyModule.scala:366:18]
                auto_in_d_ready,	// @[generators/rocket-chip/src/main/scala/diplomacy/LazyModule.scala:366:18]
  output        auto_in_d_valid,	// @[generators/rocket-chip/src/main/scala/diplomacy/LazyModule.scala:366:18]
  output [2:0]  auto_in_d_bits_opcode,	// @[generators/rocket-chip/src/main/scala/diplomacy/LazyModule.scala:366:18]
  output [1:0]  auto_in_d_bits_param,	// @[generators/rocket-chip/src/main/scala/diplomacy/LazyModule.scala:366:18]
  output [2:0]  auto_in_d_bits_size,	// @[generators/rocket-chip/src/main/scala/diplomacy/LazyModule.scala:366:18]
  output [9:0]  auto_in_d_bits_source,	// @[generators/rocket-chip/src/main/scala/diplomacy/LazyModule.scala:366:18]
  output [1:0]  auto_in_d_bits_sink,	// @[generators/rocket-chip/src/main/scala/diplomacy/LazyModule.scala:366:18]
  output [31:0] auto_in_d_bits_data,	// @[generators/rocket-chip/src/main/scala/diplomacy/LazyModule.scala:366:18]
  input         auto_in_e_valid,	// @[generators/rocket-chip/src/main/scala/diplomacy/LazyModule.scala:366:18]
  input  [1:0]  auto_in_e_bits_sink,	// @[generators/rocket-chip/src/main/scala/diplomacy/LazyModule.scala:366:18]
  input         auto_out_a_ready,	// @[generators/rocket-chip/src/main/scala/diplomacy/LazyModule.scala:366:18]
  output        auto_out_a_valid,	// @[generators/rocket-chip/src/main/scala/diplomacy/LazyModule.scala:366:18]
  output [2:0]  auto_out_a_bits_opcode,	// @[generators/rocket-chip/src/main/scala/diplomacy/LazyModule.scala:366:18]
                auto_out_a_bits_param,	// @[generators/rocket-chip/src/main/scala/diplomacy/LazyModule.scala:366:18]
                auto_out_a_bits_size,	// @[generators/rocket-chip/src/main/scala/diplomacy/LazyModule.scala:366:18]
  output [11:0] auto_out_a_bits_source,	// @[generators/rocket-chip/src/main/scala/diplomacy/LazyModule.scala:366:18]
  output [31:0] auto_out_a_bits_address,	// @[generators/rocket-chip/src/main/scala/diplomacy/LazyModule.scala:366:18]
  output [3:0]  auto_out_a_bits_mask,	// @[generators/rocket-chip/src/main/scala/diplomacy/LazyModule.scala:366:18]
  output [31:0] auto_out_a_bits_data,	// @[generators/rocket-chip/src/main/scala/diplomacy/LazyModule.scala:366:18]
  output        auto_out_d_ready,	// @[generators/rocket-chip/src/main/scala/diplomacy/LazyModule.scala:366:18]
  input         auto_out_d_valid,	// @[generators/rocket-chip/src/main/scala/diplomacy/LazyModule.scala:366:18]
  input  [2:0]  auto_out_d_bits_opcode,	// @[generators/rocket-chip/src/main/scala/diplomacy/LazyModule.scala:366:18]
                auto_out_d_bits_size,	// @[generators/rocket-chip/src/main/scala/diplomacy/LazyModule.scala:366:18]
  input  [11:0] auto_out_d_bits_source,	// @[generators/rocket-chip/src/main/scala/diplomacy/LazyModule.scala:366:18]
  input  [31:0] auto_out_d_bits_data	// @[generators/rocket-chip/src/main/scala/diplomacy/LazyModule.scala:366:18]
);

  reg  [3:0]  a_first_counter;	// @[generators/rocket-chip/src/main/scala/tilelink/Edges.scala:229:27]
  reg         probe_todo;	// @[generators/rocket-chip/src/main/scala/tilelink/Broadcast.scala:215:31]
  wire        putfull_ready;	// @[generators/rocket-chip/src/main/scala/tilelink/Arbiter.scala:94:31]
  wire        d_normal_ready;	// @[generators/rocket-chip/src/main/scala/tilelink/Arbiter.scala:94:31]
  wire        releaseack_ready;	// @[generators/rocket-chip/src/main/scala/tilelink/Arbiter.scala:94:31]
  wire        nodeIn_c_ready;	// @[generators/rocket-chip/src/main/scala/tilelink/Broadcast.scala:184:32]
  wire [2:0]  d_normal_bits_opcode;	// @[generators/rocket-chip/src/main/scala/tilelink/Broadcast.scala:130:21, :131:24, :132:30]
  wire [9:0]  d_normal_bits_source;	// @[generators/rocket-chip/src/main/scala/tilelink/Broadcast.scala:130:21]
  wire        d_normal_valid;	// @[generators/rocket-chip/src/main/scala/tilelink/Broadcast.scala:129:48]
  wire        _TLBroadcastTracker_3_io_in_a_ready;	// @[generators/rocket-chip/src/main/scala/tilelink/Broadcast.scala:107:15]
  wire        _TLBroadcastTracker_3_io_out_a_valid;	// @[generators/rocket-chip/src/main/scala/tilelink/Broadcast.scala:107:15]
  wire [2:0]  _TLBroadcastTracker_3_io_out_a_bits_opcode;	// @[generators/rocket-chip/src/main/scala/tilelink/Broadcast.scala:107:15]
  wire [2:0]  _TLBroadcastTracker_3_io_out_a_bits_param;	// @[generators/rocket-chip/src/main/scala/tilelink/Broadcast.scala:107:15]
  wire [2:0]  _TLBroadcastTracker_3_io_out_a_bits_size;	// @[generators/rocket-chip/src/main/scala/tilelink/Broadcast.scala:107:15]
  wire [11:0] _TLBroadcastTracker_3_io_out_a_bits_source;	// @[generators/rocket-chip/src/main/scala/tilelink/Broadcast.scala:107:15]
  wire [31:0] _TLBroadcastTracker_3_io_out_a_bits_address;	// @[generators/rocket-chip/src/main/scala/tilelink/Broadcast.scala:107:15]
  wire [3:0]  _TLBroadcastTracker_3_io_out_a_bits_mask;	// @[generators/rocket-chip/src/main/scala/tilelink/Broadcast.scala:107:15]
  wire [31:0] _TLBroadcastTracker_3_io_out_a_bits_data;	// @[generators/rocket-chip/src/main/scala/tilelink/Broadcast.scala:107:15]
  wire [9:0]  _TLBroadcastTracker_3_io_source;	// @[generators/rocket-chip/src/main/scala/tilelink/Broadcast.scala:107:15]
  wire [25:0] _TLBroadcastTracker_3_io_line;	// @[generators/rocket-chip/src/main/scala/tilelink/Broadcast.scala:107:15]
  wire        _TLBroadcastTracker_3_io_idle;	// @[generators/rocket-chip/src/main/scala/tilelink/Broadcast.scala:107:15]
  wire        _TLBroadcastTracker_3_io_need_d;	// @[generators/rocket-chip/src/main/scala/tilelink/Broadcast.scala:107:15]
  wire        _TLBroadcastTracker_2_io_in_a_ready;	// @[generators/rocket-chip/src/main/scala/tilelink/Broadcast.scala:107:15]
  wire        _TLBroadcastTracker_2_io_out_a_valid;	// @[generators/rocket-chip/src/main/scala/tilelink/Broadcast.scala:107:15]
  wire [2:0]  _TLBroadcastTracker_2_io_out_a_bits_opcode;	// @[generators/rocket-chip/src/main/scala/tilelink/Broadcast.scala:107:15]
  wire [2:0]  _TLBroadcastTracker_2_io_out_a_bits_param;	// @[generators/rocket-chip/src/main/scala/tilelink/Broadcast.scala:107:15]
  wire [2:0]  _TLBroadcastTracker_2_io_out_a_bits_size;	// @[generators/rocket-chip/src/main/scala/tilelink/Broadcast.scala:107:15]
  wire [11:0] _TLBroadcastTracker_2_io_out_a_bits_source;	// @[generators/rocket-chip/src/main/scala/tilelink/Broadcast.scala:107:15]
  wire [31:0] _TLBroadcastTracker_2_io_out_a_bits_address;	// @[generators/rocket-chip/src/main/scala/tilelink/Broadcast.scala:107:15]
  wire [3:0]  _TLBroadcastTracker_2_io_out_a_bits_mask;	// @[generators/rocket-chip/src/main/scala/tilelink/Broadcast.scala:107:15]
  wire [31:0] _TLBroadcastTracker_2_io_out_a_bits_data;	// @[generators/rocket-chip/src/main/scala/tilelink/Broadcast.scala:107:15]
  wire [9:0]  _TLBroadcastTracker_2_io_source;	// @[generators/rocket-chip/src/main/scala/tilelink/Broadcast.scala:107:15]
  wire [25:0] _TLBroadcastTracker_2_io_line;	// @[generators/rocket-chip/src/main/scala/tilelink/Broadcast.scala:107:15]
  wire        _TLBroadcastTracker_2_io_idle;	// @[generators/rocket-chip/src/main/scala/tilelink/Broadcast.scala:107:15]
  wire        _TLBroadcastTracker_2_io_need_d;	// @[generators/rocket-chip/src/main/scala/tilelink/Broadcast.scala:107:15]
  wire        _TLBroadcastTracker_1_io_in_a_ready;	// @[generators/rocket-chip/src/main/scala/tilelink/Broadcast.scala:107:15]
  wire        _TLBroadcastTracker_1_io_out_a_valid;	// @[generators/rocket-chip/src/main/scala/tilelink/Broadcast.scala:107:15]
  wire [2:0]  _TLBroadcastTracker_1_io_out_a_bits_opcode;	// @[generators/rocket-chip/src/main/scala/tilelink/Broadcast.scala:107:15]
  wire [2:0]  _TLBroadcastTracker_1_io_out_a_bits_param;	// @[generators/rocket-chip/src/main/scala/tilelink/Broadcast.scala:107:15]
  wire [2:0]  _TLBroadcastTracker_1_io_out_a_bits_size;	// @[generators/rocket-chip/src/main/scala/tilelink/Broadcast.scala:107:15]
  wire [11:0] _TLBroadcastTracker_1_io_out_a_bits_source;	// @[generators/rocket-chip/src/main/scala/tilelink/Broadcast.scala:107:15]
  wire [31:0] _TLBroadcastTracker_1_io_out_a_bits_address;	// @[generators/rocket-chip/src/main/scala/tilelink/Broadcast.scala:107:15]
  wire [3:0]  _TLBroadcastTracker_1_io_out_a_bits_mask;	// @[generators/rocket-chip/src/main/scala/tilelink/Broadcast.scala:107:15]
  wire [31:0] _TLBroadcastTracker_1_io_out_a_bits_data;	// @[generators/rocket-chip/src/main/scala/tilelink/Broadcast.scala:107:15]
  wire [9:0]  _TLBroadcastTracker_1_io_source;	// @[generators/rocket-chip/src/main/scala/tilelink/Broadcast.scala:107:15]
  wire [25:0] _TLBroadcastTracker_1_io_line;	// @[generators/rocket-chip/src/main/scala/tilelink/Broadcast.scala:107:15]
  wire        _TLBroadcastTracker_1_io_idle;	// @[generators/rocket-chip/src/main/scala/tilelink/Broadcast.scala:107:15]
  wire        _TLBroadcastTracker_1_io_need_d;	// @[generators/rocket-chip/src/main/scala/tilelink/Broadcast.scala:107:15]
  wire        _TLBroadcastTracker_io_in_a_ready;	// @[generators/rocket-chip/src/main/scala/tilelink/Broadcast.scala:107:15]
  wire        _TLBroadcastTracker_io_out_a_valid;	// @[generators/rocket-chip/src/main/scala/tilelink/Broadcast.scala:107:15]
  wire [2:0]  _TLBroadcastTracker_io_out_a_bits_opcode;	// @[generators/rocket-chip/src/main/scala/tilelink/Broadcast.scala:107:15]
  wire [2:0]  _TLBroadcastTracker_io_out_a_bits_param;	// @[generators/rocket-chip/src/main/scala/tilelink/Broadcast.scala:107:15]
  wire [2:0]  _TLBroadcastTracker_io_out_a_bits_size;	// @[generators/rocket-chip/src/main/scala/tilelink/Broadcast.scala:107:15]
  wire [11:0] _TLBroadcastTracker_io_out_a_bits_source;	// @[generators/rocket-chip/src/main/scala/tilelink/Broadcast.scala:107:15]
  wire [31:0] _TLBroadcastTracker_io_out_a_bits_address;	// @[generators/rocket-chip/src/main/scala/tilelink/Broadcast.scala:107:15]
  wire [3:0]  _TLBroadcastTracker_io_out_a_bits_mask;	// @[generators/rocket-chip/src/main/scala/tilelink/Broadcast.scala:107:15]
  wire [31:0] _TLBroadcastTracker_io_out_a_bits_data;	// @[generators/rocket-chip/src/main/scala/tilelink/Broadcast.scala:107:15]
  wire [9:0]  _TLBroadcastTracker_io_source;	// @[generators/rocket-chip/src/main/scala/tilelink/Broadcast.scala:107:15]
  wire [25:0] _TLBroadcastTracker_io_line;	// @[generators/rocket-chip/src/main/scala/tilelink/Broadcast.scala:107:15]
  wire        _TLBroadcastTracker_io_idle;	// @[generators/rocket-chip/src/main/scala/tilelink/Broadcast.scala:107:15]
  wire        _TLBroadcastTracker_io_need_d;	// @[generators/rocket-chip/src/main/scala/tilelink/Broadcast.scala:107:15]
  wire        _filter_io_request_ready;	// @[generators/rocket-chip/src/main/scala/tilelink/Broadcast.scala:99:26]
  wire        _filter_io_response_valid;	// @[generators/rocket-chip/src/main/scala/tilelink/Broadcast.scala:99:26]
  wire [1:0]  _filter_io_response_bits_mshr;	// @[generators/rocket-chip/src/main/scala/tilelink/Broadcast.scala:99:26]
  wire [31:0] _filter_io_response_bits_address;	// @[generators/rocket-chip/src/main/scala/tilelink/Broadcast.scala:99:26]
  wire        _filter_io_response_bits_allocOH;	// @[generators/rocket-chip/src/main/scala/tilelink/Broadcast.scala:99:26]
  wire        _filter_io_response_bits_needT;	// @[generators/rocket-chip/src/main/scala/tilelink/Broadcast.scala:99:26]
  wire        d_drop = auto_out_d_bits_source[11:10] == 2'h1;	// @[generators/rocket-chip/src/main/scala/tilelink/Broadcast.scala:118:37, :119:27]
  wire        _GEN = d_normal_ready & d_normal_valid;	// @[generators/rocket-chip/src/main/scala/tilelink/Arbiter.scala:94:31, generators/rocket-chip/src/main/scala/tilelink/Broadcast.scala:129:48, src/main/scala/chisel3/util/Decoupled.scala:52:35]
  wire [12:0] _GEN_0 = {10'h0, auto_out_d_bits_size};	// @[generators/rocket-chip/src/main/scala/util/package.scala:235:71, src/main/scala/chisel3/util/Mux.scala:30:73]
  wire [12:0] _beats1_decode_T_1 = 13'h3F << _GEN_0;	// @[generators/rocket-chip/src/main/scala/util/package.scala:235:71]
  wire [3:0]  beats1 = d_normal_bits_opcode[0] ? ~(_beats1_decode_T_1[5:2]) : 4'h0;	// @[generators/rocket-chip/src/main/scala/tilelink/Broadcast.scala:130:21, :131:24, :132:30, generators/rocket-chip/src/main/scala/tilelink/Edges.scala:106:36, :221:14, :229:27, generators/rocket-chip/src/main/scala/util/package.scala:235:{46,71,76}]
  reg  [3:0]  counter;	// @[generators/rocket-chip/src/main/scala/tilelink/Edges.scala:229:27]
  wire        d_first = counter == 4'h0;	// @[generators/rocket-chip/src/main/scala/tilelink/Edges.scala:229:27, :231:25]
  wire        d_last = counter == 4'h1 | beats1 == 4'h0;	// @[generators/rocket-chip/src/main/scala/tilelink/Edges.scala:221:14, :229:27, :232:{25,33,43}, src/main/scala/chisel3/util/OneHot.scala:58:35]
  wire [3:0]  _d_trackerOH_T_8 = {_TLBroadcastTracker_3_io_need_d & _TLBroadcastTracker_3_io_source == d_normal_bits_source, _TLBroadcastTracker_2_io_need_d & _TLBroadcastTracker_2_io_source == d_normal_bits_source, _TLBroadcastTracker_1_io_need_d & _TLBroadcastTracker_1_io_source == d_normal_bits_source, _TLBroadcastTracker_io_need_d & _TLBroadcastTracker_io_source == d_normal_bits_source};	// @[generators/rocket-chip/src/main/scala/tilelink/Broadcast.scala:107:15, :123:{62,74,102}, :130:21]
  reg  [3:0]  d_trackerOH_r;	// @[generators/rocket-chip/src/main/scala/util/package.scala:80:63]
  wire [3:0]  d_trackerOH = d_first ? _d_trackerOH_T_8 : d_trackerOH_r;	// @[generators/rocket-chip/src/main/scala/tilelink/Broadcast.scala:123:102, generators/rocket-chip/src/main/scala/tilelink/Edges.scala:231:25, generators/rocket-chip/src/main/scala/util/package.scala:80:{42,63}]
  wire        nodeOut_d_ready = d_normal_ready | d_drop;	// @[generators/rocket-chip/src/main/scala/tilelink/Arbiter.scala:94:31, generators/rocket-chip/src/main/scala/tilelink/Broadcast.scala:119:27, :128:50]
  assign d_normal_valid = auto_out_d_valid & ~d_drop;	// @[generators/rocket-chip/src/main/scala/tilelink/Broadcast.scala:119:27, :125:31, :129:48]
  assign d_normal_bits_source = auto_out_d_bits_source[9:0];	// @[generators/rocket-chip/src/main/scala/tilelink/Broadcast.scala:130:21]
  assign d_normal_bits_opcode = auto_out_d_bits_source[11] ? (auto_out_d_bits_opcode[0] ? 3'h5 : 3'h6) : auto_out_d_bits_opcode;	// @[generators/rocket-chip/src/main/scala/tilelink/Broadcast.scala:118:37, :130:21, :131:{19,24}, :132:{30,36}, generators/rocket-chip/src/main/scala/tilelink/Edges.scala:106:36]
  wire        d_response = auto_out_d_bits_opcode[0] | ~(auto_out_d_bits_source[11]);	// @[generators/rocket-chip/src/main/scala/tilelink/Broadcast.scala:118:37, :131:19, :140:{34,37}, generators/rocket-chip/src/main/scala/tilelink/Edges.scala:106:36]
  wire        _GEN_1 = nodeOut_d_ready & auto_out_d_valid;	// @[generators/rocket-chip/src/main/scala/tilelink/Broadcast.scala:128:50, src/main/scala/chisel3/util/Decoupled.scala:52:35]
  wire        c_probeack = auto_in_c_bits_opcode == 3'h4;	// @[generators/rocket-chip/src/main/scala/tilelink/Broadcast.scala:158:45]
  wire        c_probeackdata = auto_in_c_bits_opcode == 3'h5;	// @[generators/rocket-chip/src/main/scala/tilelink/Broadcast.scala:132:36, :159:45]
  wire        c_release = auto_in_c_bits_opcode == 3'h6;	// @[generators/rocket-chip/src/main/scala/tilelink/Broadcast.scala:132:36, :161:45]
  wire        c_trackerOH_0 = _TLBroadcastTracker_io_line == auto_in_c_bits_address[31:6];	// @[generators/rocket-chip/src/main/scala/tilelink/Broadcast.scala:107:15, :162:{55,78}]
  wire        c_trackerOH_1 = _TLBroadcastTracker_1_io_line == auto_in_c_bits_address[31:6];	// @[generators/rocket-chip/src/main/scala/tilelink/Broadcast.scala:107:15, :162:{55,78}]
  wire        c_trackerOH_2 = _TLBroadcastTracker_2_io_line == auto_in_c_bits_address[31:6];	// @[generators/rocket-chip/src/main/scala/tilelink/Broadcast.scala:107:15, :162:{55,78}]
  wire        c_trackerOH_3 = _TLBroadcastTracker_3_io_line == auto_in_c_bits_address[31:6];	// @[generators/rocket-chip/src/main/scala/tilelink/Broadcast.scala:107:15, :162:{55,78}]
  wire        _c_first_T = nodeIn_c_ready & auto_in_c_valid;	// @[generators/rocket-chip/src/main/scala/tilelink/Broadcast.scala:184:32, src/main/scala/chisel3/util/Decoupled.scala:52:35]
  wire        _clearOH_T_1 = c_probeack | c_probeackdata;	// @[generators/rocket-chip/src/main/scala/tilelink/Broadcast.scala:158:45, :159:45, :170:50]
  wire        _GEN_2 = _c_first_T & c_probeack;	// @[generators/rocket-chip/src/main/scala/tilelink/Broadcast.scala:158:45, :175:40, src/main/scala/chisel3/util/Decoupled.scala:52:35]
  wire        _GEN_3 = auto_in_c_bits_param == 3'h0 | auto_in_c_bits_param == 3'h4;	// @[generators/rocket-chip/src/main/scala/tilelink/Broadcast.scala:158:45, :177:{27,50}, :178:27]
  assign nodeIn_c_ready = c_probeack | (c_release ? releaseack_ready : putfull_ready);	// @[generators/rocket-chip/src/main/scala/tilelink/Arbiter.scala:94:31, generators/rocket-chip/src/main/scala/tilelink/Broadcast.scala:158:45, :161:45, :184:{32,38}]
  wire        winner_0 = auto_in_c_valid & c_release;	// @[generators/rocket-chip/src/main/scala/tilelink/Broadcast.scala:161:45, :192:79]
  wire        winner_1_0 = auto_in_c_valid & (c_probeackdata | (&auto_in_c_bits_opcode));	// @[generators/rocket-chip/src/main/scala/tilelink/Broadcast.scala:159:45, :160:45, :197:{35,54}]
  wire        putfull_bits_a_mask_acc = (|(auto_in_c_bits_size[2:1])) | auto_in_c_bits_size[0] & ~(auto_in_c_bits_address[1]);	// @[generators/rocket-chip/src/main/scala/util/Misc.scala:206:21, :210:26, :211:20, :215:{29,38}, src/main/scala/chisel3/util/OneHot.scala:64:49]
  wire        putfull_bits_a_mask_acc_1 = (|(auto_in_c_bits_size[2:1])) | auto_in_c_bits_size[0] & auto_in_c_bits_address[1];	// @[generators/rocket-chip/src/main/scala/util/Misc.scala:206:21, :210:26, :215:{29,38}, src/main/scala/chisel3/util/OneHot.scala:64:49]
  reg  [3:0]  beatsLeft;	// @[generators/rocket-chip/src/main/scala/tilelink/Arbiter.scala:60:30]
  wire        idle = beatsLeft == 4'h0;	// @[generators/rocket-chip/src/main/scala/tilelink/Arbiter.scala:60:30, :61:28, generators/rocket-chip/src/main/scala/tilelink/Edges.scala:229:27]
  wire        winner_1 = ~winner_0 & d_normal_valid;	// @[generators/rocket-chip/src/main/scala/tilelink/Arbiter.scala:16:61, :71:69, generators/rocket-chip/src/main/scala/tilelink/Broadcast.scala:129:48, :192:79]
  wire        _nodeIn_d_valid_T = winner_0 | d_normal_valid;	// @[generators/rocket-chip/src/main/scala/tilelink/Arbiter.scala:79:31, generators/rocket-chip/src/main/scala/tilelink/Broadcast.scala:129:48, :192:79]
  reg         state_0;	// @[generators/rocket-chip/src/main/scala/tilelink/Arbiter.scala:88:26]
  reg         state_1;	// @[generators/rocket-chip/src/main/scala/tilelink/Arbiter.scala:88:26]
  wire        muxState_0 = idle ? winner_0 : state_0;	// @[generators/rocket-chip/src/main/scala/tilelink/Arbiter.scala:61:28, :88:26, :89:25, generators/rocket-chip/src/main/scala/tilelink/Broadcast.scala:192:79]
  wire        muxState_1 = idle ? winner_1 : state_1;	// @[generators/rocket-chip/src/main/scala/tilelink/Arbiter.scala:61:28, :71:69, :88:26, :89:25]
  assign releaseack_ready = auto_in_d_ready & (idle | state_0);	// @[generators/rocket-chip/src/main/scala/tilelink/Arbiter.scala:61:28, :88:26, :92:24, :94:31]
  assign d_normal_ready = auto_in_d_ready & (idle ? ~winner_0 : state_1);	// @[generators/rocket-chip/src/main/scala/tilelink/Arbiter.scala:16:61, :61:28, :88:26, :92:24, :94:31, generators/rocket-chip/src/main/scala/tilelink/Broadcast.scala:192:79]
  wire        nodeIn_d_valid = idle ? _nodeIn_d_valid_T : state_0 & winner_0 | state_1 & d_normal_valid;	// @[generators/rocket-chip/src/main/scala/tilelink/Arbiter.scala:61:28, :79:31, :88:26, :96:24, generators/rocket-chip/src/main/scala/tilelink/Broadcast.scala:129:48, :192:79, src/main/scala/chisel3/util/Mux.scala:30:73]
  wire [1:0]  _nodeIn_d_bits_WIRE_6 = muxState_1 ? {|(d_trackerOH[3:2]), d_trackerOH[3] | d_trackerOH[1]} : 2'h0;	// @[generators/rocket-chip/src/main/scala/tilelink/Arbiter.scala:89:25, generators/rocket-chip/src/main/scala/util/package.scala:80:42, src/main/scala/chisel3/util/Mux.scala:30:73, src/main/scala/chisel3/util/OneHot.scala:30:18, :31:18, :32:{10,14,28}]
  wire [9:0]  _nodeIn_d_bits_WIRE_7 = (muxState_0 ? auto_in_c_bits_source : 10'h0) | (muxState_1 ? d_normal_bits_source : 10'h0);	// @[generators/rocket-chip/src/main/scala/tilelink/Arbiter.scala:89:25, generators/rocket-chip/src/main/scala/tilelink/Broadcast.scala:130:21, src/main/scala/chisel3/util/Mux.scala:30:73]
  wire [2:0]  _nodeIn_d_bits_WIRE_8 = (muxState_0 ? auto_in_c_bits_size : 3'h0) | (muxState_1 ? auto_out_d_bits_size : 3'h0);	// @[generators/rocket-chip/src/main/scala/tilelink/Arbiter.scala:89:25, generators/rocket-chip/src/main/scala/tilelink/Broadcast.scala:177:27, src/main/scala/chisel3/util/Mux.scala:30:73]
  wire [1:0]  _nodeIn_d_bits_WIRE_9 = muxState_1 & auto_out_d_bits_source[11] & auto_out_d_bits_opcode[0] ? {1'h0, ~(auto_out_d_bits_source[10])} : 2'h0;	// @[generators/rocket-chip/src/main/scala/tilelink/Arbiter.scala:89:25, generators/rocket-chip/src/main/scala/tilelink/Broadcast.scala:118:37, :131:19, :133:{51,58}, generators/rocket-chip/src/main/scala/tilelink/Edges.scala:106:36, src/main/scala/chisel3/util/Mux.scala:30:73]
  wire [2:0]  _nodeIn_d_bits_WIRE_10 = (muxState_0 ? 3'h6 : 3'h0) | (muxState_1 ? d_normal_bits_opcode : 3'h0);	// @[generators/rocket-chip/src/main/scala/tilelink/Arbiter.scala:89:25, generators/rocket-chip/src/main/scala/tilelink/Broadcast.scala:130:21, :131:24, :132:{30,36}, :177:27, src/main/scala/chisel3/util/Mux.scala:30:73]
  reg  [3:0]  beatsLeft_1;	// @[generators/rocket-chip/src/main/scala/tilelink/Arbiter.scala:60:30]
  wire        idle_1 = beatsLeft_1 == 4'h0;	// @[generators/rocket-chip/src/main/scala/tilelink/Arbiter.scala:60:30, :61:28, generators/rocket-chip/src/main/scala/tilelink/Edges.scala:229:27]
  wire        _GEN_4 = _TLBroadcastTracker_io_out_a_valid | winner_1_0;	// @[generators/rocket-chip/src/main/scala/tilelink/Broadcast.scala:107:15, :197:35, generators/rocket-chip/src/main/scala/util/package.scala:245:43]
  wire        _GEN_5 = _TLBroadcastTracker_2_io_out_a_valid | _TLBroadcastTracker_1_io_out_a_valid | _GEN_4;	// @[generators/rocket-chip/src/main/scala/tilelink/Broadcast.scala:107:15, generators/rocket-chip/src/main/scala/util/package.scala:245:43]
  wire        _GEN_6 = _TLBroadcastTracker_1_io_out_a_valid | _TLBroadcastTracker_io_out_a_valid | winner_1_0;	// @[generators/rocket-chip/src/main/scala/tilelink/Broadcast.scala:107:15, :197:35, generators/rocket-chip/src/main/scala/util/package.scala:245:43]
  wire        winner_1_1 = ~winner_1_0 & _TLBroadcastTracker_io_out_a_valid;	// @[generators/rocket-chip/src/main/scala/tilelink/Arbiter.scala:16:61, :71:69, generators/rocket-chip/src/main/scala/tilelink/Broadcast.scala:107:15, :197:35]
  wire        winner_1_2 = ~_GEN_4 & _TLBroadcastTracker_1_io_out_a_valid;	// @[generators/rocket-chip/src/main/scala/tilelink/Arbiter.scala:16:61, :71:69, generators/rocket-chip/src/main/scala/tilelink/Broadcast.scala:107:15, generators/rocket-chip/src/main/scala/util/package.scala:245:43]
  wire        winner_1_3 = ~_GEN_6 & _TLBroadcastTracker_2_io_out_a_valid;	// @[generators/rocket-chip/src/main/scala/tilelink/Arbiter.scala:16:61, :71:69, generators/rocket-chip/src/main/scala/tilelink/Broadcast.scala:107:15, generators/rocket-chip/src/main/scala/util/package.scala:245:43]
  wire        winner_1_4 = ~_GEN_5 & _TLBroadcastTracker_3_io_out_a_valid;	// @[generators/rocket-chip/src/main/scala/tilelink/Arbiter.scala:16:61, :71:69, generators/rocket-chip/src/main/scala/tilelink/Broadcast.scala:107:15, generators/rocket-chip/src/main/scala/util/package.scala:245:43]
  wire        _nodeOut_a_valid_T = winner_1_0 | _TLBroadcastTracker_io_out_a_valid;	// @[generators/rocket-chip/src/main/scala/tilelink/Arbiter.scala:79:31, generators/rocket-chip/src/main/scala/tilelink/Broadcast.scala:107:15, :197:35]
  `ifndef SYNTHESIS	// @[generators/rocket-chip/src/main/scala/tilelink/Broadcast.scala:125:14]
    wire prefixOR_2 = winner_1_0 | winner_1_1;	// @[generators/rocket-chip/src/main/scala/tilelink/Arbiter.scala:71:69, :76:48, generators/rocket-chip/src/main/scala/tilelink/Broadcast.scala:197:35]
    wire prefixOR_3 = prefixOR_2 | winner_1_2;	// @[generators/rocket-chip/src/main/scala/tilelink/Arbiter.scala:71:69, :76:48]
    always @(posedge clock) begin	// @[generators/rocket-chip/src/main/scala/tilelink/Broadcast.scala:125:14]
      if (~reset & ~(~auto_out_d_valid | ~d_drop | auto_out_d_bits_opcode == 3'h0)) begin	// @[generators/rocket-chip/src/main/scala/tilelink/Broadcast.scala:119:27, :125:{14,15,31,39,60}, :177:27]
        if (`ASSERT_VERBOSE_COND_)	// @[generators/rocket-chip/src/main/scala/tilelink/Broadcast.scala:125:14]
          $error("Assertion failed\n    at Broadcast.scala:125 assert (!out.d.valid || !d_drop || out.d.bits.opcode === TLMessages.AccessAck)\n");	// @[generators/rocket-chip/src/main/scala/tilelink/Broadcast.scala:125:14]
        if (`STOP_COND_)	// @[generators/rocket-chip/src/main/scala/tilelink/Broadcast.scala:125:14]
          $fatal;	// @[generators/rocket-chip/src/main/scala/tilelink/Broadcast.scala:125:14]
      end
      if (~reset & ~(~d_normal_valid | (|d_trackerOH) | d_normal_bits_opcode == 3'h6)) begin	// @[generators/rocket-chip/src/main/scala/tilelink/Broadcast.scala:125:14, :129:48, :130:21, :131:24, :132:{30,36}, :137:{14,15,31,47,75}, generators/rocket-chip/src/main/scala/util/package.scala:80:42]
        if (`ASSERT_VERBOSE_COND_)	// @[generators/rocket-chip/src/main/scala/tilelink/Broadcast.scala:137:14]
          $error("Assertion failed\n    at Broadcast.scala:137 assert (!d_normal.valid || (d_trackerOH.orR || d_normal.bits.opcode === TLMessages.ReleaseAck))\n");	// @[generators/rocket-chip/src/main/scala/tilelink/Broadcast.scala:137:14]
        if (`STOP_COND_)	// @[generators/rocket-chip/src/main/scala/tilelink/Broadcast.scala:137:14]
          $fatal;	// @[generators/rocket-chip/src/main/scala/tilelink/Broadcast.scala:137:14]
      end
      if (~reset & ~(~winner_0 | ~winner_1)) begin	// @[generators/rocket-chip/src/main/scala/tilelink/Arbiter.scala:71:69, :77:{13,56,59,62}, generators/rocket-chip/src/main/scala/tilelink/Broadcast.scala:125:14, :192:79]
        if (`ASSERT_VERBOSE_COND_)	// @[generators/rocket-chip/src/main/scala/tilelink/Arbiter.scala:77:13]
          $error("Assertion failed\n    at Arbiter.scala:77 assert((prefixOR zip winner) map { case (p,w) => !p || !w } reduce {_ && _})\n");	// @[generators/rocket-chip/src/main/scala/tilelink/Arbiter.scala:77:13]
        if (`STOP_COND_)	// @[generators/rocket-chip/src/main/scala/tilelink/Arbiter.scala:77:13]
          $fatal;	// @[generators/rocket-chip/src/main/scala/tilelink/Arbiter.scala:77:13]
      end
      if (~reset & ~(~_nodeIn_d_valid_T | winner_0 | winner_1)) begin	// @[generators/rocket-chip/src/main/scala/tilelink/Arbiter.scala:71:69, :79:{14,15,31,36}, generators/rocket-chip/src/main/scala/tilelink/Broadcast.scala:125:14, :192:79]
        if (`ASSERT_VERBOSE_COND_)	// @[generators/rocket-chip/src/main/scala/tilelink/Arbiter.scala:79:14]
          $error("Assertion failed\n    at Arbiter.scala:79 assert (!valids.reduce(_||_) || winner.reduce(_||_))\n");	// @[generators/rocket-chip/src/main/scala/tilelink/Arbiter.scala:79:14]
        if (`STOP_COND_)	// @[generators/rocket-chip/src/main/scala/tilelink/Arbiter.scala:79:14]
          $fatal;	// @[generators/rocket-chip/src/main/scala/tilelink/Arbiter.scala:79:14]
      end
      if (~reset & ~((~winner_1_0 | ~winner_1_1) & (~prefixOR_2 | ~winner_1_2) & (~prefixOR_3 | ~winner_1_3) & (~(prefixOR_3 | winner_1_3) | ~winner_1_4))) begin	// @[generators/rocket-chip/src/main/scala/tilelink/Arbiter.scala:71:69, :76:48, :77:{13,56,59,62,77}, generators/rocket-chip/src/main/scala/tilelink/Broadcast.scala:125:14, :197:35]
        if (`ASSERT_VERBOSE_COND_)	// @[generators/rocket-chip/src/main/scala/tilelink/Arbiter.scala:77:13]
          $error("Assertion failed\n    at Arbiter.scala:77 assert((prefixOR zip winner) map { case (p,w) => !p || !w } reduce {_ && _})\n");	// @[generators/rocket-chip/src/main/scala/tilelink/Arbiter.scala:77:13]
        if (`STOP_COND_)	// @[generators/rocket-chip/src/main/scala/tilelink/Arbiter.scala:77:13]
          $fatal;	// @[generators/rocket-chip/src/main/scala/tilelink/Arbiter.scala:77:13]
      end
      if (~reset & ~(~(_nodeOut_a_valid_T | _TLBroadcastTracker_1_io_out_a_valid | _TLBroadcastTracker_2_io_out_a_valid | _TLBroadcastTracker_3_io_out_a_valid) | winner_1_0 | winner_1_1 | winner_1_2 | winner_1_3 | winner_1_4)) begin	// @[generators/rocket-chip/src/main/scala/tilelink/Arbiter.scala:71:69, :79:{14,15,31,36}, generators/rocket-chip/src/main/scala/tilelink/Broadcast.scala:107:15, :125:14, :197:35]
        if (`ASSERT_VERBOSE_COND_)	// @[generators/rocket-chip/src/main/scala/tilelink/Arbiter.scala:79:14]
          $error("Assertion failed\n    at Arbiter.scala:79 assert (!valids.reduce(_||_) || winner.reduce(_||_))\n");	// @[generators/rocket-chip/src/main/scala/tilelink/Arbiter.scala:79:14]
        if (`STOP_COND_)	// @[generators/rocket-chip/src/main/scala/tilelink/Arbiter.scala:79:14]
          $fatal;	// @[generators/rocket-chip/src/main/scala/tilelink/Arbiter.scala:79:14]
      end
    end // always @(posedge)
  `endif // not def SYNTHESIS
  reg         state_1_0;	// @[generators/rocket-chip/src/main/scala/tilelink/Arbiter.scala:88:26]
  reg         state_1_1;	// @[generators/rocket-chip/src/main/scala/tilelink/Arbiter.scala:88:26]
  reg         state_1_2;	// @[generators/rocket-chip/src/main/scala/tilelink/Arbiter.scala:88:26]
  reg         state_1_3;	// @[generators/rocket-chip/src/main/scala/tilelink/Arbiter.scala:88:26]
  reg         state_1_4;	// @[generators/rocket-chip/src/main/scala/tilelink/Arbiter.scala:88:26]
  wire        muxState_1_0 = idle_1 ? winner_1_0 : state_1_0;	// @[generators/rocket-chip/src/main/scala/tilelink/Arbiter.scala:61:28, :88:26, :89:25, generators/rocket-chip/src/main/scala/tilelink/Broadcast.scala:197:35]
  wire        muxState_1_1 = idle_1 ? winner_1_1 : state_1_1;	// @[generators/rocket-chip/src/main/scala/tilelink/Arbiter.scala:61:28, :71:69, :88:26, :89:25]
  wire        muxState_1_2 = idle_1 ? winner_1_2 : state_1_2;	// @[generators/rocket-chip/src/main/scala/tilelink/Arbiter.scala:61:28, :71:69, :88:26, :89:25]
  wire        muxState_1_3 = idle_1 ? winner_1_3 : state_1_3;	// @[generators/rocket-chip/src/main/scala/tilelink/Arbiter.scala:61:28, :71:69, :88:26, :89:25]
  wire        muxState_1_4 = idle_1 ? winner_1_4 : state_1_4;	// @[generators/rocket-chip/src/main/scala/tilelink/Arbiter.scala:61:28, :71:69, :88:26, :89:25]
  assign putfull_ready = auto_out_a_ready & (idle_1 | state_1_0);	// @[generators/rocket-chip/src/main/scala/tilelink/Arbiter.scala:61:28, :88:26, :92:24, :94:31]
  wire        nodeOut_a_valid = idle_1 ? _nodeOut_a_valid_T | _TLBroadcastTracker_1_io_out_a_valid | _TLBroadcastTracker_2_io_out_a_valid | _TLBroadcastTracker_3_io_out_a_valid : state_1_0 & winner_1_0 | state_1_1 & _TLBroadcastTracker_io_out_a_valid | state_1_2 & _TLBroadcastTracker_1_io_out_a_valid | state_1_3 & _TLBroadcastTracker_2_io_out_a_valid | state_1_4 & _TLBroadcastTracker_3_io_out_a_valid;	// @[generators/rocket-chip/src/main/scala/tilelink/Arbiter.scala:61:28, :79:31, :88:26, :96:{24,46}, generators/rocket-chip/src/main/scala/tilelink/Broadcast.scala:107:15, :197:35, src/main/scala/chisel3/util/Mux.scala:30:73]
  reg  [25:0] probe_line;	// @[generators/rocket-chip/src/main/scala/tilelink/Broadcast.scala:216:27]
  reg  [1:0]  probe_perms;	// @[generators/rocket-chip/src/main/scala/tilelink/Broadcast.scala:217:28]
  wire [31:0] nodeIn_b_bits_b_address = {probe_line, 6'h0};	// @[generators/rocket-chip/src/main/scala/tilelink/Broadcast.scala:216:27, :225:46]
  wire        _matchTrackers_WIRE_0 = _TLBroadcastTracker_io_line == auto_in_a_bits_address[31:6];	// @[generators/rocket-chip/src/main/scala/tilelink/Broadcast.scala:107:15, :236:{62,84}]
  wire        _matchTrackers_WIRE_1 = _TLBroadcastTracker_1_io_line == auto_in_a_bits_address[31:6];	// @[generators/rocket-chip/src/main/scala/tilelink/Broadcast.scala:107:15, :236:{62,84}]
  wire        _matchTrackers_WIRE_2 = _TLBroadcastTracker_2_io_line == auto_in_a_bits_address[31:6];	// @[generators/rocket-chip/src/main/scala/tilelink/Broadcast.scala:107:15, :236:{62,84}]
  wire        _matchTrackers_WIRE_3 = _TLBroadcastTracker_3_io_line == auto_in_a_bits_address[31:6];	// @[generators/rocket-chip/src/main/scala/tilelink/Broadcast.scala:107:15, :236:{62,84}]
  wire [3:0]  filter_io_request_bits_mshr_lo = (|{_matchTrackers_WIRE_3, _matchTrackers_WIRE_2, _matchTrackers_WIRE_1, _matchTrackers_WIRE_0}) ? {_matchTrackers_WIRE_3, _matchTrackers_WIRE_2, _matchTrackers_WIRE_1, _matchTrackers_WIRE_0} : {~(_TLBroadcastTracker_2_io_idle | _TLBroadcastTracker_1_io_idle | _TLBroadcastTracker_io_idle), ~(_TLBroadcastTracker_1_io_idle | _TLBroadcastTracker_io_idle), ~_TLBroadcastTracker_io_idle, 1'h1} & {_TLBroadcastTracker_3_io_idle, _TLBroadcastTracker_2_io_idle, _TLBroadcastTracker_1_io_idle, _TLBroadcastTracker_io_idle};	// @[generators/rocket-chip/src/main/scala/tilelink/Broadcast.scala:107:15, :234:64, :236:{62,100}, :237:40, :238:{39,41}, :239:30, generators/rocket-chip/src/main/scala/util/package.scala:245:43]
  wire [3:0]  _GEN_7 = filter_io_request_bits_mshr_lo & {_TLBroadcastTracker_3_io_in_a_ready, _TLBroadcastTracker_2_io_in_a_ready, _TLBroadcastTracker_1_io_in_a_ready, _TLBroadcastTracker_io_in_a_ready};	// @[generators/rocket-chip/src/main/scala/tilelink/Broadcast.scala:107:15, :239:30, :240:63, :241:41]
  wire        nodeIn_a_ready = ((|a_first_counter) | _filter_io_request_ready) & (|_GEN_7);	// @[generators/rocket-chip/src/main/scala/tilelink/Broadcast.scala:99:26, :241:{41,58}, :243:{31,59}, generators/rocket-chip/src/main/scala/tilelink/Edges.scala:229:27, :231:25]
  wire        _GEN_8 = (|a_first_counter) | _filter_io_request_ready;	// @[generators/rocket-chip/src/main/scala/tilelink/Broadcast.scala:99:26, :245:59, generators/rocket-chip/src/main/scala/tilelink/Edges.scala:229:27, :231:25]
  wire        _sack_T = ~probe_todo & _filter_io_response_valid;	// @[generators/rocket-chip/src/main/scala/tilelink/Broadcast.scala:99:26, :215:31, :259:35, src/main/scala/chisel3/util/Decoupled.scala:52:35]
  wire [12:0] _decode_T_5 = 13'h3F << _GEN_0;	// @[generators/rocket-chip/src/main/scala/util/package.scala:235:71]
  wire [12:0] _decode_T_25 = 13'h3F << _TLBroadcastTracker_3_io_out_a_bits_size;	// @[generators/rocket-chip/src/main/scala/tilelink/Broadcast.scala:107:15, generators/rocket-chip/src/main/scala/util/package.scala:235:71]
  wire [12:0] _decode_T_21 = 13'h3F << _TLBroadcastTracker_2_io_out_a_bits_size;	// @[generators/rocket-chip/src/main/scala/tilelink/Broadcast.scala:107:15, generators/rocket-chip/src/main/scala/util/package.scala:235:71]
  wire [12:0] _decode_T_17 = 13'h3F << _TLBroadcastTracker_1_io_out_a_bits_size;	// @[generators/rocket-chip/src/main/scala/tilelink/Broadcast.scala:107:15, generators/rocket-chip/src/main/scala/util/package.scala:235:71]
  wire [12:0] _decode_T_13 = 13'h3F << _TLBroadcastTracker_io_out_a_bits_size;	// @[generators/rocket-chip/src/main/scala/tilelink/Broadcast.scala:107:15, generators/rocket-chip/src/main/scala/util/package.scala:235:71]
  wire [12:0] _decode_T_9 = 13'h3F << auto_in_c_bits_size;	// @[generators/rocket-chip/src/main/scala/util/package.scala:235:71]
  wire [12:0] _a_first_beats1_decode_T_1 = 13'h3F << auto_in_a_bits_size;	// @[generators/rocket-chip/src/main/scala/util/package.scala:235:71]
  always @(posedge clock) begin
    if (reset) begin
      counter <= 4'h0;	// @[generators/rocket-chip/src/main/scala/tilelink/Edges.scala:229:27]
      beatsLeft <= 4'h0;	// @[generators/rocket-chip/src/main/scala/tilelink/Arbiter.scala:60:30, generators/rocket-chip/src/main/scala/tilelink/Edges.scala:229:27]
      state_0 <= 1'h0;	// @[generators/rocket-chip/src/main/scala/tilelink/Arbiter.scala:88:26]
      state_1 <= 1'h0;	// @[generators/rocket-chip/src/main/scala/tilelink/Arbiter.scala:88:26]
      beatsLeft_1 <= 4'h0;	// @[generators/rocket-chip/src/main/scala/tilelink/Arbiter.scala:60:30, generators/rocket-chip/src/main/scala/tilelink/Edges.scala:229:27]
      state_1_0 <= 1'h0;	// @[generators/rocket-chip/src/main/scala/tilelink/Arbiter.scala:88:26]
      state_1_1 <= 1'h0;	// @[generators/rocket-chip/src/main/scala/tilelink/Arbiter.scala:88:26]
      state_1_2 <= 1'h0;	// @[generators/rocket-chip/src/main/scala/tilelink/Arbiter.scala:88:26]
      state_1_3 <= 1'h0;	// @[generators/rocket-chip/src/main/scala/tilelink/Arbiter.scala:88:26]
      state_1_4 <= 1'h0;	// @[generators/rocket-chip/src/main/scala/tilelink/Arbiter.scala:88:26]
      probe_todo <= 1'h0;	// @[generators/rocket-chip/src/main/scala/tilelink/Broadcast.scala:215:31]
      a_first_counter <= 4'h0;	// @[generators/rocket-chip/src/main/scala/tilelink/Edges.scala:229:27]
    end
    else begin
      if (_GEN) begin	// @[src/main/scala/chisel3/util/Decoupled.scala:52:35]
        if (d_first)	// @[generators/rocket-chip/src/main/scala/tilelink/Edges.scala:231:25]
          counter <= beats1;	// @[generators/rocket-chip/src/main/scala/tilelink/Edges.scala:221:14, :229:27]
        else	// @[generators/rocket-chip/src/main/scala/tilelink/Edges.scala:231:25]
          counter <= counter - 4'h1;	// @[generators/rocket-chip/src/main/scala/tilelink/Edges.scala:229:27, :230:28]
      end
      if (idle & auto_in_d_ready)	// @[generators/rocket-chip/src/main/scala/tilelink/Arbiter.scala:61:28, :62:24]
        beatsLeft <= winner_1 & d_normal_bits_opcode[0] ? ~(_decode_T_5[5:2]) : 4'h0;	// @[generators/rocket-chip/src/main/scala/tilelink/Arbiter.scala:60:30, :71:69, :82:69, generators/rocket-chip/src/main/scala/tilelink/Broadcast.scala:130:21, :131:24, :132:30, generators/rocket-chip/src/main/scala/tilelink/Edges.scala:106:36, :221:14, :229:27, generators/rocket-chip/src/main/scala/util/package.scala:235:{46,71,76}]
      else	// @[generators/rocket-chip/src/main/scala/tilelink/Arbiter.scala:62:24]
        beatsLeft <= beatsLeft - {3'h0, auto_in_d_ready & nodeIn_d_valid};	// @[generators/rocket-chip/src/main/scala/tilelink/Arbiter.scala:60:30, :85:52, :96:24, generators/rocket-chip/src/main/scala/tilelink/Broadcast.scala:177:27, src/main/scala/chisel3/util/Decoupled.scala:52:35]
      if (idle) begin	// @[generators/rocket-chip/src/main/scala/tilelink/Arbiter.scala:61:28]
        state_0 <= winner_0;	// @[generators/rocket-chip/src/main/scala/tilelink/Arbiter.scala:88:26, generators/rocket-chip/src/main/scala/tilelink/Broadcast.scala:192:79]
        state_1 <= winner_1;	// @[generators/rocket-chip/src/main/scala/tilelink/Arbiter.scala:71:69, :88:26]
      end
      if (idle_1 & auto_out_a_ready)	// @[generators/rocket-chip/src/main/scala/tilelink/Arbiter.scala:61:28, :62:24]
        beatsLeft_1 <= (winner_1_0 ? ~(_decode_T_9[5:2]) : 4'h0) | (winner_1_1 & ~(_TLBroadcastTracker_io_out_a_bits_opcode[2]) ? ~(_decode_T_13[5:2]) : 4'h0) | (winner_1_2 & ~(_TLBroadcastTracker_1_io_out_a_bits_opcode[2]) ? ~(_decode_T_17[5:2]) : 4'h0) | (winner_1_3 & ~(_TLBroadcastTracker_2_io_out_a_bits_opcode[2]) ? ~(_decode_T_21[5:2]) : 4'h0) | (winner_1_4 & ~(_TLBroadcastTracker_3_io_out_a_bits_opcode[2]) ? ~(_decode_T_25[5:2]) : 4'h0);	// @[generators/rocket-chip/src/main/scala/tilelink/Arbiter.scala:60:30, :71:69, :82:69, :84:44, generators/rocket-chip/src/main/scala/tilelink/Broadcast.scala:107:15, :197:35, generators/rocket-chip/src/main/scala/tilelink/Edges.scala:92:{28,37}, :221:14, :229:27, generators/rocket-chip/src/main/scala/util/package.scala:235:{46,71,76}]
      else	// @[generators/rocket-chip/src/main/scala/tilelink/Arbiter.scala:62:24]
        beatsLeft_1 <= beatsLeft_1 - {3'h0, auto_out_a_ready & nodeOut_a_valid};	// @[generators/rocket-chip/src/main/scala/tilelink/Arbiter.scala:60:30, :85:52, :96:24, generators/rocket-chip/src/main/scala/tilelink/Broadcast.scala:177:27, src/main/scala/chisel3/util/Decoupled.scala:52:35]
      if (idle_1) begin	// @[generators/rocket-chip/src/main/scala/tilelink/Arbiter.scala:61:28]
        state_1_0 <= winner_1_0;	// @[generators/rocket-chip/src/main/scala/tilelink/Arbiter.scala:88:26, generators/rocket-chip/src/main/scala/tilelink/Broadcast.scala:197:35]
        state_1_1 <= winner_1_1;	// @[generators/rocket-chip/src/main/scala/tilelink/Arbiter.scala:71:69, :88:26]
        state_1_2 <= winner_1_2;	// @[generators/rocket-chip/src/main/scala/tilelink/Arbiter.scala:71:69, :88:26]
        state_1_3 <= winner_1_3;	// @[generators/rocket-chip/src/main/scala/tilelink/Arbiter.scala:71:69, :88:26]
        state_1_4 <= winner_1_4;	// @[generators/rocket-chip/src/main/scala/tilelink/Arbiter.scala:71:69, :88:26]
      end
      if (_sack_T)	// @[src/main/scala/chisel3/util/Decoupled.scala:52:35]
        probe_todo <= ~_filter_io_response_bits_allocOH;	// @[generators/rocket-chip/src/main/scala/tilelink/Broadcast.scala:99:26, :215:31, :257:54]
      else	// @[src/main/scala/chisel3/util/Decoupled.scala:52:35]
        probe_todo <= ~(auto_in_b_ready & probe_todo) & probe_todo;	// @[generators/rocket-chip/src/main/scala/tilelink/Broadcast.scala:215:31, :227:{24,37}, src/main/scala/chisel3/util/Decoupled.scala:52:35]
      if (nodeIn_a_ready & auto_in_a_valid) begin	// @[generators/rocket-chip/src/main/scala/tilelink/Broadcast.scala:243:59, src/main/scala/chisel3/util/Decoupled.scala:52:35]
        if (|a_first_counter)	// @[generators/rocket-chip/src/main/scala/tilelink/Edges.scala:229:27, :231:25]
          a_first_counter <= a_first_counter - 4'h1;	// @[generators/rocket-chip/src/main/scala/tilelink/Edges.scala:229:27, :230:28]
        else	// @[generators/rocket-chip/src/main/scala/tilelink/Edges.scala:231:25]
          a_first_counter <= auto_in_a_bits_opcode[2] ? 4'h0 : ~(_a_first_beats1_decode_T_1[5:2]);	// @[generators/rocket-chip/src/main/scala/tilelink/Edges.scala:92:37, :221:14, :229:27, generators/rocket-chip/src/main/scala/util/package.scala:235:{46,71,76}]
      end
    end
    if (d_first)	// @[generators/rocket-chip/src/main/scala/tilelink/Edges.scala:231:25]
      d_trackerOH_r <= _d_trackerOH_T_8;	// @[generators/rocket-chip/src/main/scala/tilelink/Broadcast.scala:123:102, generators/rocket-chip/src/main/scala/util/package.scala:80:63]
    if (_sack_T) begin	// @[src/main/scala/chisel3/util/Decoupled.scala:52:35]
      probe_line <= _filter_io_response_bits_address[31:6];	// @[generators/rocket-chip/src/main/scala/tilelink/Broadcast.scala:99:26, :216:27, :262:56]
      probe_perms <= _filter_io_response_bits_needT ? 2'h2 : 2'h1;	// @[generators/rocket-chip/src/main/scala/tilelink/Broadcast.scala:99:26, :217:28, :263:27]
    end
  end // always @(posedge)
  `ifdef ENABLE_INITIAL_REG_
    `ifdef FIRRTL_BEFORE_INITIAL
      `FIRRTL_BEFORE_INITIAL
    `endif // FIRRTL_BEFORE_INITIAL
    logic [31:0] _RANDOM[0:1];
    initial begin
      `ifdef INIT_RANDOM_PROLOG_
        `INIT_RANDOM_PROLOG_
      `endif // INIT_RANDOM_PROLOG_
      `ifdef RANDOMIZE_REG_INIT
        for (logic [1:0] i = 2'h0; i < 2'h2; i += 2'h1) begin
          _RANDOM[i[0]] = `RANDOM;
        end
        counter = _RANDOM[1'h0][3:0];	// @[generators/rocket-chip/src/main/scala/tilelink/Edges.scala:229:27]
        d_trackerOH_r = _RANDOM[1'h0][7:4];	// @[generators/rocket-chip/src/main/scala/tilelink/Edges.scala:229:27, generators/rocket-chip/src/main/scala/util/package.scala:80:63]
        beatsLeft = _RANDOM[1'h0][15:12];	// @[generators/rocket-chip/src/main/scala/tilelink/Arbiter.scala:60:30, generators/rocket-chip/src/main/scala/tilelink/Edges.scala:229:27]
        state_0 = _RANDOM[1'h0][16];	// @[generators/rocket-chip/src/main/scala/tilelink/Arbiter.scala:88:26, generators/rocket-chip/src/main/scala/tilelink/Edges.scala:229:27]
        state_1 = _RANDOM[1'h0][17];	// @[generators/rocket-chip/src/main/scala/tilelink/Arbiter.scala:88:26, generators/rocket-chip/src/main/scala/tilelink/Edges.scala:229:27]
        beatsLeft_1 = _RANDOM[1'h0][21:18];	// @[generators/rocket-chip/src/main/scala/tilelink/Arbiter.scala:60:30, generators/rocket-chip/src/main/scala/tilelink/Edges.scala:229:27]
        state_1_0 = _RANDOM[1'h0][22];	// @[generators/rocket-chip/src/main/scala/tilelink/Arbiter.scala:88:26, generators/rocket-chip/src/main/scala/tilelink/Edges.scala:229:27]
        state_1_1 = _RANDOM[1'h0][23];	// @[generators/rocket-chip/src/main/scala/tilelink/Arbiter.scala:88:26, generators/rocket-chip/src/main/scala/tilelink/Edges.scala:229:27]
        state_1_2 = _RANDOM[1'h0][24];	// @[generators/rocket-chip/src/main/scala/tilelink/Arbiter.scala:88:26, generators/rocket-chip/src/main/scala/tilelink/Edges.scala:229:27]
        state_1_3 = _RANDOM[1'h0][25];	// @[generators/rocket-chip/src/main/scala/tilelink/Arbiter.scala:88:26, generators/rocket-chip/src/main/scala/tilelink/Edges.scala:229:27]
        state_1_4 = _RANDOM[1'h0][26];	// @[generators/rocket-chip/src/main/scala/tilelink/Arbiter.scala:88:26, generators/rocket-chip/src/main/scala/tilelink/Edges.scala:229:27]
        probe_todo = _RANDOM[1'h0][27];	// @[generators/rocket-chip/src/main/scala/tilelink/Broadcast.scala:215:31, generators/rocket-chip/src/main/scala/tilelink/Edges.scala:229:27]
        probe_line = {_RANDOM[1'h0][31:28], _RANDOM[1'h1][21:0]};	// @[generators/rocket-chip/src/main/scala/tilelink/Broadcast.scala:216:27, generators/rocket-chip/src/main/scala/tilelink/Edges.scala:229:27]
        probe_perms = _RANDOM[1'h1][23:22];	// @[generators/rocket-chip/src/main/scala/tilelink/Broadcast.scala:216:27, :217:28]
        a_first_counter = _RANDOM[1'h1][27:24];	// @[generators/rocket-chip/src/main/scala/tilelink/Broadcast.scala:216:27, generators/rocket-chip/src/main/scala/tilelink/Edges.scala:229:27]
      `endif // RANDOMIZE_REG_INIT
    end // initial
    `ifdef FIRRTL_AFTER_INITIAL
      `FIRRTL_AFTER_INITIAL
    `endif // FIRRTL_AFTER_INITIAL
  `endif // ENABLE_INITIAL_REG_
  TLMonitor_40 monitor (	// @[generators/rocket-chip/src/main/scala/tilelink/Nodes.scala:24:25]
    .clock                (clock),
    .reset                (reset),
    .io_in_a_ready        (nodeIn_a_ready),	// @[generators/rocket-chip/src/main/scala/tilelink/Broadcast.scala:243:59]
    .io_in_a_valid        (auto_in_a_valid),
    .io_in_a_bits_opcode  (auto_in_a_bits_opcode),
    .io_in_a_bits_param   (auto_in_a_bits_param),
    .io_in_a_bits_size    (auto_in_a_bits_size),
    .io_in_a_bits_source  (auto_in_a_bits_source),
    .io_in_a_bits_address (auto_in_a_bits_address),
    .io_in_a_bits_mask    (auto_in_a_bits_mask),
    .io_in_a_bits_corrupt (auto_in_a_bits_corrupt),
    .io_in_b_ready        (auto_in_b_ready),
    .io_in_b_valid        (probe_todo),	// @[generators/rocket-chip/src/main/scala/tilelink/Broadcast.scala:215:31]
    .io_in_b_bits_param   (probe_perms),	// @[generators/rocket-chip/src/main/scala/tilelink/Broadcast.scala:217:28]
    .io_in_b_bits_address (nodeIn_b_bits_b_address),	// @[generators/rocket-chip/src/main/scala/tilelink/Broadcast.scala:225:46]
    .io_in_c_ready        (nodeIn_c_ready),	// @[generators/rocket-chip/src/main/scala/tilelink/Broadcast.scala:184:32]
    .io_in_c_valid        (auto_in_c_valid),
    .io_in_c_bits_opcode  (auto_in_c_bits_opcode),
    .io_in_c_bits_param   (auto_in_c_bits_param),
    .io_in_c_bits_size    (auto_in_c_bits_size),
    .io_in_c_bits_source  (auto_in_c_bits_source),
    .io_in_c_bits_address (auto_in_c_bits_address),
    .io_in_c_bits_corrupt (auto_in_c_bits_corrupt),
    .io_in_d_ready        (auto_in_d_ready),
    .io_in_d_valid        (nodeIn_d_valid),	// @[generators/rocket-chip/src/main/scala/tilelink/Arbiter.scala:96:24]
    .io_in_d_bits_opcode  (_nodeIn_d_bits_WIRE_10),	// @[src/main/scala/chisel3/util/Mux.scala:30:73]
    .io_in_d_bits_param   (_nodeIn_d_bits_WIRE_9),	// @[src/main/scala/chisel3/util/Mux.scala:30:73]
    .io_in_d_bits_size    (_nodeIn_d_bits_WIRE_8),	// @[src/main/scala/chisel3/util/Mux.scala:30:73]
    .io_in_d_bits_source  (_nodeIn_d_bits_WIRE_7),	// @[src/main/scala/chisel3/util/Mux.scala:30:73]
    .io_in_d_bits_sink    (_nodeIn_d_bits_WIRE_6),	// @[src/main/scala/chisel3/util/Mux.scala:30:73]
    .io_in_e_valid        (auto_in_e_valid),
    .io_in_e_bits_sink    (auto_in_e_bits_sink)
  );
  BroadcastFilter filter (	// @[generators/rocket-chip/src/main/scala/tilelink/Broadcast.scala:99:26]
    .io_request_ready         (_filter_io_request_ready),
    .io_request_valid         (auto_in_a_valid & ~(|a_first_counter) & (|_GEN_7)),	// @[generators/rocket-chip/src/main/scala/tilelink/Broadcast.scala:241:{41,58}, :250:56, generators/rocket-chip/src/main/scala/tilelink/Edges.scala:229:27, :231:25]
    .io_request_bits_mshr     ({|(filter_io_request_bits_mshr_lo[3:2]), filter_io_request_bits_mshr_lo[3] | filter_io_request_bits_mshr_lo[1]}),	// @[generators/rocket-chip/src/main/scala/tilelink/Broadcast.scala:239:30, :244:35, :251:38, src/main/scala/chisel3/util/OneHot.scala:30:18, :32:{14,28}]
    .io_request_bits_address  (auto_in_a_bits_address),
    .io_request_bits_allocOH  (auto_in_a_bits_source == 10'h200),	// @[generators/rocket-chip/src/main/scala/diplomacy/Parameters.scala:46:9]
    .io_request_bits_needT    ((&auto_in_a_bits_opcode) | auto_in_a_bits_opcode == 3'h6 ? auto_in_a_bits_param == 3'h2 | auto_in_a_bits_param == 3'h1 : auto_in_a_bits_opcode == 3'h5 ? auto_in_a_bits_param == 3'h1 : auto_in_a_bits_opcode != 3'h4),	// @[generators/rocket-chip/src/main/scala/tilelink/Broadcast.scala:132:36, :158:45, generators/rocket-chip/src/main/scala/tilelink/Edges.scala:276:70, :280:55, :286:85, generators/rocket-chip/src/main/scala/util/Misc.scala:206:21]
    .io_response_ready        (~probe_todo),	// @[generators/rocket-chip/src/main/scala/tilelink/Broadcast.scala:215:31, :259:35]
    .io_response_valid        (_filter_io_response_valid),
    .io_response_bits_mshr    (_filter_io_response_bits_mshr),
    .io_response_bits_address (_filter_io_response_bits_address),
    .io_response_bits_allocOH (_filter_io_response_bits_allocOH),
    .io_response_bits_needT   (_filter_io_response_bits_needT)
  );
  TLBroadcastTracker TLBroadcastTracker (	// @[generators/rocket-chip/src/main/scala/tilelink/Broadcast.scala:107:15]
    .clock                 (clock),
    .reset                 (reset),
    .io_in_a_first         (~(|a_first_counter)),	// @[generators/rocket-chip/src/main/scala/tilelink/Edges.scala:229:27, :231:25]
    .io_in_a_ready         (_TLBroadcastTracker_io_in_a_ready),
    .io_in_a_valid         (auto_in_a_valid & filter_io_request_bits_mshr_lo[0] & _GEN_8),	// @[generators/rocket-chip/src/main/scala/tilelink/Broadcast.scala:239:30, :244:35, :245:{46,59}]
    .io_in_a_bits_opcode   (auto_in_a_bits_opcode),
    .io_in_a_bits_param    (auto_in_a_bits_param),
    .io_in_a_bits_size     (auto_in_a_bits_size),
    .io_in_a_bits_source   (auto_in_a_bits_source),
    .io_in_a_bits_address  (auto_in_a_bits_address),
    .io_in_a_bits_mask     (auto_in_a_bits_mask),
    .io_in_a_bits_data     (auto_in_a_bits_data),
    .io_out_a_ready        (auto_out_a_ready & (idle_1 ? ~winner_1_0 : state_1_1)),	// @[generators/rocket-chip/src/main/scala/tilelink/Arbiter.scala:16:61, :61:28, :88:26, :92:24, :94:31, generators/rocket-chip/src/main/scala/tilelink/Broadcast.scala:197:35]
    .io_out_a_valid        (_TLBroadcastTracker_io_out_a_valid),
    .io_out_a_bits_opcode  (_TLBroadcastTracker_io_out_a_bits_opcode),
    .io_out_a_bits_param   (_TLBroadcastTracker_io_out_a_bits_param),
    .io_out_a_bits_size    (_TLBroadcastTracker_io_out_a_bits_size),
    .io_out_a_bits_source  (_TLBroadcastTracker_io_out_a_bits_source),
    .io_out_a_bits_address (_TLBroadcastTracker_io_out_a_bits_address),
    .io_out_a_bits_mask    (_TLBroadcastTracker_io_out_a_bits_mask),
    .io_out_a_bits_data    (_TLBroadcastTracker_io_out_a_bits_data),
    .io_probe_valid        (_sack_T & _filter_io_response_bits_mshr == 2'h0),	// @[generators/rocket-chip/src/main/scala/tilelink/Broadcast.scala:99:26, :269:85, :272:56, src/main/scala/chisel3/util/Decoupled.scala:52:35]
    .io_probe_bits_count   (~_filter_io_response_bits_allocOH),	// @[generators/rocket-chip/src/main/scala/tilelink/Broadcast.scala:99:26, :257:54]
    .io_probenack          (_GEN_2 & c_trackerOH_0),	// @[generators/rocket-chip/src/main/scala/tilelink/Broadcast.scala:162:55, :175:{40,54}]
    .io_probedack          (d_trackerOH[0] & _GEN_1 & d_drop),	// @[generators/rocket-chip/src/main/scala/tilelink/Broadcast.scala:119:27, :141:33, :143:51, generators/rocket-chip/src/main/scala/util/package.scala:80:42, src/main/scala/chisel3/util/Decoupled.scala:52:35]
    .io_probesack          (_c_first_T & c_trackerOH_0 & _clearOH_T_1 & _GEN_3),	// @[generators/rocket-chip/src/main/scala/tilelink/Broadcast.scala:162:55, :170:50, :176:84, :177:50, src/main/scala/chisel3/util/Decoupled.scala:52:35]
    .io_d_last             (d_trackerOH[0] & _GEN & d_response & d_last),	// @[generators/rocket-chip/src/main/scala/tilelink/Broadcast.scala:140:34, :141:33, :142:65, generators/rocket-chip/src/main/scala/tilelink/Edges.scala:232:33, generators/rocket-chip/src/main/scala/util/package.scala:80:42, src/main/scala/chisel3/util/Decoupled.scala:52:35]
    .io_e_last             (auto_in_e_bits_sink == 2'h0 & auto_in_e_valid),	// @[generators/rocket-chip/src/main/scala/tilelink/Broadcast.scala:112:46, :113:34]
    .io_source             (_TLBroadcastTracker_io_source),
    .io_line               (_TLBroadcastTracker_io_line),
    .io_idle               (_TLBroadcastTracker_io_idle),
    .io_need_d             (_TLBroadcastTracker_io_need_d)
  );
  TLBroadcastTracker_1 TLBroadcastTracker_1 (	// @[generators/rocket-chip/src/main/scala/tilelink/Broadcast.scala:107:15]
    .clock                 (clock),
    .reset                 (reset),
    .io_in_a_first         (~(|a_first_counter)),	// @[generators/rocket-chip/src/main/scala/tilelink/Edges.scala:229:27, :231:25]
    .io_in_a_ready         (_TLBroadcastTracker_1_io_in_a_ready),
    .io_in_a_valid         (auto_in_a_valid & filter_io_request_bits_mshr_lo[1] & _GEN_8),	// @[generators/rocket-chip/src/main/scala/tilelink/Broadcast.scala:239:30, :244:35, :245:{46,59}]
    .io_in_a_bits_opcode   (auto_in_a_bits_opcode),
    .io_in_a_bits_param    (auto_in_a_bits_param),
    .io_in_a_bits_size     (auto_in_a_bits_size),
    .io_in_a_bits_source   (auto_in_a_bits_source),
    .io_in_a_bits_address  (auto_in_a_bits_address),
    .io_in_a_bits_mask     (auto_in_a_bits_mask),
    .io_in_a_bits_data     (auto_in_a_bits_data),
    .io_out_a_ready        (auto_out_a_ready & (idle_1 ? ~_GEN_4 : state_1_2)),	// @[generators/rocket-chip/src/main/scala/tilelink/Arbiter.scala:16:61, :61:28, :88:26, :92:24, :94:31, generators/rocket-chip/src/main/scala/util/package.scala:245:43]
    .io_out_a_valid        (_TLBroadcastTracker_1_io_out_a_valid),
    .io_out_a_bits_opcode  (_TLBroadcastTracker_1_io_out_a_bits_opcode),
    .io_out_a_bits_param   (_TLBroadcastTracker_1_io_out_a_bits_param),
    .io_out_a_bits_size    (_TLBroadcastTracker_1_io_out_a_bits_size),
    .io_out_a_bits_source  (_TLBroadcastTracker_1_io_out_a_bits_source),
    .io_out_a_bits_address (_TLBroadcastTracker_1_io_out_a_bits_address),
    .io_out_a_bits_mask    (_TLBroadcastTracker_1_io_out_a_bits_mask),
    .io_out_a_bits_data    (_TLBroadcastTracker_1_io_out_a_bits_data),
    .io_probe_valid        (_sack_T & _filter_io_response_bits_mshr == 2'h1),	// @[generators/rocket-chip/src/main/scala/tilelink/Broadcast.scala:99:26, :269:85, :272:56, src/main/scala/chisel3/util/Decoupled.scala:52:35]
    .io_probe_bits_count   (~_filter_io_response_bits_allocOH),	// @[generators/rocket-chip/src/main/scala/tilelink/Broadcast.scala:99:26, :257:54]
    .io_probenack          (_GEN_2 & c_trackerOH_1),	// @[generators/rocket-chip/src/main/scala/tilelink/Broadcast.scala:162:55, :175:{40,54}]
    .io_probedack          (d_trackerOH[1] & _GEN_1 & d_drop),	// @[generators/rocket-chip/src/main/scala/tilelink/Broadcast.scala:119:27, :141:33, :143:51, generators/rocket-chip/src/main/scala/util/package.scala:80:42, src/main/scala/chisel3/util/Decoupled.scala:52:35]
    .io_probesack          (_c_first_T & c_trackerOH_1 & _clearOH_T_1 & _GEN_3),	// @[generators/rocket-chip/src/main/scala/tilelink/Broadcast.scala:162:55, :170:50, :176:84, :177:50, src/main/scala/chisel3/util/Decoupled.scala:52:35]
    .io_d_last             (d_trackerOH[1] & _GEN & d_response & d_last),	// @[generators/rocket-chip/src/main/scala/tilelink/Broadcast.scala:140:34, :141:33, :142:65, generators/rocket-chip/src/main/scala/tilelink/Edges.scala:232:33, generators/rocket-chip/src/main/scala/util/package.scala:80:42, src/main/scala/chisel3/util/Decoupled.scala:52:35]
    .io_e_last             (auto_in_e_bits_sink == 2'h1 & auto_in_e_valid),	// @[generators/rocket-chip/src/main/scala/tilelink/Broadcast.scala:112:46, :113:34]
    .io_source             (_TLBroadcastTracker_1_io_source),
    .io_line               (_TLBroadcastTracker_1_io_line),
    .io_idle               (_TLBroadcastTracker_1_io_idle),
    .io_need_d             (_TLBroadcastTracker_1_io_need_d)
  );
  TLBroadcastTracker_2 TLBroadcastTracker_2 (	// @[generators/rocket-chip/src/main/scala/tilelink/Broadcast.scala:107:15]
    .clock                 (clock),
    .reset                 (reset),
    .io_in_a_first         (~(|a_first_counter)),	// @[generators/rocket-chip/src/main/scala/tilelink/Edges.scala:229:27, :231:25]
    .io_in_a_ready         (_TLBroadcastTracker_2_io_in_a_ready),
    .io_in_a_valid         (auto_in_a_valid & filter_io_request_bits_mshr_lo[2] & _GEN_8),	// @[generators/rocket-chip/src/main/scala/tilelink/Broadcast.scala:239:30, :244:35, :245:{46,59}]
    .io_in_a_bits_opcode   (auto_in_a_bits_opcode),
    .io_in_a_bits_param    (auto_in_a_bits_param),
    .io_in_a_bits_size     (auto_in_a_bits_size),
    .io_in_a_bits_source   (auto_in_a_bits_source),
    .io_in_a_bits_address  (auto_in_a_bits_address),
    .io_in_a_bits_mask     (auto_in_a_bits_mask),
    .io_in_a_bits_data     (auto_in_a_bits_data),
    .io_out_a_ready        (auto_out_a_ready & (idle_1 ? ~_GEN_6 : state_1_3)),	// @[generators/rocket-chip/src/main/scala/tilelink/Arbiter.scala:16:61, :61:28, :88:26, :92:24, :94:31, generators/rocket-chip/src/main/scala/util/package.scala:245:43]
    .io_out_a_valid        (_TLBroadcastTracker_2_io_out_a_valid),
    .io_out_a_bits_opcode  (_TLBroadcastTracker_2_io_out_a_bits_opcode),
    .io_out_a_bits_param   (_TLBroadcastTracker_2_io_out_a_bits_param),
    .io_out_a_bits_size    (_TLBroadcastTracker_2_io_out_a_bits_size),
    .io_out_a_bits_source  (_TLBroadcastTracker_2_io_out_a_bits_source),
    .io_out_a_bits_address (_TLBroadcastTracker_2_io_out_a_bits_address),
    .io_out_a_bits_mask    (_TLBroadcastTracker_2_io_out_a_bits_mask),
    .io_out_a_bits_data    (_TLBroadcastTracker_2_io_out_a_bits_data),
    .io_probe_valid        (_sack_T & _filter_io_response_bits_mshr == 2'h2),	// @[generators/rocket-chip/src/main/scala/tilelink/Broadcast.scala:99:26, :269:85, :272:56, src/main/scala/chisel3/util/Decoupled.scala:52:35]
    .io_probe_bits_count   (~_filter_io_response_bits_allocOH),	// @[generators/rocket-chip/src/main/scala/tilelink/Broadcast.scala:99:26, :257:54]
    .io_probenack          (_GEN_2 & c_trackerOH_2),	// @[generators/rocket-chip/src/main/scala/tilelink/Broadcast.scala:162:55, :175:{40,54}]
    .io_probedack          (d_trackerOH[2] & _GEN_1 & d_drop),	// @[generators/rocket-chip/src/main/scala/tilelink/Broadcast.scala:119:27, :141:33, :143:51, generators/rocket-chip/src/main/scala/util/package.scala:80:42, src/main/scala/chisel3/util/Decoupled.scala:52:35]
    .io_probesack          (_c_first_T & c_trackerOH_2 & _clearOH_T_1 & _GEN_3),	// @[generators/rocket-chip/src/main/scala/tilelink/Broadcast.scala:162:55, :170:50, :176:84, :177:50, src/main/scala/chisel3/util/Decoupled.scala:52:35]
    .io_d_last             (d_trackerOH[2] & _GEN & d_response & d_last),	// @[generators/rocket-chip/src/main/scala/tilelink/Broadcast.scala:140:34, :141:33, :142:65, generators/rocket-chip/src/main/scala/tilelink/Edges.scala:232:33, generators/rocket-chip/src/main/scala/util/package.scala:80:42, src/main/scala/chisel3/util/Decoupled.scala:52:35]
    .io_e_last             (auto_in_e_bits_sink == 2'h2 & auto_in_e_valid),	// @[generators/rocket-chip/src/main/scala/tilelink/Broadcast.scala:112:46, :113:34]
    .io_source             (_TLBroadcastTracker_2_io_source),
    .io_line               (_TLBroadcastTracker_2_io_line),
    .io_idle               (_TLBroadcastTracker_2_io_idle),
    .io_need_d             (_TLBroadcastTracker_2_io_need_d)
  );
  TLBroadcastTracker_3 TLBroadcastTracker_3 (	// @[generators/rocket-chip/src/main/scala/tilelink/Broadcast.scala:107:15]
    .clock                 (clock),
    .reset                 (reset),
    .io_in_a_first         (~(|a_first_counter)),	// @[generators/rocket-chip/src/main/scala/tilelink/Edges.scala:229:27, :231:25]
    .io_in_a_ready         (_TLBroadcastTracker_3_io_in_a_ready),
    .io_in_a_valid         (auto_in_a_valid & filter_io_request_bits_mshr_lo[3] & _GEN_8),	// @[generators/rocket-chip/src/main/scala/tilelink/Broadcast.scala:239:30, :244:35, :245:{46,59}]
    .io_in_a_bits_opcode   (auto_in_a_bits_opcode),
    .io_in_a_bits_param    (auto_in_a_bits_param),
    .io_in_a_bits_size     (auto_in_a_bits_size),
    .io_in_a_bits_source   (auto_in_a_bits_source),
    .io_in_a_bits_address  (auto_in_a_bits_address),
    .io_in_a_bits_mask     (auto_in_a_bits_mask),
    .io_in_a_bits_data     (auto_in_a_bits_data),
    .io_out_a_ready        (auto_out_a_ready & (idle_1 ? ~_GEN_5 : state_1_4)),	// @[generators/rocket-chip/src/main/scala/tilelink/Arbiter.scala:16:61, :61:28, :88:26, :92:24, :94:31, generators/rocket-chip/src/main/scala/util/package.scala:245:43]
    .io_out_a_valid        (_TLBroadcastTracker_3_io_out_a_valid),
    .io_out_a_bits_opcode  (_TLBroadcastTracker_3_io_out_a_bits_opcode),
    .io_out_a_bits_param   (_TLBroadcastTracker_3_io_out_a_bits_param),
    .io_out_a_bits_size    (_TLBroadcastTracker_3_io_out_a_bits_size),
    .io_out_a_bits_source  (_TLBroadcastTracker_3_io_out_a_bits_source),
    .io_out_a_bits_address (_TLBroadcastTracker_3_io_out_a_bits_address),
    .io_out_a_bits_mask    (_TLBroadcastTracker_3_io_out_a_bits_mask),
    .io_out_a_bits_data    (_TLBroadcastTracker_3_io_out_a_bits_data),
    .io_probe_valid        (_sack_T & (&_filter_io_response_bits_mshr)),	// @[generators/rocket-chip/src/main/scala/tilelink/Broadcast.scala:99:26, :269:85, :272:56, src/main/scala/chisel3/util/Decoupled.scala:52:35]
    .io_probe_bits_count   (~_filter_io_response_bits_allocOH),	// @[generators/rocket-chip/src/main/scala/tilelink/Broadcast.scala:99:26, :257:54]
    .io_probenack          (_GEN_2 & c_trackerOH_3),	// @[generators/rocket-chip/src/main/scala/tilelink/Broadcast.scala:162:55, :175:{40,54}]
    .io_probedack          (d_trackerOH[3] & _GEN_1 & d_drop),	// @[generators/rocket-chip/src/main/scala/tilelink/Broadcast.scala:119:27, :141:33, :143:51, generators/rocket-chip/src/main/scala/util/package.scala:80:42, src/main/scala/chisel3/util/Decoupled.scala:52:35]
    .io_probesack          (_c_first_T & c_trackerOH_3 & _clearOH_T_1 & _GEN_3),	// @[generators/rocket-chip/src/main/scala/tilelink/Broadcast.scala:162:55, :170:50, :176:84, :177:50, src/main/scala/chisel3/util/Decoupled.scala:52:35]
    .io_d_last             (d_trackerOH[3] & _GEN & d_response & d_last),	// @[generators/rocket-chip/src/main/scala/tilelink/Broadcast.scala:140:34, :141:33, :142:65, generators/rocket-chip/src/main/scala/tilelink/Edges.scala:232:33, generators/rocket-chip/src/main/scala/util/package.scala:80:42, src/main/scala/chisel3/util/Decoupled.scala:52:35]
    .io_e_last             ((&auto_in_e_bits_sink) & auto_in_e_valid),	// @[generators/rocket-chip/src/main/scala/tilelink/Broadcast.scala:112:46, :113:34]
    .io_source             (_TLBroadcastTracker_3_io_source),
    .io_line               (_TLBroadcastTracker_3_io_line),
    .io_idle               (_TLBroadcastTracker_3_io_idle),
    .io_need_d             (_TLBroadcastTracker_3_io_need_d)
  );
  assign auto_in_a_ready = nodeIn_a_ready;	// @[generators/rocket-chip/src/main/scala/tilelink/Broadcast.scala:243:59]
  assign auto_in_b_valid = probe_todo;	// @[generators/rocket-chip/src/main/scala/tilelink/Broadcast.scala:215:31]
  assign auto_in_b_bits_param = probe_perms;	// @[generators/rocket-chip/src/main/scala/tilelink/Broadcast.scala:217:28]
  assign auto_in_b_bits_address = nodeIn_b_bits_b_address;	// @[generators/rocket-chip/src/main/scala/tilelink/Broadcast.scala:225:46]
  assign auto_in_c_ready = nodeIn_c_ready;	// @[generators/rocket-chip/src/main/scala/tilelink/Broadcast.scala:184:32]
  assign auto_in_d_valid = nodeIn_d_valid;	// @[generators/rocket-chip/src/main/scala/tilelink/Arbiter.scala:96:24]
  assign auto_in_d_bits_opcode = _nodeIn_d_bits_WIRE_10;	// @[src/main/scala/chisel3/util/Mux.scala:30:73]
  assign auto_in_d_bits_param = _nodeIn_d_bits_WIRE_9;	// @[src/main/scala/chisel3/util/Mux.scala:30:73]
  assign auto_in_d_bits_size = _nodeIn_d_bits_WIRE_8;	// @[src/main/scala/chisel3/util/Mux.scala:30:73]
  assign auto_in_d_bits_source = _nodeIn_d_bits_WIRE_7;	// @[src/main/scala/chisel3/util/Mux.scala:30:73]
  assign auto_in_d_bits_sink = _nodeIn_d_bits_WIRE_6;	// @[src/main/scala/chisel3/util/Mux.scala:30:73]
  assign auto_in_d_bits_data = muxState_1 ? auto_out_d_bits_data : 32'h0;	// @[generators/rocket-chip/src/main/scala/tilelink/Arbiter.scala:89:25, generators/rocket-chip/src/main/scala/tilelink/Edges.scala:686:15, src/main/scala/chisel3/util/Mux.scala:30:73]
  assign auto_out_a_valid = nodeOut_a_valid;	// @[generators/rocket-chip/src/main/scala/tilelink/Arbiter.scala:96:24]
  assign auto_out_a_bits_opcode = (muxState_1_1 ? _TLBroadcastTracker_io_out_a_bits_opcode : 3'h0) | (muxState_1_2 ? _TLBroadcastTracker_1_io_out_a_bits_opcode : 3'h0) | (muxState_1_3 ? _TLBroadcastTracker_2_io_out_a_bits_opcode : 3'h0) | (muxState_1_4 ? _TLBroadcastTracker_3_io_out_a_bits_opcode : 3'h0);	// @[generators/rocket-chip/src/main/scala/tilelink/Arbiter.scala:89:25, generators/rocket-chip/src/main/scala/tilelink/Broadcast.scala:107:15, :177:27, src/main/scala/chisel3/util/Mux.scala:30:73]
  assign auto_out_a_bits_param = (muxState_1_1 ? _TLBroadcastTracker_io_out_a_bits_param : 3'h0) | (muxState_1_2 ? _TLBroadcastTracker_1_io_out_a_bits_param : 3'h0) | (muxState_1_3 ? _TLBroadcastTracker_2_io_out_a_bits_param : 3'h0) | (muxState_1_4 ? _TLBroadcastTracker_3_io_out_a_bits_param : 3'h0);	// @[generators/rocket-chip/src/main/scala/tilelink/Arbiter.scala:89:25, generators/rocket-chip/src/main/scala/tilelink/Broadcast.scala:107:15, :177:27, src/main/scala/chisel3/util/Mux.scala:30:73]
  assign auto_out_a_bits_size = (muxState_1_0 ? auto_in_c_bits_size : 3'h0) | (muxState_1_1 ? _TLBroadcastTracker_io_out_a_bits_size : 3'h0) | (muxState_1_2 ? _TLBroadcastTracker_1_io_out_a_bits_size : 3'h0) | (muxState_1_3 ? _TLBroadcastTracker_2_io_out_a_bits_size : 3'h0) | (muxState_1_4 ? _TLBroadcastTracker_3_io_out_a_bits_size : 3'h0);	// @[generators/rocket-chip/src/main/scala/tilelink/Arbiter.scala:89:25, generators/rocket-chip/src/main/scala/tilelink/Broadcast.scala:107:15, :177:27, src/main/scala/chisel3/util/Mux.scala:30:73]
  assign auto_out_a_bits_source = (muxState_1_0 ? {(&auto_in_c_bits_opcode) ? 2'h2 : 2'h1, (&auto_in_c_bits_opcode) ? auto_in_c_bits_source : (c_trackerOH_0 ? _TLBroadcastTracker_io_source : 10'h0) | (c_trackerOH_1 ? _TLBroadcastTracker_1_io_source : 10'h0) | (c_trackerOH_2 ? _TLBroadcastTracker_2_io_source : 10'h0) | (c_trackerOH_3 ? _TLBroadcastTracker_3_io_source : 10'h0)} : 12'h0) | (muxState_1_1 ? _TLBroadcastTracker_io_out_a_bits_source : 12'h0) | (muxState_1_2 ? _TLBroadcastTracker_1_io_out_a_bits_source : 12'h0) | (muxState_1_3 ? _TLBroadcastTracker_2_io_out_a_bits_source : 12'h0) | (muxState_1_4 ? _TLBroadcastTracker_3_io_out_a_bits_source : 12'h0);	// @[generators/rocket-chip/src/main/scala/tilelink/Arbiter.scala:89:25, generators/rocket-chip/src/main/scala/tilelink/Broadcast.scala:107:15, :160:45, :162:55, :195:25, :196:25, :198:38, generators/rocket-chip/src/main/scala/tilelink/Bundles.scala:259:74, src/main/scala/chisel3/util/Mux.scala:30:73]
  assign auto_out_a_bits_address = (muxState_1_0 ? auto_in_c_bits_address : 32'h0) | (muxState_1_1 ? _TLBroadcastTracker_io_out_a_bits_address : 32'h0) | (muxState_1_2 ? _TLBroadcastTracker_1_io_out_a_bits_address : 32'h0) | (muxState_1_3 ? _TLBroadcastTracker_2_io_out_a_bits_address : 32'h0) | (muxState_1_4 ? _TLBroadcastTracker_3_io_out_a_bits_address : 32'h0);	// @[generators/rocket-chip/src/main/scala/tilelink/Arbiter.scala:89:25, generators/rocket-chip/src/main/scala/tilelink/Broadcast.scala:107:15, generators/rocket-chip/src/main/scala/tilelink/Edges.scala:686:15, src/main/scala/chisel3/util/Mux.scala:30:73]
  assign auto_out_a_bits_mask = (muxState_1_0 ? {putfull_bits_a_mask_acc_1 | auto_in_c_bits_address[1] & auto_in_c_bits_address[0], putfull_bits_a_mask_acc_1 | auto_in_c_bits_address[1] & ~(auto_in_c_bits_address[0]), putfull_bits_a_mask_acc | ~(auto_in_c_bits_address[1]) & auto_in_c_bits_address[0], putfull_bits_a_mask_acc | ~(auto_in_c_bits_address[1]) & ~(auto_in_c_bits_address[0])} : 4'h0) | (muxState_1_1 ? _TLBroadcastTracker_io_out_a_bits_mask : 4'h0) | (muxState_1_2 ? _TLBroadcastTracker_1_io_out_a_bits_mask : 4'h0) | (muxState_1_3 ? _TLBroadcastTracker_2_io_out_a_bits_mask : 4'h0) | (muxState_1_4 ? _TLBroadcastTracker_3_io_out_a_bits_mask : 4'h0);	// @[generators/rocket-chip/src/main/scala/tilelink/Arbiter.scala:89:25, generators/rocket-chip/src/main/scala/tilelink/Broadcast.scala:107:15, generators/rocket-chip/src/main/scala/tilelink/Edges.scala:229:27, generators/rocket-chip/src/main/scala/util/Misc.scala:210:26, :211:20, :214:27, :215:29, :222:10, src/main/scala/chisel3/util/Mux.scala:30:73]
  assign auto_out_a_bits_data = (muxState_1_0 ? auto_in_c_bits_data : 32'h0) | (muxState_1_1 ? _TLBroadcastTracker_io_out_a_bits_data : 32'h0) | (muxState_1_2 ? _TLBroadcastTracker_1_io_out_a_bits_data : 32'h0) | (muxState_1_3 ? _TLBroadcastTracker_2_io_out_a_bits_data : 32'h0) | (muxState_1_4 ? _TLBroadcastTracker_3_io_out_a_bits_data : 32'h0);	// @[generators/rocket-chip/src/main/scala/tilelink/Arbiter.scala:89:25, generators/rocket-chip/src/main/scala/tilelink/Broadcast.scala:107:15, generators/rocket-chip/src/main/scala/tilelink/Edges.scala:686:15, src/main/scala/chisel3/util/Mux.scala:30:73]
  assign auto_out_d_ready = nodeOut_d_ready;	// @[generators/rocket-chip/src/main/scala/tilelink/Broadcast.scala:128:50]
endmodule

