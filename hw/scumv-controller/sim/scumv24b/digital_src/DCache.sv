// Generated by CIRCT unknown git version
// Standard header to adapt well known macros for register randomization.
`ifndef RANDOMIZE
  `ifdef RANDOMIZE_MEM_INIT
    `define RANDOMIZE
  `endif // RANDOMIZE_MEM_INIT
`endif // not def RANDOMIZE
`ifndef RANDOMIZE
  `ifdef RANDOMIZE_REG_INIT
    `define RANDOMIZE
  `endif // RANDOMIZE_REG_INIT
`endif // not def RANDOMIZE

// RANDOM may be set to an expression that produces a 32-bit random unsigned value.
`ifndef RANDOM
  `define RANDOM $random
`endif // not def RANDOM

// Users can define INIT_RANDOM as general code that gets injected into the
// initializer block for modules with registers.
`ifndef INIT_RANDOM
  `define INIT_RANDOM
`endif // not def INIT_RANDOM

// If using random initialization, you can also define RANDOMIZE_DELAY to
// customize the delay used, otherwise 0.002 is used.
`ifndef RANDOMIZE_DELAY
  `define RANDOMIZE_DELAY 0.002
`endif // not def RANDOMIZE_DELAY

// Define INIT_RANDOM_PROLOG_ for use in our modules below.
`ifndef INIT_RANDOM_PROLOG_
  `ifdef RANDOMIZE
    `ifdef VERILATOR
      `define INIT_RANDOM_PROLOG_ `INIT_RANDOM
    `else  // VERILATOR
      `define INIT_RANDOM_PROLOG_ `INIT_RANDOM #`RANDOMIZE_DELAY begin end
    `endif // VERILATOR
  `else  // RANDOMIZE
    `define INIT_RANDOM_PROLOG_
  `endif // RANDOMIZE
`endif // not def INIT_RANDOM_PROLOG_

// Include register initializers in init blocks unless synthesis is set
`ifndef SYNTHESIS
  `ifndef ENABLE_INITIAL_REG_
    `define ENABLE_INITIAL_REG_
  `endif // not def ENABLE_INITIAL_REG_
`endif // not def SYNTHESIS

// Include rmemory initializers in init blocks unless synthesis is set
`ifndef SYNTHESIS
  `ifndef ENABLE_INITIAL_MEM_
    `define ENABLE_INITIAL_MEM_
  `endif // not def ENABLE_INITIAL_MEM_
`endif // not def SYNTHESIS

// Standard header to adapt well known macros for prints and assertions.

// Users can define 'PRINTF_COND' to add an extra gate to prints.
`ifndef PRINTF_COND_
  `ifdef PRINTF_COND
    `define PRINTF_COND_ (`PRINTF_COND)
  `else  // PRINTF_COND
    `define PRINTF_COND_ 1
  `endif // PRINTF_COND
`endif // not def PRINTF_COND_

// Users can define 'ASSERT_VERBOSE_COND' to add an extra gate to assert error printing.
`ifndef ASSERT_VERBOSE_COND_
  `ifdef ASSERT_VERBOSE_COND
    `define ASSERT_VERBOSE_COND_ (`ASSERT_VERBOSE_COND)
  `else  // ASSERT_VERBOSE_COND
    `define ASSERT_VERBOSE_COND_ 1
  `endif // ASSERT_VERBOSE_COND
`endif // not def ASSERT_VERBOSE_COND_

// Users can define 'STOP_COND' to add an extra gate to stop conditions.
`ifndef STOP_COND_
  `ifdef STOP_COND
    `define STOP_COND_ (`STOP_COND)
  `else  // STOP_COND
    `define STOP_COND_ 1
  `endif // STOP_COND
`endif // not def STOP_COND_

module DCache(
  input         clock,
                reset,
                auto_out_a_ready,	// @[generators/rocket-chip/src/main/scala/diplomacy/LazyModule.scala:366:18]
  output        auto_out_a_valid,	// @[generators/rocket-chip/src/main/scala/diplomacy/LazyModule.scala:366:18]
  output [2:0]  auto_out_a_bits_opcode,	// @[generators/rocket-chip/src/main/scala/diplomacy/LazyModule.scala:366:18]
                auto_out_a_bits_param,	// @[generators/rocket-chip/src/main/scala/diplomacy/LazyModule.scala:366:18]
                auto_out_a_bits_size,	// @[generators/rocket-chip/src/main/scala/diplomacy/LazyModule.scala:366:18]
  output        auto_out_a_bits_source,	// @[generators/rocket-chip/src/main/scala/diplomacy/LazyModule.scala:366:18]
  output [31:0] auto_out_a_bits_address,	// @[generators/rocket-chip/src/main/scala/diplomacy/LazyModule.scala:366:18]
  output [3:0]  auto_out_a_bits_mask,	// @[generators/rocket-chip/src/main/scala/diplomacy/LazyModule.scala:366:18]
  output [31:0] auto_out_a_bits_data,	// @[generators/rocket-chip/src/main/scala/diplomacy/LazyModule.scala:366:18]
  output        auto_out_b_ready,	// @[generators/rocket-chip/src/main/scala/diplomacy/LazyModule.scala:366:18]
  input         auto_out_b_valid,	// @[generators/rocket-chip/src/main/scala/diplomacy/LazyModule.scala:366:18]
  input  [1:0]  auto_out_b_bits_param,	// @[generators/rocket-chip/src/main/scala/diplomacy/LazyModule.scala:366:18]
  input  [2:0]  auto_out_b_bits_size,	// @[generators/rocket-chip/src/main/scala/diplomacy/LazyModule.scala:366:18]
  input         auto_out_b_bits_source,	// @[generators/rocket-chip/src/main/scala/diplomacy/LazyModule.scala:366:18]
  input  [31:0] auto_out_b_bits_address,	// @[generators/rocket-chip/src/main/scala/diplomacy/LazyModule.scala:366:18]
  input         auto_out_c_ready,	// @[generators/rocket-chip/src/main/scala/diplomacy/LazyModule.scala:366:18]
  output        auto_out_c_valid,	// @[generators/rocket-chip/src/main/scala/diplomacy/LazyModule.scala:366:18]
  output [2:0]  auto_out_c_bits_opcode,	// @[generators/rocket-chip/src/main/scala/diplomacy/LazyModule.scala:366:18]
                auto_out_c_bits_param,	// @[generators/rocket-chip/src/main/scala/diplomacy/LazyModule.scala:366:18]
                auto_out_c_bits_size,	// @[generators/rocket-chip/src/main/scala/diplomacy/LazyModule.scala:366:18]
  output        auto_out_c_bits_source,	// @[generators/rocket-chip/src/main/scala/diplomacy/LazyModule.scala:366:18]
  output [31:0] auto_out_c_bits_address,	// @[generators/rocket-chip/src/main/scala/diplomacy/LazyModule.scala:366:18]
                auto_out_c_bits_data,	// @[generators/rocket-chip/src/main/scala/diplomacy/LazyModule.scala:366:18]
  output        auto_out_d_ready,	// @[generators/rocket-chip/src/main/scala/diplomacy/LazyModule.scala:366:18]
  input         auto_out_d_valid,	// @[generators/rocket-chip/src/main/scala/diplomacy/LazyModule.scala:366:18]
  input  [2:0]  auto_out_d_bits_opcode,	// @[generators/rocket-chip/src/main/scala/diplomacy/LazyModule.scala:366:18]
  input  [1:0]  auto_out_d_bits_param,	// @[generators/rocket-chip/src/main/scala/diplomacy/LazyModule.scala:366:18]
  input  [2:0]  auto_out_d_bits_size,	// @[generators/rocket-chip/src/main/scala/diplomacy/LazyModule.scala:366:18]
  input         auto_out_d_bits_source,	// @[generators/rocket-chip/src/main/scala/diplomacy/LazyModule.scala:366:18]
  input  [1:0]  auto_out_d_bits_sink,	// @[generators/rocket-chip/src/main/scala/diplomacy/LazyModule.scala:366:18]
  input         auto_out_d_bits_denied,	// @[generators/rocket-chip/src/main/scala/diplomacy/LazyModule.scala:366:18]
  input  [31:0] auto_out_d_bits_data,	// @[generators/rocket-chip/src/main/scala/diplomacy/LazyModule.scala:366:18]
  input         auto_out_e_ready,	// @[generators/rocket-chip/src/main/scala/diplomacy/LazyModule.scala:366:18]
  output        auto_out_e_valid,	// @[generators/rocket-chip/src/main/scala/diplomacy/LazyModule.scala:366:18]
  output [1:0]  auto_out_e_bits_sink,	// @[generators/rocket-chip/src/main/scala/diplomacy/LazyModule.scala:366:18]
  output        io_cpu_req_ready,	// @[generators/rocket-chip/src/main/scala/rocket/HellaCache.scala:234:14]
  input         io_cpu_req_valid,	// @[generators/rocket-chip/src/main/scala/rocket/HellaCache.scala:234:14]
  input  [31:0] io_cpu_req_bits_addr,	// @[generators/rocket-chip/src/main/scala/rocket/HellaCache.scala:234:14]
  input  [5:0]  io_cpu_req_bits_tag,	// @[generators/rocket-chip/src/main/scala/rocket/HellaCache.scala:234:14]
  input  [4:0]  io_cpu_req_bits_cmd,	// @[generators/rocket-chip/src/main/scala/rocket/HellaCache.scala:234:14]
  input  [1:0]  io_cpu_req_bits_size,	// @[generators/rocket-chip/src/main/scala/rocket/HellaCache.scala:234:14]
  input         io_cpu_req_bits_signed,	// @[generators/rocket-chip/src/main/scala/rocket/HellaCache.scala:234:14]
                io_cpu_req_bits_dv,	// @[generators/rocket-chip/src/main/scala/rocket/HellaCache.scala:234:14]
                io_cpu_s1_kill,	// @[generators/rocket-chip/src/main/scala/rocket/HellaCache.scala:234:14]
  input  [31:0] io_cpu_s1_data_data,	// @[generators/rocket-chip/src/main/scala/rocket/HellaCache.scala:234:14]
  input  [3:0]  io_cpu_s1_data_mask,	// @[generators/rocket-chip/src/main/scala/rocket/HellaCache.scala:234:14]
  output        io_cpu_s2_nack,	// @[generators/rocket-chip/src/main/scala/rocket/HellaCache.scala:234:14]
                io_cpu_resp_valid,	// @[generators/rocket-chip/src/main/scala/rocket/HellaCache.scala:234:14]
  output [31:0] io_cpu_resp_bits_addr,	// @[generators/rocket-chip/src/main/scala/rocket/HellaCache.scala:234:14]
  output [5:0]  io_cpu_resp_bits_tag,	// @[generators/rocket-chip/src/main/scala/rocket/HellaCache.scala:234:14]
  output [4:0]  io_cpu_resp_bits_cmd,	// @[generators/rocket-chip/src/main/scala/rocket/HellaCache.scala:234:14]
  output [1:0]  io_cpu_resp_bits_size,	// @[generators/rocket-chip/src/main/scala/rocket/HellaCache.scala:234:14]
  output        io_cpu_resp_bits_signed,	// @[generators/rocket-chip/src/main/scala/rocket/HellaCache.scala:234:14]
  output [1:0]  io_cpu_resp_bits_dprv,	// @[generators/rocket-chip/src/main/scala/rocket/HellaCache.scala:234:14]
  output        io_cpu_resp_bits_dv,	// @[generators/rocket-chip/src/main/scala/rocket/HellaCache.scala:234:14]
  output [31:0] io_cpu_resp_bits_data,	// @[generators/rocket-chip/src/main/scala/rocket/HellaCache.scala:234:14]
  output [3:0]  io_cpu_resp_bits_mask,	// @[generators/rocket-chip/src/main/scala/rocket/HellaCache.scala:234:14]
  output        io_cpu_resp_bits_replay,	// @[generators/rocket-chip/src/main/scala/rocket/HellaCache.scala:234:14]
                io_cpu_resp_bits_has_data,	// @[generators/rocket-chip/src/main/scala/rocket/HellaCache.scala:234:14]
  output [31:0] io_cpu_resp_bits_data_word_bypass,	// @[generators/rocket-chip/src/main/scala/rocket/HellaCache.scala:234:14]
                io_cpu_resp_bits_data_raw,	// @[generators/rocket-chip/src/main/scala/rocket/HellaCache.scala:234:14]
                io_cpu_resp_bits_store_data,	// @[generators/rocket-chip/src/main/scala/rocket/HellaCache.scala:234:14]
  output        io_cpu_replay_next,	// @[generators/rocket-chip/src/main/scala/rocket/HellaCache.scala:234:14]
                io_cpu_s2_xcpt_ma_ld,	// @[generators/rocket-chip/src/main/scala/rocket/HellaCache.scala:234:14]
                io_cpu_s2_xcpt_ma_st,	// @[generators/rocket-chip/src/main/scala/rocket/HellaCache.scala:234:14]
                io_cpu_s2_xcpt_pf_ld,	// @[generators/rocket-chip/src/main/scala/rocket/HellaCache.scala:234:14]
                io_cpu_s2_xcpt_pf_st,	// @[generators/rocket-chip/src/main/scala/rocket/HellaCache.scala:234:14]
                io_cpu_s2_xcpt_ae_ld,	// @[generators/rocket-chip/src/main/scala/rocket/HellaCache.scala:234:14]
                io_cpu_s2_xcpt_ae_st,	// @[generators/rocket-chip/src/main/scala/rocket/HellaCache.scala:234:14]
                io_cpu_ordered,	// @[generators/rocket-chip/src/main/scala/rocket/HellaCache.scala:234:14]
                io_cpu_perf_release,	// @[generators/rocket-chip/src/main/scala/rocket/HellaCache.scala:234:14]
                io_cpu_perf_grant,	// @[generators/rocket-chip/src/main/scala/rocket/HellaCache.scala:234:14]
                io_ptw_req_bits_bits_need_gpa,	// @[generators/rocket-chip/src/main/scala/rocket/HellaCache.scala:234:14]
                io_ptw_req_bits_bits_stage2,	// @[generators/rocket-chip/src/main/scala/rocket/HellaCache.scala:234:14]
  input         io_ptw_status_debug	// @[generators/rocket-chip/src/main/scala/rocket/HellaCache.scala:234:14]
);

  wire [5:0]       metaArb_io_in_0_bits_idx;	// @[generators/rocket-chip/src/main/scala/rocket/DCache.scala:1010:44]
  wire             io_cpu_s2_xcpt_ma_st_0;	// @[generators/rocket-chip/src/main/scala/rocket/DCache.scala:926:24]
  wire             io_cpu_s2_xcpt_ma_ld_0;	// @[generators/rocket-chip/src/main/scala/rocket/DCache.scala:926:24]
  wire             io_cpu_s2_xcpt_ae_st_0;	// @[generators/rocket-chip/src/main/scala/rocket/DCache.scala:926:24]
  wire             io_cpu_s2_xcpt_ae_ld_0;	// @[generators/rocket-chip/src/main/scala/rocket/DCache.scala:926:24]
  wire             io_cpu_s2_xcpt_pf_st_0;	// @[generators/rocket-chip/src/main/scala/rocket/DCache.scala:926:24]
  wire             io_cpu_s2_xcpt_pf_ld_0;	// @[generators/rocket-chip/src/main/scala/rocket/DCache.scala:926:24]
  wire [21:0]      metaArb_io_in_7_bits_data;	// @[generators/rocket-chip/src/main/scala/rocket/DCache.scala:907:97]
  wire             metaArb_io_in_4_valid;	// @[generators/rocket-chip/src/main/scala/util/package.scala:73:59]
  wire [11:0]      dataArb_io_in_2_bits_addr;	// @[generators/rocket-chip/src/main/scala/rocket/DCache.scala:897:72]
  wire             dataArb_io_in_2_valid;	// @[generators/rocket-chip/src/main/scala/rocket/DCache.scala:894:41]
  wire [1:0]       releaseWay;	// @[generators/rocket-chip/src/main/scala/rocket/DCache.scala:807:14, :857:102, :871:18]
  wire [2:0]       nodeOut_c_bits_size;	// @[generators/rocket-chip/src/main/scala/rocket/DCache.scala:853:48, :857:102, :858:52]
  wire [2:0]       nodeOut_c_bits_opcode;	// @[generators/rocket-chip/src/main/scala/rocket/DCache.scala:853:48, :857:102, :858:52]
  wire             nodeOut_c_valid;	// @[generators/rocket-chip/src/main/scala/rocket/DCache.scala:818:21, :844:47, :845:22, :848:48, :849:22]
  wire [5:0]       metaArb_io_in_6_bits_idx;	// @[generators/rocket-chip/src/main/scala/rocket/DCache.scala:766:29, :835:44, :837:33]
  wire             metaArb_io_in_6_valid;	// @[generators/rocket-chip/src/main/scala/rocket/DCache.scala:763:26, :835:44, :836:30]
  wire             s1_nack;	// @[generators/rocket-chip/src/main/scala/rocket/DCache.scala:565:36, :818:21, :833:24]
  wire             dataArb_io_in_1_bits_write;	// @[generators/rocket-chip/src/main/scala/rocket/DCache.scala:721:33, :746:68, :749:29]
  wire             dataArb_io_in_1_valid;	// @[generators/rocket-chip/src/main/scala/rocket/DCache.scala:715:26, :746:68, :749:29, :751:32]
  wire             nodeOut_d_ready;	// @[generators/rocket-chip/src/main/scala/rocket/DCache.scala:665:18, :716:51, :718:20, :746:68, :747:22]
  wire [21:0]      metaArb_io_in_3_bits_data;	// @[generators/rocket-chip/src/main/scala/rocket/DCache.scala:740:134]
  wire             metaArb_io_in_3_valid;	// @[generators/rocket-chip/src/main/scala/rocket/DCache.scala:735:53]
  wire [11:0]      dataArb_io_in_1_bits_addr;	// @[generators/rocket-chip/src/main/scala/rocket/DCache.scala:722:32]
  wire [3:0]       dataArb_io_in_0_bits_eccMask;	// @[generators/rocket-chip/src/main/scala/rocket/DCache.scala:551:47]
  wire [31:0]      dataArb_io_in_0_bits_wdata;	// @[generators/rocket-chip/src/main/scala/rocket/DCache.scala:545:63]
  wire [1:0]       dataArb_io_in_0_bits_way_en;	// @[generators/rocket-chip/src/main/scala/rocket/DCache.scala:544:38]
  wire [11:0]      _dataArb_io_in_0_bits_wordMask_wordMask_T;	// @[generators/rocket-chip/src/main/scala/rocket/DCache.scala:543:36]
  wire             dataArb_io_in_0_valid;	// @[generators/rocket-chip/src/main/scala/rocket/DCache.scala:511:44]
  wire             dataArb_io_in_0_bits_write;	// @[generators/rocket-chip/src/main/scala/rocket/DCache.scala:511:44]
  wire [21:0]      metaArb_io_in_2_bits_data;	// @[generators/rocket-chip/src/main/scala/rocket/DCache.scala:461:97]
  wire [5:0]       metaArb_io_in_3_bits_idx;	// @[generators/rocket-chip/src/main/scala/rocket/DCache.scala:447:76]
  wire [5:0]       metaArb_io_in_4_bits_idx;	// @[generators/rocket-chip/src/main/scala/rocket/DCache.scala:1193:47]
  wire             metaArb_io_in_2_valid;	// @[generators/rocket-chip/src/main/scala/rocket/DCache.scala:440:62]
  wire [1:0]       metaArb_io_in_2_bits_way_en;	// @[generators/rocket-chip/src/main/scala/rocket/DCache.scala:426:33]
  reg  [31:0]      s2_req_addr;	// @[generators/rocket-chip/src/main/scala/rocket/DCache.scala:333:19]
  wire             tag_array_s1_meta_en;	// @[generators/rocket-chip/src/main/scala/rocket/DCache.scala:308:59]
  wire             tag_array_MPORT_en;	// @[generators/rocket-chip/src/main/scala/rocket/DCache.scala:304:27]
  wire [5:0]       metaArb_io_in_7_bits_idx;	// @[generators/rocket-chip/src/main/scala/rocket/DCache.scala:257:58]
  wire [11:0]      dataArb_io_in_3_bits_addr;	// @[generators/rocket-chip/src/main/scala/rocket/DCache.scala:239:30]
  wire             dataArb_io_in_3_valid;	// @[generators/rocket-chip/src/main/scala/rocket/DCache.scala:236:46]
  reg  [1:0]       refill_way;	// @[generators/rocket-chip/src/main/scala/rocket/DCache.scala:223:23]
  reg              resetting;	// @[generators/rocket-chip/src/main/scala/rocket/DCache.scala:218:26]
  wire [31:0]      _amoalus_0_io_out;	// @[generators/rocket-chip/src/main/scala/rocket/DCache.scala:975:26]
  wire [31:0]      _data_io_resp_0;	// @[generators/rocket-chip/src/main/scala/rocket/DCache.scala:139:20]
  wire [31:0]      _data_io_resp_1;	// @[generators/rocket-chip/src/main/scala/rocket/DCache.scala:139:20]
  wire [43:0]      _tag_array_RW0_rdata;	// @[generators/rocket-chip/src/main/scala/util/DescribedSRAM.scala:17:26]
  wire             _lfsr_prng_io_out_0;	// @[src/main/scala/chisel3/util/random/PRNG.scala:91:22]
  wire             _GEN = metaArb_io_in_2_valid | metaArb_io_in_3_valid;	// @[generators/rocket-chip/src/main/scala/rocket/DCache.scala:440:62, :735:53, src/main/scala/chisel3/util/Arbiter.scala:139:26, :141:19]
  wire             metaArb_io_out_bits_write = resetting | metaArb_io_in_2_valid | metaArb_io_in_3_valid | metaArb_io_in_4_valid;	// @[generators/rocket-chip/src/main/scala/rocket/DCache.scala:218:26, :440:62, :735:53, generators/rocket-chip/src/main/scala/util/package.scala:73:59, src/main/scala/chisel3/util/Arbiter.scala:139:26, :141:19]
  wire             metaArb__grant_T_2 = resetting | metaArb_io_in_2_valid | metaArb_io_in_3_valid;	// @[generators/rocket-chip/src/main/scala/rocket/DCache.scala:218:26, :440:62, :735:53, src/main/scala/chisel3/util/Arbiter.scala:45:68]
  wire             metaArb__grant_T_3 = metaArb__grant_T_2 | metaArb_io_in_4_valid;	// @[generators/rocket-chip/src/main/scala/util/package.scala:73:59, src/main/scala/chisel3/util/Arbiter.scala:45:68]
  wire             metaArb__grant_T_5 = metaArb__grant_T_3 | metaArb_io_in_6_valid;	// @[generators/rocket-chip/src/main/scala/rocket/DCache.scala:763:26, :835:44, :836:30, src/main/scala/chisel3/util/Arbiter.scala:45:68]
  wire             metaArb_io_out_valid = metaArb__grant_T_5 | io_cpu_req_valid;	// @[src/main/scala/chisel3/util/Arbiter.scala:45:68, :148:31]
  wire             dataArb__grant_T = dataArb_io_in_0_valid | dataArb_io_in_1_valid;	// @[generators/rocket-chip/src/main/scala/rocket/DCache.scala:511:44, :715:26, :746:68, :749:29, :751:32, src/main/scala/chisel3/util/Arbiter.scala:45:68]
  wire             dataArb__grant_T_1 = dataArb__grant_T | dataArb_io_in_2_valid;	// @[generators/rocket-chip/src/main/scala/rocket/DCache.scala:894:41, src/main/scala/chisel3/util/Arbiter.scala:45:68]
  wire             dataArb_io_out_valid = dataArb__grant_T_1 | dataArb_io_in_3_valid;	// @[generators/rocket-chip/src/main/scala/rocket/DCache.scala:236:46, src/main/scala/chisel3/util/Arbiter.scala:45:68, :148:31]
  reg              s1_valid;	// @[generators/rocket-chip/src/main/scala/rocket/DCache.scala:176:25]
  reg              s1_probe;	// @[generators/rocket-chip/src/main/scala/rocket/DCache.scala:177:25]
  reg  [1:0]       probe_bits_param;	// @[generators/rocket-chip/src/main/scala/rocket/DCache.scala:178:29]
  reg  [2:0]       probe_bits_size;	// @[generators/rocket-chip/src/main/scala/rocket/DCache.scala:178:29]
  reg              probe_bits_source;	// @[generators/rocket-chip/src/main/scala/rocket/DCache.scala:178:29]
  reg  [31:0]      probe_bits_address;	// @[generators/rocket-chip/src/main/scala/rocket/DCache.scala:178:29]
  wire             s1_valid_masked = s1_valid & ~io_cpu_s1_kill;	// @[generators/rocket-chip/src/main/scala/rocket/DCache.scala:176:25, :180:{34,37}]
  reg  [31:0]      s1_vaddr;	// @[generators/rocket-chip/src/main/scala/rocket/DCache.scala:190:25]
  reg  [5:0]       s1_req_tag;	// @[generators/rocket-chip/src/main/scala/rocket/DCache.scala:190:25]
  reg  [4:0]       s1_req_cmd;	// @[generators/rocket-chip/src/main/scala/rocket/DCache.scala:190:25]
  reg  [1:0]       s1_req_size;	// @[generators/rocket-chip/src/main/scala/rocket/DCache.scala:190:25]
  reg              s1_req_signed;	// @[generators/rocket-chip/src/main/scala/rocket/DCache.scala:190:25]
  reg  [1:0]       s1_req_dprv;	// @[generators/rocket-chip/src/main/scala/rocket/DCache.scala:190:25]
  reg              s1_req_dv;	// @[generators/rocket-chip/src/main/scala/rocket/DCache.scala:190:25]
  reg  [31:0]      s1_tlb_req_vaddr;	// @[generators/rocket-chip/src/main/scala/rocket/DCache.scala:202:29]
  reg  [1:0]       s1_tlb_req_size;	// @[generators/rocket-chip/src/main/scala/rocket/DCache.scala:202:29]
  reg  [4:0]       s1_tlb_req_cmd;	// @[generators/rocket-chip/src/main/scala/rocket/DCache.scala:202:29]
  reg  [1:0]       s1_tlb_req_prv;	// @[generators/rocket-chip/src/main/scala/rocket/DCache.scala:202:29]
  wire             _io_cpu_perf_canAcceptLoadThenLoad_T_1 = s1_req_cmd == 5'h0;	// @[generators/rocket-chip/src/main/scala/rocket/DCache.scala:94:20, :190:25, generators/rocket-chip/src/main/scala/util/package.scala:16:47]
  wire             _io_cpu_perf_canAcceptLoadThenLoad_T_2 = s1_req_cmd == 5'h10;	// @[generators/rocket-chip/src/main/scala/rocket/DCache.scala:190:25, generators/rocket-chip/src/main/scala/util/package.scala:16:47]
  wire             _io_cpu_perf_canAcceptLoadThenLoad_T_3 = s1_req_cmd == 5'h6;	// @[generators/rocket-chip/src/main/scala/rocket/DCache.scala:190:25, generators/rocket-chip/src/main/scala/util/package.scala:16:47]
  wire             _io_cpu_perf_canAcceptLoadThenLoad_T_29 = s1_req_cmd == 5'h7;	// @[generators/rocket-chip/src/main/scala/rocket/DCache.scala:190:25, generators/rocket-chip/src/main/scala/util/package.scala:16:47]
  wire             _io_cpu_perf_canAcceptLoadThenLoad_T_31 = s1_req_cmd == 5'h4;	// @[generators/rocket-chip/src/main/scala/rocket/DCache.scala:190:25, generators/rocket-chip/src/main/scala/util/package.scala:16:47]
  wire             _io_cpu_perf_canAcceptLoadThenLoad_T_32 = s1_req_cmd == 5'h9;	// @[generators/rocket-chip/src/main/scala/rocket/DCache.scala:190:25, generators/rocket-chip/src/main/scala/util/package.scala:16:47]
  wire             _io_cpu_perf_canAcceptLoadThenLoad_T_33 = s1_req_cmd == 5'hA;	// @[generators/rocket-chip/src/main/scala/rocket/DCache.scala:190:25, generators/rocket-chip/src/main/scala/util/package.scala:16:47]
  wire             _io_cpu_perf_canAcceptLoadThenLoad_T_34 = s1_req_cmd == 5'hB;	// @[generators/rocket-chip/src/main/scala/rocket/DCache.scala:190:25, generators/rocket-chip/src/main/scala/util/package.scala:16:47]
  wire             _io_cpu_perf_canAcceptLoadThenLoad_T_38 = s1_req_cmd == 5'h8;	// @[generators/rocket-chip/src/main/scala/rocket/DCache.scala:190:25, generators/rocket-chip/src/main/scala/util/package.scala:16:47]
  wire             _io_cpu_perf_canAcceptLoadThenLoad_T_39 = s1_req_cmd == 5'hC;	// @[generators/rocket-chip/src/main/scala/rocket/DCache.scala:190:25, generators/rocket-chip/src/main/scala/util/package.scala:16:47]
  wire             _io_cpu_perf_canAcceptLoadThenLoad_T_40 = s1_req_cmd == 5'hD;	// @[generators/rocket-chip/src/main/scala/rocket/DCache.scala:190:25, generators/rocket-chip/src/main/scala/util/package.scala:16:47]
  wire             _io_cpu_perf_canAcceptLoadThenLoad_T_41 = s1_req_cmd == 5'hE;	// @[generators/rocket-chip/src/main/scala/rocket/DCache.scala:190:25, generators/rocket-chip/src/main/scala/util/package.scala:16:47]
  wire             _io_cpu_perf_canAcceptLoadThenLoad_T_42 = s1_req_cmd == 5'hF;	// @[generators/rocket-chip/src/main/scala/rocket/DCache.scala:190:25, generators/rocket-chip/src/main/scala/util/package.scala:16:47]
  wire             s1_read = _io_cpu_perf_canAcceptLoadThenLoad_T_1 | _io_cpu_perf_canAcceptLoadThenLoad_T_2 | _io_cpu_perf_canAcceptLoadThenLoad_T_3 | _io_cpu_perf_canAcceptLoadThenLoad_T_29 | _io_cpu_perf_canAcceptLoadThenLoad_T_31 | _io_cpu_perf_canAcceptLoadThenLoad_T_32 | _io_cpu_perf_canAcceptLoadThenLoad_T_33 | _io_cpu_perf_canAcceptLoadThenLoad_T_34 | _io_cpu_perf_canAcceptLoadThenLoad_T_38 | _io_cpu_perf_canAcceptLoadThenLoad_T_39 | _io_cpu_perf_canAcceptLoadThenLoad_T_40 | _io_cpu_perf_canAcceptLoadThenLoad_T_41 | _io_cpu_perf_canAcceptLoadThenLoad_T_42;	// @[generators/rocket-chip/src/main/scala/rocket/Consts.scala:85:68, generators/rocket-chip/src/main/scala/util/package.scala:16:47]
  wire             _io_cpu_perf_canAcceptLoadThenLoad_T_26 = s1_req_cmd == 5'h1;	// @[generators/rocket-chip/src/main/scala/rocket/Consts.scala:86:32, generators/rocket-chip/src/main/scala/rocket/DCache.scala:190:25, generators/rocket-chip/src/main/scala/rocket/TLB.scala:546:69]
  wire             _io_cpu_perf_canAcceptLoadThenLoad_T_51 = s1_req_cmd == 5'h11;	// @[generators/rocket-chip/src/main/scala/rocket/Consts.scala:86:49, generators/rocket-chip/src/main/scala/rocket/DCache.scala:190:25, generators/rocket-chip/src/main/scala/rocket/TLB.scala:569:41]
  wire             s1_write = _io_cpu_perf_canAcceptLoadThenLoad_T_26 | _io_cpu_perf_canAcceptLoadThenLoad_T_51 | _io_cpu_perf_canAcceptLoadThenLoad_T_29 | _io_cpu_perf_canAcceptLoadThenLoad_T_31 | _io_cpu_perf_canAcceptLoadThenLoad_T_32 | _io_cpu_perf_canAcceptLoadThenLoad_T_33 | _io_cpu_perf_canAcceptLoadThenLoad_T_34 | _io_cpu_perf_canAcceptLoadThenLoad_T_38 | _io_cpu_perf_canAcceptLoadThenLoad_T_39 | _io_cpu_perf_canAcceptLoadThenLoad_T_40 | _io_cpu_perf_canAcceptLoadThenLoad_T_41 | _io_cpu_perf_canAcceptLoadThenLoad_T_42;	// @[generators/rocket-chip/src/main/scala/rocket/Consts.scala:86:{32,49,76}, generators/rocket-chip/src/main/scala/util/package.scala:16:47]
  reg              s1_flush_valid;	// @[generators/rocket-chip/src/main/scala/rocket/DCache.scala:209:27]
  reg              cached_grant_wait;	// @[generators/rocket-chip/src/main/scala/rocket/DCache.scala:217:34]
  reg  [6:0]       flushCounter;	// @[generators/rocket-chip/src/main/scala/rocket/DCache.scala:219:29]
  reg              release_ack_wait;	// @[generators/rocket-chip/src/main/scala/rocket/DCache.scala:220:33]
  reg  [31:0]      release_ack_addr;	// @[generators/rocket-chip/src/main/scala/rocket/DCache.scala:221:29]
  reg  [3:0]       release_state;	// @[generators/rocket-chip/src/main/scala/rocket/DCache.scala:222:30]
  wire             _canAcceptCachedGrant_T = release_state == 4'h1;	// @[generators/rocket-chip/src/main/scala/rocket/DCache.scala:222:30, generators/rocket-chip/src/main/scala/util/package.scala:16:47]
  wire             _inWriteback_T_1 = release_state == 4'h2;	// @[generators/rocket-chip/src/main/scala/rocket/DCache.scala:222:30, generators/rocket-chip/src/main/scala/util/package.scala:16:47]
  wire             inWriteback = _canAcceptCachedGrant_T | _inWriteback_T_1;	// @[generators/rocket-chip/src/main/scala/util/package.scala:16:47, :73:59]
  wire             _io_cpu_req_ready_T_4 = release_state == 4'h0 & ~cached_grant_wait & ~s1_nack;	// @[generators/rocket-chip/src/main/scala/rocket/DCache.scala:181:41, :217:34, :222:30, :227:{38,54,73}, :565:36, :818:21, :833:24, generators/rocket-chip/src/main/scala/rocket/HellaCache.scala:234:14]
  reg              uncachedInFlight_0;	// @[generators/rocket-chip/src/main/scala/rocket/DCache.scala:230:33]
  reg  [31:0]      uncachedReqs_0_addr;	// @[generators/rocket-chip/src/main/scala/rocket/DCache.scala:231:25]
  reg  [5:0]       uncachedReqs_0_tag;	// @[generators/rocket-chip/src/main/scala/rocket/DCache.scala:231:25]
  reg  [1:0]       uncachedReqs_0_size;	// @[generators/rocket-chip/src/main/scala/rocket/DCache.scala:231:25]
  reg              uncachedReqs_0_signed;	// @[generators/rocket-chip/src/main/scala/rocket/DCache.scala:231:25]
  wire             _pstore_drain_opportunistic_T = io_cpu_req_bits_cmd == 5'h0;	// @[generators/rocket-chip/src/main/scala/rocket/DCache.scala:94:20, generators/rocket-chip/src/main/scala/util/package.scala:16:47]
  wire             _pstore_drain_opportunistic_T_1 = io_cpu_req_bits_cmd == 5'h10;	// @[generators/rocket-chip/src/main/scala/util/package.scala:16:47]
  wire             _pstore_drain_opportunistic_T_2 = io_cpu_req_bits_cmd == 5'h6;	// @[generators/rocket-chip/src/main/scala/util/package.scala:16:47]
  wire             _pstore_drain_opportunistic_T_28 = io_cpu_req_bits_cmd == 5'h7;	// @[generators/rocket-chip/src/main/scala/util/package.scala:16:47]
  wire             _pstore_drain_opportunistic_T_30 = io_cpu_req_bits_cmd == 5'h4;	// @[generators/rocket-chip/src/main/scala/util/package.scala:16:47]
  wire             _pstore_drain_opportunistic_T_31 = io_cpu_req_bits_cmd == 5'h9;	// @[generators/rocket-chip/src/main/scala/util/package.scala:16:47]
  wire             _pstore_drain_opportunistic_T_32 = io_cpu_req_bits_cmd == 5'hA;	// @[generators/rocket-chip/src/main/scala/util/package.scala:16:47]
  wire             _pstore_drain_opportunistic_T_33 = io_cpu_req_bits_cmd == 5'hB;	// @[generators/rocket-chip/src/main/scala/util/package.scala:16:47]
  wire             _pstore_drain_opportunistic_T_37 = io_cpu_req_bits_cmd == 5'h8;	// @[generators/rocket-chip/src/main/scala/util/package.scala:16:47]
  wire             _pstore_drain_opportunistic_T_38 = io_cpu_req_bits_cmd == 5'hC;	// @[generators/rocket-chip/src/main/scala/util/package.scala:16:47]
  wire             _pstore_drain_opportunistic_T_39 = io_cpu_req_bits_cmd == 5'hD;	// @[generators/rocket-chip/src/main/scala/util/package.scala:16:47]
  wire             _pstore_drain_opportunistic_T_40 = io_cpu_req_bits_cmd == 5'hE;	// @[generators/rocket-chip/src/main/scala/util/package.scala:16:47]
  wire             _pstore_drain_opportunistic_T_41 = io_cpu_req_bits_cmd == 5'hF;	// @[generators/rocket-chip/src/main/scala/util/package.scala:16:47]
  wire             _pstore_drain_opportunistic_T_25 = io_cpu_req_bits_cmd == 5'h1;	// @[generators/rocket-chip/src/main/scala/rocket/TLB.scala:546:69, generators/rocket-chip/src/main/scala/util/package.scala:16:47]
  wire             _pstore_drain_opportunistic_res_T_1 = io_cpu_req_bits_cmd == 5'h3;	// @[generators/rocket-chip/src/main/scala/util/package.scala:16:47]
  wire             _dataArb_io_in_3_valid_res_T_2 = _pstore_drain_opportunistic_T_25 | _pstore_drain_opportunistic_res_T_1;	// @[generators/rocket-chip/src/main/scala/util/package.scala:16:47, :73:59]
  wire             _pstore_drain_opportunistic_T_50 = io_cpu_req_bits_cmd == 5'h11;	// @[generators/rocket-chip/src/main/scala/rocket/Consts.scala:86:49, generators/rocket-chip/src/main/scala/rocket/TLB.scala:569:41]
  assign dataArb_io_in_3_valid = io_cpu_req_valid & ~_dataArb_io_in_3_valid_res_T_2;	// @[generators/rocket-chip/src/main/scala/rocket/DCache.scala:236:46, :1178:15, generators/rocket-chip/src/main/scala/util/package.scala:73:59]
  assign dataArb_io_in_3_bits_addr = io_cpu_req_bits_addr[11:0];	// @[generators/rocket-chip/src/main/scala/rocket/DCache.scala:239:30]
  wire             _GEN_0 = dataArb__grant_T_1 & (_pstore_drain_opportunistic_T | _pstore_drain_opportunistic_T_1 | _pstore_drain_opportunistic_T_2 | _pstore_drain_opportunistic_T_28 | _pstore_drain_opportunistic_T_30 | _pstore_drain_opportunistic_T_31 | _pstore_drain_opportunistic_T_32 | _pstore_drain_opportunistic_T_33 | _pstore_drain_opportunistic_T_37 | _pstore_drain_opportunistic_T_38 | _pstore_drain_opportunistic_T_39 | _pstore_drain_opportunistic_T_40 | _pstore_drain_opportunistic_T_41);	// @[generators/rocket-chip/src/main/scala/rocket/Consts.scala:85:68, generators/rocket-chip/src/main/scala/rocket/DCache.scala:252:33, generators/rocket-chip/src/main/scala/util/package.scala:16:47, src/main/scala/chisel3/util/Arbiter.scala:45:68]
  reg              s1_did_read;	// @[generators/rocket-chip/src/main/scala/rocket/DCache.scala:253:30]
  assign metaArb_io_in_7_bits_idx = io_cpu_req_bits_addr[11:6];	// @[generators/rocket-chip/src/main/scala/rocket/DCache.scala:257:58]
  assign tag_array_MPORT_en = metaArb_io_out_valid & metaArb_io_out_bits_write;	// @[generators/rocket-chip/src/main/scala/rocket/DCache.scala:304:27, src/main/scala/chisel3/util/Arbiter.scala:139:26, :141:19, :148:31]
  assign tag_array_s1_meta_en = metaArb_io_out_valid & ~metaArb_io_out_bits_write;	// @[generators/rocket-chip/src/main/scala/rocket/DCache.scala:184:43, :308:59, src/main/scala/chisel3/util/Arbiter.scala:139:26, :141:19, :148:31]
  wire             _s1_meta_hit_state_T = _tag_array_RW0_rdata[19:0] == s1_tlb_req_vaddr[31:12];	// @[generators/rocket-chip/src/main/scala/rocket/DCache.scala:202:29, :292:99, :309:80, :311:83, generators/rocket-chip/src/main/scala/util/DescribedSRAM.scala:17:26]
  wire             _s1_meta_hit_state_T_4 = _tag_array_RW0_rdata[41:22] == s1_tlb_req_vaddr[31:12];	// @[generators/rocket-chip/src/main/scala/rocket/DCache.scala:202:29, :292:99, :309:80, :311:83, generators/rocket-chip/src/main/scala/util/DescribedSRAM.scala:17:26]
  wire [1:0]       s1_hit_way = {(|(_tag_array_RW0_rdata[43:42])) & _s1_meta_hit_state_T_4, (|(_tag_array_RW0_rdata[21:20])) & _s1_meta_hit_state_T};	// @[generators/rocket-chip/src/main/scala/rocket/DCache.scala:309:80, :311:{74,83}, generators/rocket-chip/src/main/scala/tilelink/Metadata.scala:50:45, generators/rocket-chip/src/main/scala/util/DescribedSRAM.scala:17:26, generators/rocket-chip/src/main/scala/util/package.scala:37:27]
  wire [1:0]       _s1_mask_xwr_T = {s1_vaddr[0] | (|s1_req_size), ~(s1_vaddr[0])};	// @[generators/rocket-chip/src/main/scala/rocket/AMOALU.scala:20:{27,42,53}, :21:22, :22:16, generators/rocket-chip/src/main/scala/rocket/DCache.scala:190:25]
  wire [3:0]       s1_mask_xwr = {(s1_vaddr[1] ? _s1_mask_xwr_T : 2'h0) | {2{s1_req_size[1]}}, s1_vaddr[1] ? 2'h0 : _s1_mask_xwr_T};	// @[generators/rocket-chip/src/main/scala/rocket/AMOALU.scala:20:{22,27,42,47,53}, :21:22, :22:16, generators/rocket-chip/src/main/scala/rocket/DCache.scala:94:20, :190:25, generators/rocket-chip/src/main/scala/rocket/HellaCache.scala:234:14]
  reg              s2_valid;	// @[generators/rocket-chip/src/main/scala/rocket/DCache.scala:325:25]
  wire             s2_valid_no_xcpt = s2_valid & {io_cpu_s2_xcpt_ma_ld_0, io_cpu_s2_xcpt_ma_st_0, io_cpu_s2_xcpt_pf_ld_0, io_cpu_s2_xcpt_pf_st_0, io_cpu_s2_xcpt_ae_ld_0, io_cpu_s2_xcpt_ae_st_0} == 6'h0;	// @[generators/rocket-chip/src/main/scala/rocket/DCache.scala:325:25, :326:{35,54,61}, :926:24, generators/rocket-chip/src/main/scala/rocket/TLB.scala:516:74]
  reg              s2_probe;	// @[generators/rocket-chip/src/main/scala/rocket/DCache.scala:327:25]
  wire             releaseInFlight = s1_probe | s2_probe | (|release_state);	// @[generators/rocket-chip/src/main/scala/rocket/DCache.scala:177:25, :222:30, :327:25, :328:{46,63}]
  reg              s2_not_nacked_in_s1;	// @[generators/rocket-chip/src/main/scala/rocket/DCache.scala:329:36]
  wire             s2_valid_masked = s2_valid_no_xcpt & s2_not_nacked_in_s1;	// @[generators/rocket-chip/src/main/scala/rocket/DCache.scala:326:35, :329:36, :331:42]
  reg  [5:0]       s2_req_tag;	// @[generators/rocket-chip/src/main/scala/rocket/DCache.scala:333:19]
  reg  [4:0]       s2_req_cmd;	// @[generators/rocket-chip/src/main/scala/rocket/DCache.scala:333:19]
  reg  [1:0]       s2_req_size;	// @[generators/rocket-chip/src/main/scala/rocket/DCache.scala:333:19]
  reg              s2_req_signed;	// @[generators/rocket-chip/src/main/scala/rocket/DCache.scala:333:19]
  reg  [1:0]       s2_req_dprv;	// @[generators/rocket-chip/src/main/scala/rocket/DCache.scala:333:19]
  reg              s2_req_dv;	// @[generators/rocket-chip/src/main/scala/rocket/DCache.scala:333:19]
  reg              s2_tlb_xcpt_pf_ld;	// @[generators/rocket-chip/src/main/scala/rocket/DCache.scala:336:24]
  reg              s2_tlb_xcpt_pf_st;	// @[generators/rocket-chip/src/main/scala/rocket/DCache.scala:336:24]
  reg              s2_tlb_xcpt_ae_ld;	// @[generators/rocket-chip/src/main/scala/rocket/DCache.scala:336:24]
  reg              s2_tlb_xcpt_ae_st;	// @[generators/rocket-chip/src/main/scala/rocket/DCache.scala:336:24]
  reg              s2_tlb_xcpt_ma_ld;	// @[generators/rocket-chip/src/main/scala/rocket/DCache.scala:336:24]
  reg              s2_tlb_xcpt_ma_st;	// @[generators/rocket-chip/src/main/scala/rocket/DCache.scala:336:24]
  reg              s2_pma_cacheable;	// @[generators/rocket-chip/src/main/scala/rocket/DCache.scala:337:19]
  reg  [31:0]      s2_uncached_resp_addr;	// @[generators/rocket-chip/src/main/scala/rocket/DCache.scala:338:34]
  reg  [31:0]      s2_vaddr_r;	// @[generators/rocket-chip/src/main/scala/rocket/DCache.scala:345:31]
  wire             s2_lr = s2_req_cmd == 5'h6;	// @[generators/rocket-chip/src/main/scala/rocket/DCache.scala:333:19, generators/rocket-chip/src/main/scala/util/package.scala:16:47]
  wire             s2_sc = s2_req_cmd == 5'h7;	// @[generators/rocket-chip/src/main/scala/rocket/DCache.scala:333:19, generators/rocket-chip/src/main/scala/util/package.scala:16:47]
  wire             _metaArb_io_in_3_bits_data_c_cat_T_28 = s2_req_cmd == 5'h4;	// @[generators/rocket-chip/src/main/scala/rocket/DCache.scala:333:19, generators/rocket-chip/src/main/scala/util/package.scala:16:47]
  wire             _metaArb_io_in_3_bits_data_c_cat_T_29 = s2_req_cmd == 5'h9;	// @[generators/rocket-chip/src/main/scala/rocket/DCache.scala:333:19, generators/rocket-chip/src/main/scala/util/package.scala:16:47]
  wire             _metaArb_io_in_3_bits_data_c_cat_T_30 = s2_req_cmd == 5'hA;	// @[generators/rocket-chip/src/main/scala/rocket/DCache.scala:333:19, generators/rocket-chip/src/main/scala/util/package.scala:16:47]
  wire             _metaArb_io_in_3_bits_data_c_cat_T_31 = s2_req_cmd == 5'hB;	// @[generators/rocket-chip/src/main/scala/rocket/DCache.scala:333:19, generators/rocket-chip/src/main/scala/util/package.scala:16:47]
  wire             _metaArb_io_in_3_bits_data_c_cat_T_35 = s2_req_cmd == 5'h8;	// @[generators/rocket-chip/src/main/scala/rocket/DCache.scala:333:19, generators/rocket-chip/src/main/scala/util/package.scala:16:47]
  wire             _metaArb_io_in_3_bits_data_c_cat_T_36 = s2_req_cmd == 5'hC;	// @[generators/rocket-chip/src/main/scala/rocket/DCache.scala:333:19, generators/rocket-chip/src/main/scala/util/package.scala:16:47]
  wire             _metaArb_io_in_3_bits_data_c_cat_T_37 = s2_req_cmd == 5'hD;	// @[generators/rocket-chip/src/main/scala/rocket/DCache.scala:333:19, generators/rocket-chip/src/main/scala/util/package.scala:16:47]
  wire             _metaArb_io_in_3_bits_data_c_cat_T_38 = s2_req_cmd == 5'hE;	// @[generators/rocket-chip/src/main/scala/rocket/DCache.scala:333:19, generators/rocket-chip/src/main/scala/util/package.scala:16:47]
  wire             _metaArb_io_in_3_bits_data_c_cat_T_39 = s2_req_cmd == 5'hF;	// @[generators/rocket-chip/src/main/scala/rocket/DCache.scala:333:19, generators/rocket-chip/src/main/scala/util/package.scala:16:47]
  wire             io_cpu_resp_bits_has_data_0 = s2_req_cmd == 5'h0 | s2_req_cmd == 5'h10 | s2_lr | s2_sc | _metaArb_io_in_3_bits_data_c_cat_T_28 | _metaArb_io_in_3_bits_data_c_cat_T_29 | _metaArb_io_in_3_bits_data_c_cat_T_30 | _metaArb_io_in_3_bits_data_c_cat_T_31 | _metaArb_io_in_3_bits_data_c_cat_T_35 | _metaArb_io_in_3_bits_data_c_cat_T_36 | _metaArb_io_in_3_bits_data_c_cat_T_37 | _metaArb_io_in_3_bits_data_c_cat_T_38 | _metaArb_io_in_3_bits_data_c_cat_T_39;	// @[generators/rocket-chip/src/main/scala/rocket/Consts.scala:85:68, generators/rocket-chip/src/main/scala/rocket/DCache.scala:94:20, :333:19, generators/rocket-chip/src/main/scala/util/package.scala:16:47]
  wire             _metaArb_io_in_3_bits_data_c_cat_T_23 = s2_req_cmd == 5'h1;	// @[generators/rocket-chip/src/main/scala/rocket/Consts.scala:86:32, generators/rocket-chip/src/main/scala/rocket/DCache.scala:333:19, generators/rocket-chip/src/main/scala/rocket/TLB.scala:546:69]
  wire             _metaArb_io_in_3_bits_data_c_cat_T_24 = s2_req_cmd == 5'h11;	// @[generators/rocket-chip/src/main/scala/rocket/Consts.scala:86:49, generators/rocket-chip/src/main/scala/rocket/DCache.scala:333:19, generators/rocket-chip/src/main/scala/rocket/TLB.scala:569:41]
  wire             s2_write = _metaArb_io_in_3_bits_data_c_cat_T_23 | _metaArb_io_in_3_bits_data_c_cat_T_24 | s2_sc | _metaArb_io_in_3_bits_data_c_cat_T_28 | _metaArb_io_in_3_bits_data_c_cat_T_29 | _metaArb_io_in_3_bits_data_c_cat_T_30 | _metaArb_io_in_3_bits_data_c_cat_T_31 | _metaArb_io_in_3_bits_data_c_cat_T_35 | _metaArb_io_in_3_bits_data_c_cat_T_36 | _metaArb_io_in_3_bits_data_c_cat_T_37 | _metaArb_io_in_3_bits_data_c_cat_T_38 | _metaArb_io_in_3_bits_data_c_cat_T_39;	// @[generators/rocket-chip/src/main/scala/rocket/Consts.scala:86:{32,49,76}, generators/rocket-chip/src/main/scala/util/package.scala:16:47]
  wire             s2_readwrite = io_cpu_resp_bits_has_data_0 | s2_write;	// @[generators/rocket-chip/src/main/scala/rocket/Consts.scala:85:68, :86:76, generators/rocket-chip/src/main/scala/rocket/DCache.scala:348:30]
  reg              s2_flush_valid_pre_tag_ecc;	// @[generators/rocket-chip/src/main/scala/rocket/DCache.scala:349:43]
  reg  [21:0]      s2_meta_corrected_r;	// @[generators/rocket-chip/src/main/scala/rocket/DCache.scala:355:61]
  reg  [21:0]      s2_meta_corrected_r_1;	// @[generators/rocket-chip/src/main/scala/rocket/DCache.scala:355:61]
  reg  [31:0]      s2_data;	// @[generators/rocket-chip/src/main/scala/rocket/DCache.scala:373:18]
  reg  [1:0]       s2_probe_way;	// @[generators/rocket-chip/src/main/scala/rocket/DCache.scala:377:31]
  reg  [1:0]       s2_probe_state_state;	// @[generators/rocket-chip/src/main/scala/rocket/DCache.scala:378:33]
  reg  [1:0]       s2_hit_way;	// @[generators/rocket-chip/src/main/scala/rocket/DCache.scala:379:29]
  reg  [1:0]       s2_hit_state_state;	// @[generators/rocket-chip/src/main/scala/rocket/DCache.scala:380:31]
  wire             _metaArb_io_in_3_bits_data_c_cat_T_46 = s2_req_cmd == 5'h3;	// @[generators/rocket-chip/src/main/scala/rocket/Consts.scala:87:54, generators/rocket-chip/src/main/scala/rocket/DCache.scala:333:19, generators/rocket-chip/src/main/scala/util/package.scala:16:47]
  wire [3:0]       _GEN_1 = {_metaArb_io_in_3_bits_data_c_cat_T_23 | _metaArb_io_in_3_bits_data_c_cat_T_24 | s2_sc | _metaArb_io_in_3_bits_data_c_cat_T_28 | _metaArb_io_in_3_bits_data_c_cat_T_29 | _metaArb_io_in_3_bits_data_c_cat_T_30 | _metaArb_io_in_3_bits_data_c_cat_T_31 | _metaArb_io_in_3_bits_data_c_cat_T_35 | _metaArb_io_in_3_bits_data_c_cat_T_36 | _metaArb_io_in_3_bits_data_c_cat_T_37 | _metaArb_io_in_3_bits_data_c_cat_T_38 | _metaArb_io_in_3_bits_data_c_cat_T_39, _metaArb_io_in_3_bits_data_c_cat_T_23 | _metaArb_io_in_3_bits_data_c_cat_T_24 | s2_sc | _metaArb_io_in_3_bits_data_c_cat_T_28 | _metaArb_io_in_3_bits_data_c_cat_T_29 | _metaArb_io_in_3_bits_data_c_cat_T_30 | _metaArb_io_in_3_bits_data_c_cat_T_31 | _metaArb_io_in_3_bits_data_c_cat_T_35 | _metaArb_io_in_3_bits_data_c_cat_T_36 | _metaArb_io_in_3_bits_data_c_cat_T_37 | _metaArb_io_in_3_bits_data_c_cat_T_38 | _metaArb_io_in_3_bits_data_c_cat_T_39 | _metaArb_io_in_3_bits_data_c_cat_T_46 | s2_lr, s2_hit_state_state};	// @[generators/rocket-chip/src/main/scala/rocket/Consts.scala:86:{32,49,76}, :87:{54,64}, generators/rocket-chip/src/main/scala/rocket/DCache.scala:380:31, generators/rocket-chip/src/main/scala/tilelink/Metadata.scala:58:19, generators/rocket-chip/src/main/scala/util/package.scala:16:47]
  wire [1:0]       _GEN_2 = {1'h0, _GEN_1 == 4'hC};	// @[generators/rocket-chip/src/main/scala/rocket/DCache.scala:269:27, :282:26, :1007:122, generators/rocket-chip/src/main/scala/rocket/HellaCache.scala:234:14, generators/rocket-chip/src/main/scala/tilelink/Metadata.scala:58:19, generators/rocket-chip/src/main/scala/util/Misc.scala:35:36, :49:20, generators/rocket-chip/src/main/scala/util/package.scala:16:47]
  wire             s2_hit = _GEN_1 == 4'h3 | _GEN_1 == 4'h2 | _GEN_1 == 4'h1 | _GEN_1 == 4'h7 | _GEN_1 == 4'h6 | (&_GEN_1) | _GEN_1 == 4'hE;	// @[generators/rocket-chip/src/main/scala/rocket/DCache.scala:827:29, generators/rocket-chip/src/main/scala/tilelink/Metadata.scala:58:19, generators/rocket-chip/src/main/scala/util/Misc.scala:35:9, :49:20, generators/rocket-chip/src/main/scala/util/package.scala:16:47]
  wire [15:0][1:0] _GEN_3 = {{2'h3}, {2'h3}, {2'h2}, {_GEN_2}, {_GEN_2}, {_GEN_2}, {_GEN_2}, {_GEN_2}, {2'h3}, {2'h2}, {2'h2}, {2'h1}, {2'h3}, {2'h2}, {2'h1}, {2'h0}};	// @[generators/rocket-chip/src/main/scala/rocket/DCache.scala:94:20, generators/rocket-chip/src/main/scala/rocket/HellaCache.scala:234:14, generators/rocket-chip/src/main/scala/rocket/TLB.scala:474:82, generators/rocket-chip/src/main/scala/util/Misc.scala:35:36, :49:20, generators/rocket-chip/src/main/scala/util/package.scala:16:47]
  wire             s2_valid_hit_maybe_flush_pre_data_ecc_and_waw = s2_valid_masked & s2_hit;	// @[generators/rocket-chip/src/main/scala/rocket/DCache.scala:331:42, :391:89, generators/rocket-chip/src/main/scala/util/Misc.scala:35:9]
  wire             s2_valid_hit_pre_data_ecc_and_waw = s2_valid_hit_maybe_flush_pre_data_ecc_and_waw & s2_readwrite;	// @[generators/rocket-chip/src/main/scala/rocket/DCache.scala:348:30, :391:89, :412:89]
  wire             s2_valid_flush_line = s2_valid_hit_maybe_flush_pre_data_ecc_and_waw & s2_req_cmd == 5'h5 & s2_req_size[0];	// @[generators/rocket-chip/src/main/scala/rocket/DCache.scala:333:19, :334:{37,68}, :391:89, :413:75, generators/rocket-chip/src/main/scala/util/package.scala:16:47]
  wire             s2_valid_miss = s2_valid_masked & s2_readwrite & ~s2_hit;	// @[generators/rocket-chip/src/main/scala/rocket/DCache.scala:331:42, :348:30, :417:{73,76}, generators/rocket-chip/src/main/scala/util/Misc.scala:35:9]
  wire             s2_valid_cached_miss = s2_valid_miss & s2_pma_cacheable & ~uncachedInFlight_0;	// @[generators/rocket-chip/src/main/scala/rocket/DCache.scala:230:33, :337:19, :417:73, :419:{60,63}]
  wire             s2_want_victimize = s2_valid_cached_miss | s2_valid_flush_line | s2_flush_valid_pre_tag_ecc;	// @[generators/rocket-chip/src/main/scala/rocket/DCache.scala:349:43, :413:75, :419:60, :421:123]
  wire             s2_valid_uncached_pending = s2_valid_miss & ~s2_pma_cacheable & ~uncachedInFlight_0;	// @[generators/rocket-chip/src/main/scala/rocket/DCache.scala:230:33, :337:19, :417:73, :418:21, :424:{64,67}]
  reg              s2_victim_way_r;	// @[generators/rocket-chip/src/main/scala/rocket/DCache.scala:425:41]
  assign metaArb_io_in_2_bits_way_en = (|s2_hit_state_state) ? s2_hit_way : 2'h1 << s2_victim_way_r;	// @[generators/rocket-chip/src/main/scala/rocket/DCache.scala:379:29, :380:31, :425:41, :426:33, generators/rocket-chip/src/main/scala/tilelink/Metadata.scala:50:45, generators/rocket-chip/src/main/scala/util/package.scala:16:47, src/main/scala/chisel3/util/OneHot.scala:58:35]
  wire [1:0]       s2_victim_state_state = (|s2_hit_state_state) ? s2_hit_state_state : (s2_victim_way_r ? 2'h0 : s2_meta_corrected_r[21:20]) | (s2_victim_way_r ? s2_meta_corrected_r_1[21:20] : 2'h0);	// @[generators/rocket-chip/src/main/scala/rocket/DCache.scala:94:20, :355:{61,99}, :380:31, :425:41, :428:28, generators/rocket-chip/src/main/scala/rocket/HellaCache.scala:234:14, generators/rocket-chip/src/main/scala/tilelink/Metadata.scala:50:45, src/main/scala/chisel3/util/Mux.scala:30:73]
  wire [3:0]       _GEN_4 = {probe_bits_param, s2_probe_state_state};	// @[generators/rocket-chip/src/main/scala/rocket/DCache.scala:178:29, :378:33, generators/rocket-chip/src/main/scala/tilelink/Metadata.scala:120:19]
  wire             _GEN_5 = _GEN_4 == 4'hB;	// @[generators/rocket-chip/src/main/scala/tilelink/Metadata.scala:120:19, generators/rocket-chip/src/main/scala/util/Misc.scala:56:20, generators/rocket-chip/src/main/scala/util/package.scala:16:47]
  wire             _GEN_6 = _GEN_4 == 4'h4;	// @[generators/rocket-chip/src/main/scala/rocket/DCache.scala:821:23, generators/rocket-chip/src/main/scala/tilelink/Metadata.scala:120:19, generators/rocket-chip/src/main/scala/util/Misc.scala:56:20]
  wire             _GEN_7 = _GEN_4 == 4'h5;	// @[generators/rocket-chip/src/main/scala/rocket/DCache.scala:831:29, generators/rocket-chip/src/main/scala/tilelink/Metadata.scala:120:19, generators/rocket-chip/src/main/scala/util/Misc.scala:56:20]
  wire             _GEN_8 = _GEN_4 == 4'h6;	// @[generators/rocket-chip/src/main/scala/tilelink/Metadata.scala:120:19, generators/rocket-chip/src/main/scala/util/Misc.scala:56:20, generators/rocket-chip/src/main/scala/util/package.scala:16:47]
  wire             _GEN_9 = _GEN_4 == 4'h7;	// @[generators/rocket-chip/src/main/scala/rocket/DCache.scala:827:29, generators/rocket-chip/src/main/scala/tilelink/Metadata.scala:120:19, generators/rocket-chip/src/main/scala/util/Misc.scala:56:20]
  wire             _GEN_10 = _GEN_4 == 4'h0;	// @[generators/rocket-chip/src/main/scala/rocket/HellaCache.scala:234:14, generators/rocket-chip/src/main/scala/tilelink/Metadata.scala:120:19, generators/rocket-chip/src/main/scala/util/Misc.scala:56:20]
  wire             _GEN_11 = _GEN_4 == 4'h1;	// @[generators/rocket-chip/src/main/scala/tilelink/Metadata.scala:120:19, generators/rocket-chip/src/main/scala/util/Misc.scala:56:20, generators/rocket-chip/src/main/scala/util/package.scala:16:47]
  wire             _GEN_12 = _GEN_4 == 4'h2;	// @[generators/rocket-chip/src/main/scala/tilelink/Metadata.scala:120:19, generators/rocket-chip/src/main/scala/util/Misc.scala:56:20, generators/rocket-chip/src/main/scala/util/package.scala:16:47]
  wire             _GEN_13 = _GEN_4 == 4'h3;	// @[generators/rocket-chip/src/main/scala/rocket/DCache.scala:827:29, generators/rocket-chip/src/main/scala/tilelink/Metadata.scala:120:19, generators/rocket-chip/src/main/scala/util/Misc.scala:56:20]
  wire             s2_prb_ack_data = _GEN_13 | ~(_GEN_12 | _GEN_11 | _GEN_10) & (_GEN_9 | ~(_GEN_8 | _GEN_7 | _GEN_6) & _GEN_5);	// @[generators/rocket-chip/src/main/scala/util/Misc.scala:38:9, :56:20]
  wire             _GEN_14 = _GEN_13 | _GEN_12;	// @[generators/rocket-chip/src/main/scala/util/Misc.scala:38:36, :56:20]
  wire             s2_victim_dirty = &s2_victim_state_state;	// @[generators/rocket-chip/src/main/scala/rocket/DCache.scala:428:28, generators/rocket-chip/src/main/scala/util/Misc.scala:38:9, :56:20]
  wire             io_cpu_s2_nack_0 = s2_valid_no_xcpt & ~(s2_valid_uncached_pending & auto_out_a_ready) & ~(s2_valid_masked & s2_req_cmd == 5'h17) & ~s2_valid_hit_pre_data_ecc_and_waw;	// @[generators/rocket-chip/src/main/scala/rocket/DCache.scala:326:35, :331:42, :333:19, :412:89, :424:64, :434:57, :435:61, :438:17, :439:{41,67,86,89}, generators/rocket-chip/src/main/scala/util/package.scala:16:47]
  assign metaArb_io_in_2_valid = s2_valid_hit_pre_data_ecc_and_waw & s2_hit_state_state != _GEN_3[_GEN_1];	// @[generators/rocket-chip/src/main/scala/rocket/DCache.scala:380:31, :412:89, :440:62, generators/rocket-chip/src/main/scala/tilelink/Metadata.scala:46:46, :58:19, generators/rocket-chip/src/main/scala/util/Misc.scala:35:36, :49:20]
  wire             _GEN_15 = io_cpu_s2_nack_0 | metaArb_io_in_2_valid;	// @[generators/rocket-chip/src/main/scala/rocket/DCache.scala:439:86, :440:{24,62}]
  assign metaArb_io_in_4_bits_idx = probe_bits_address[11:6];	// @[generators/rocket-chip/src/main/scala/rocket/DCache.scala:178:29, :1193:47]
  assign metaArb_io_in_3_bits_idx = s2_req_addr[11:6];	// @[generators/rocket-chip/src/main/scala/rocket/DCache.scala:333:19, :447:76]
  assign metaArb_io_in_2_bits_data = {_GEN_3[_GEN_1], s2_req_addr[31:12]};	// @[generators/rocket-chip/src/main/scala/rocket/DCache.scala:333:19, :461:{68,97}, generators/rocket-chip/src/main/scala/tilelink/Metadata.scala:58:19, generators/rocket-chip/src/main/scala/util/Misc.scala:35:36, :49:20]
  reg  [6:0]       lrscCount;	// @[generators/rocket-chip/src/main/scala/rocket/DCache.scala:466:26]
  reg  [25:0]      lrscAddr;	// @[generators/rocket-chip/src/main/scala/rocket/DCache.scala:469:21]
  wire             s2_sc_fail = s2_sc & ~((|(lrscCount[6:2])) & lrscAddr == s2_req_addr[31:6]);	// @[generators/rocket-chip/src/main/scala/rocket/DCache.scala:333:19, :466:26, :467:29, :469:21, :470:{32,49}, :471:{26,29,41}, generators/rocket-chip/src/main/scala/util/package.scala:16:47]
  reg  [4:0]       pstore1_cmd;	// @[generators/rocket-chip/src/main/scala/rocket/DCache.scala:486:30]
  reg  [31:0]      pstore1_addr;	// @[generators/rocket-chip/src/main/scala/rocket/DCache.scala:487:31]
  reg  [31:0]      pstore1_data;	// @[generators/rocket-chip/src/main/scala/rocket/DCache.scala:488:31]
  reg  [1:0]       pstore1_way;	// @[generators/rocket-chip/src/main/scala/rocket/DCache.scala:489:30]
  reg  [3:0]       pstore1_mask;	// @[generators/rocket-chip/src/main/scala/rocket/DCache.scala:490:31]
  reg              pstore1_rmw;	// @[generators/rocket-chip/src/main/scala/rocket/DCache.scala:492:44]
  wire             _pstore1_held_T = s2_valid_hit_pre_data_ecc_and_waw & s2_write;	// @[generators/rocket-chip/src/main/scala/rocket/Consts.scala:86:76, generators/rocket-chip/src/main/scala/rocket/DCache.scala:412:89, :484:46]
  reg              pstore2_valid;	// @[generators/rocket-chip/src/main/scala/rocket/DCache.scala:495:30]
  wire             _pstore_drain_opportunistic_res_T_2 = _pstore_drain_opportunistic_T_25 | _pstore_drain_opportunistic_res_T_1;	// @[generators/rocket-chip/src/main/scala/util/package.scala:16:47, :73:59]
  reg              pstore_drain_on_miss_REG;	// @[generators/rocket-chip/src/main/scala/rocket/DCache.scala:497:56]
  reg              pstore1_held;	// @[generators/rocket-chip/src/main/scala/rocket/DCache.scala:498:29]
  wire             pstore1_valid_likely = s2_valid & s2_write | pstore1_held;	// @[generators/rocket-chip/src/main/scala/rocket/Consts.scala:86:76, generators/rocket-chip/src/main/scala/rocket/DCache.scala:325:25, :498:29, :499:{39,51}]
  wire             pstore1_valid = _pstore1_held_T & ~s2_sc_fail | pstore1_held;	// @[generators/rocket-chip/src/main/scala/rocket/DCache.scala:471:26, :484:{46,58,61}, :498:29, :501:38]
  wire             pstore_drain_structural = pstore1_valid_likely & pstore2_valid & (s1_valid & s1_write | pstore1_rmw);	// @[generators/rocket-chip/src/main/scala/rocket/Consts.scala:86:76, generators/rocket-chip/src/main/scala/rocket/DCache.scala:176:25, :492:44, :495:30, :499:51, :503:{71,85,98}]
  wire             _dataArb_io_in_0_valid_T_4 = s2_valid_hit_pre_data_ecc_and_waw & s2_write;	// @[generators/rocket-chip/src/main/scala/rocket/Consts.scala:86:76, generators/rocket-chip/src/main/scala/rocket/DCache.scala:412:89, :500:72]
  wire             _dataArb_io_in_0_valid_T_9 = ~(io_cpu_req_valid & ~_pstore_drain_opportunistic_res_T_2) | releaseInFlight | pstore_drain_on_miss_REG;	// @[generators/rocket-chip/src/main/scala/rocket/DCache.scala:328:46, :496:{36,55}, :497:56, :512:107, :1178:15, generators/rocket-chip/src/main/scala/util/package.scala:73:59]
  assign dataArb_io_in_0_bits_write = pstore_drain_structural | ((_dataArb_io_in_0_valid_T_4 | pstore1_held) & ~pstore1_rmw | pstore2_valid) & _dataArb_io_in_0_valid_T_9;	// @[generators/rocket-chip/src/main/scala/rocket/DCache.scala:492:44, :495:30, :498:29, :500:{72,96}, :503:71, :511:44, :512:{41,44,58,76,107}]
  reg  [31:0]      pstore2_addr;	// @[generators/rocket-chip/src/main/scala/rocket/DCache.scala:518:31]
  reg  [1:0]       pstore2_way;	// @[generators/rocket-chip/src/main/scala/rocket/DCache.scala:519:30]
  reg  [7:0]       pstore2_storegen_data_r;	// @[generators/rocket-chip/src/main/scala/rocket/DCache.scala:522:22]
  reg  [7:0]       pstore2_storegen_data_r_1;	// @[generators/rocket-chip/src/main/scala/rocket/DCache.scala:522:22]
  reg  [7:0]       pstore2_storegen_data_r_2;	// @[generators/rocket-chip/src/main/scala/rocket/DCache.scala:522:22]
  reg  [7:0]       pstore2_storegen_data_r_3;	// @[generators/rocket-chip/src/main/scala/rocket/DCache.scala:522:22]
  reg  [3:0]       pstore2_storegen_mask;	// @[generators/rocket-chip/src/main/scala/rocket/DCache.scala:525:19]
  assign dataArb_io_in_0_valid = pstore_drain_structural | ((_dataArb_io_in_0_valid_T_4 | pstore1_held) & ~pstore1_rmw | pstore2_valid) & _dataArb_io_in_0_valid_T_9;	// @[generators/rocket-chip/src/main/scala/rocket/DCache.scala:492:44, :495:30, :498:29, :500:{72,96}, :503:71, :511:44, :512:{41,44,58,76,107}]
  assign _dataArb_io_in_0_bits_wordMask_wordMask_T = pstore2_valid ? pstore2_addr[11:0] : pstore1_addr[11:0];	// @[generators/rocket-chip/src/main/scala/rocket/DCache.scala:487:31, :495:30, :518:31, :543:36]
  assign dataArb_io_in_0_bits_way_en = pstore2_valid ? pstore2_way : pstore1_way;	// @[generators/rocket-chip/src/main/scala/rocket/DCache.scala:489:30, :495:30, :519:30, :544:38]
  assign dataArb_io_in_0_bits_wdata = pstore2_valid ? {pstore2_storegen_data_r_3, pstore2_storegen_data_r_2, pstore2_storegen_data_r_1, pstore2_storegen_data_r} : pstore1_data;	// @[generators/rocket-chip/src/main/scala/rocket/DCache.scala:488:31, :495:30, :522:22, :545:63, generators/rocket-chip/src/main/scala/util/package.scala:37:27]
  assign dataArb_io_in_0_bits_eccMask = pstore2_valid ? pstore2_storegen_mask : pstore1_mask;	// @[generators/rocket-chip/src/main/scala/rocket/DCache.scala:490:31, :495:30, :525:19, :551:47]
  wire             _GEN_16 = s1_valid & s1_read & (pstore1_valid_likely & pstore1_addr[11:2] == s1_vaddr[11:2] & (s1_write ? (|(pstore1_mask & s1_mask_xwr)) : (|(pstore1_mask & s1_mask_xwr))) | pstore2_valid & pstore2_addr[11:2] == s1_vaddr[11:2] & (s1_write ? (|(pstore2_storegen_mask & s1_mask_xwr)) : (|(pstore2_storegen_mask & s1_mask_xwr))));	// @[generators/rocket-chip/src/main/scala/rocket/AMOALU.scala:22:16, generators/rocket-chip/src/main/scala/rocket/Consts.scala:85:68, :86:76, generators/rocket-chip/src/main/scala/rocket/DCache.scala:176:25, :190:25, :487:31, :490:31, :495:30, :499:51, :518:31, :525:19, :555:{9,31,43}, :556:{8,38,66,77,92}, :558:{27,69}, :559:21, :565:18]
  wire             get_a_mask_acc = s2_req_size[1] | s2_req_size[0] & ~(s2_req_addr[1]);	// @[generators/rocket-chip/src/main/scala/rocket/DCache.scala:333:19, generators/rocket-chip/src/main/scala/util/Misc.scala:206:21, :210:26, :211:20, :215:{29,38}, src/main/scala/chisel3/util/OneHot.scala:64:49]
  wire             get_a_mask_acc_1 = s2_req_size[1] | s2_req_size[0] & s2_req_addr[1];	// @[generators/rocket-chip/src/main/scala/rocket/DCache.scala:333:19, generators/rocket-chip/src/main/scala/util/Misc.scala:206:21, :210:26, :215:{29,38}, src/main/scala/chisel3/util/OneHot.scala:64:49]
  wire             put_a_mask_acc = s2_req_size[1] | s2_req_size[0] & ~(s2_req_addr[1]);	// @[generators/rocket-chip/src/main/scala/rocket/DCache.scala:333:19, generators/rocket-chip/src/main/scala/util/Misc.scala:206:21, :210:26, :211:20, :215:{29,38}, src/main/scala/chisel3/util/OneHot.scala:64:49]
  wire             put_a_mask_acc_1 = s2_req_size[1] | s2_req_size[0] & s2_req_addr[1];	// @[generators/rocket-chip/src/main/scala/rocket/DCache.scala:333:19, generators/rocket-chip/src/main/scala/util/Misc.scala:206:21, :210:26, :215:{29,38}, src/main/scala/chisel3/util/OneHot.scala:64:49]
  wire             atomics_a_mask_acc = s2_req_size[1] | s2_req_size[0] & ~(s2_req_addr[1]);	// @[generators/rocket-chip/src/main/scala/rocket/DCache.scala:333:19, generators/rocket-chip/src/main/scala/util/Misc.scala:206:21, :210:26, :211:20, :215:{29,38}, src/main/scala/chisel3/util/OneHot.scala:64:49]
  wire             atomics_a_mask_acc_1 = s2_req_size[1] | s2_req_size[0] & s2_req_addr[1];	// @[generators/rocket-chip/src/main/scala/rocket/DCache.scala:333:19, generators/rocket-chip/src/main/scala/util/Misc.scala:206:21, :210:26, :215:{29,38}, src/main/scala/chisel3/util/OneHot.scala:64:49]
  wire             atomics_a_mask_acc_6 = s2_req_size[1] | s2_req_size[0] & ~(s2_req_addr[1]);	// @[generators/rocket-chip/src/main/scala/rocket/DCache.scala:333:19, generators/rocket-chip/src/main/scala/util/Misc.scala:206:21, :210:26, :211:20, :215:{29,38}, src/main/scala/chisel3/util/OneHot.scala:64:49]
  wire             atomics_a_mask_acc_7 = s2_req_size[1] | s2_req_size[0] & s2_req_addr[1];	// @[generators/rocket-chip/src/main/scala/rocket/DCache.scala:333:19, generators/rocket-chip/src/main/scala/util/Misc.scala:206:21, :210:26, :215:{29,38}, src/main/scala/chisel3/util/OneHot.scala:64:49]
  wire             atomics_a_mask_acc_12 = s2_req_size[1] | s2_req_size[0] & ~(s2_req_addr[1]);	// @[generators/rocket-chip/src/main/scala/rocket/DCache.scala:333:19, generators/rocket-chip/src/main/scala/util/Misc.scala:206:21, :210:26, :211:20, :215:{29,38}, src/main/scala/chisel3/util/OneHot.scala:64:49]
  wire             atomics_a_mask_acc_13 = s2_req_size[1] | s2_req_size[0] & s2_req_addr[1];	// @[generators/rocket-chip/src/main/scala/rocket/DCache.scala:333:19, generators/rocket-chip/src/main/scala/util/Misc.scala:206:21, :210:26, :215:{29,38}, src/main/scala/chisel3/util/OneHot.scala:64:49]
  wire             atomics_a_mask_acc_18 = s2_req_size[1] | s2_req_size[0] & ~(s2_req_addr[1]);	// @[generators/rocket-chip/src/main/scala/rocket/DCache.scala:333:19, generators/rocket-chip/src/main/scala/util/Misc.scala:206:21, :210:26, :211:20, :215:{29,38}, src/main/scala/chisel3/util/OneHot.scala:64:49]
  wire             atomics_a_mask_acc_19 = s2_req_size[1] | s2_req_size[0] & s2_req_addr[1];	// @[generators/rocket-chip/src/main/scala/rocket/DCache.scala:333:19, generators/rocket-chip/src/main/scala/util/Misc.scala:206:21, :210:26, :215:{29,38}, src/main/scala/chisel3/util/OneHot.scala:64:49]
  wire             atomics_a_mask_acc_24 = s2_req_size[1] | s2_req_size[0] & ~(s2_req_addr[1]);	// @[generators/rocket-chip/src/main/scala/rocket/DCache.scala:333:19, generators/rocket-chip/src/main/scala/util/Misc.scala:206:21, :210:26, :211:20, :215:{29,38}, src/main/scala/chisel3/util/OneHot.scala:64:49]
  wire             atomics_a_mask_acc_25 = s2_req_size[1] | s2_req_size[0] & s2_req_addr[1];	// @[generators/rocket-chip/src/main/scala/rocket/DCache.scala:333:19, generators/rocket-chip/src/main/scala/util/Misc.scala:206:21, :210:26, :215:{29,38}, src/main/scala/chisel3/util/OneHot.scala:64:49]
  wire             atomics_a_mask_acc_30 = s2_req_size[1] | s2_req_size[0] & ~(s2_req_addr[1]);	// @[generators/rocket-chip/src/main/scala/rocket/DCache.scala:333:19, generators/rocket-chip/src/main/scala/util/Misc.scala:206:21, :210:26, :211:20, :215:{29,38}, src/main/scala/chisel3/util/OneHot.scala:64:49]
  wire             atomics_a_mask_acc_31 = s2_req_size[1] | s2_req_size[0] & s2_req_addr[1];	// @[generators/rocket-chip/src/main/scala/rocket/DCache.scala:333:19, generators/rocket-chip/src/main/scala/util/Misc.scala:206:21, :210:26, :215:{29,38}, src/main/scala/chisel3/util/OneHot.scala:64:49]
  wire             atomics_a_mask_acc_36 = s2_req_size[1] | s2_req_size[0] & ~(s2_req_addr[1]);	// @[generators/rocket-chip/src/main/scala/rocket/DCache.scala:333:19, generators/rocket-chip/src/main/scala/util/Misc.scala:206:21, :210:26, :211:20, :215:{29,38}, src/main/scala/chisel3/util/OneHot.scala:64:49]
  wire             atomics_a_mask_acc_37 = s2_req_size[1] | s2_req_size[0] & s2_req_addr[1];	// @[generators/rocket-chip/src/main/scala/rocket/DCache.scala:333:19, generators/rocket-chip/src/main/scala/util/Misc.scala:206:21, :210:26, :215:{29,38}, src/main/scala/chisel3/util/OneHot.scala:64:49]
  wire             atomics_a_mask_acc_42 = s2_req_size[1] | s2_req_size[0] & ~(s2_req_addr[1]);	// @[generators/rocket-chip/src/main/scala/rocket/DCache.scala:333:19, generators/rocket-chip/src/main/scala/util/Misc.scala:206:21, :210:26, :211:20, :215:{29,38}, src/main/scala/chisel3/util/OneHot.scala:64:49]
  wire             atomics_a_mask_acc_43 = s2_req_size[1] | s2_req_size[0] & s2_req_addr[1];	// @[generators/rocket-chip/src/main/scala/rocket/DCache.scala:333:19, generators/rocket-chip/src/main/scala/util/Misc.scala:206:21, :210:26, :215:{29,38}, src/main/scala/chisel3/util/OneHot.scala:64:49]
  wire             atomics_a_mask_acc_48 = s2_req_size[1] | s2_req_size[0] & ~(s2_req_addr[1]);	// @[generators/rocket-chip/src/main/scala/rocket/DCache.scala:333:19, generators/rocket-chip/src/main/scala/util/Misc.scala:206:21, :210:26, :211:20, :215:{29,38}, src/main/scala/chisel3/util/OneHot.scala:64:49]
  wire             atomics_a_mask_acc_49 = s2_req_size[1] | s2_req_size[0] & s2_req_addr[1];	// @[generators/rocket-chip/src/main/scala/rocket/DCache.scala:333:19, generators/rocket-chip/src/main/scala/util/Misc.scala:206:21, :210:26, :215:{29,38}, src/main/scala/chisel3/util/OneHot.scala:64:49]
  wire             _atomics_T = s2_req_cmd == 5'h4;	// @[generators/rocket-chip/src/main/scala/rocket/DCache.scala:333:19, :581:81, generators/rocket-chip/src/main/scala/util/package.scala:16:47]
  wire             _atomics_T_2 = s2_req_cmd == 5'h9;	// @[generators/rocket-chip/src/main/scala/rocket/DCache.scala:333:19, :581:81, generators/rocket-chip/src/main/scala/util/package.scala:16:47]
  wire             _atomics_T_4 = s2_req_cmd == 5'hA;	// @[generators/rocket-chip/src/main/scala/rocket/DCache.scala:333:19, :581:81, generators/rocket-chip/src/main/scala/util/package.scala:16:47]
  wire             _atomics_T_6 = s2_req_cmd == 5'hB;	// @[generators/rocket-chip/src/main/scala/rocket/DCache.scala:333:19, :581:81, generators/rocket-chip/src/main/scala/util/package.scala:16:47]
  wire             _atomics_T_8 = s2_req_cmd == 5'h8;	// @[generators/rocket-chip/src/main/scala/rocket/DCache.scala:333:19, :581:81, generators/rocket-chip/src/main/scala/util/package.scala:16:47]
  wire             _atomics_T_10 = s2_req_cmd == 5'hC;	// @[generators/rocket-chip/src/main/scala/rocket/DCache.scala:333:19, :581:81, generators/rocket-chip/src/main/scala/util/package.scala:16:47]
  wire             _atomics_T_12 = s2_req_cmd == 5'hD;	// @[generators/rocket-chip/src/main/scala/rocket/DCache.scala:333:19, :581:81, generators/rocket-chip/src/main/scala/util/package.scala:16:47]
  wire             _atomics_T_14 = s2_req_cmd == 5'hE;	// @[generators/rocket-chip/src/main/scala/rocket/DCache.scala:333:19, :581:81, generators/rocket-chip/src/main/scala/util/package.scala:16:47]
  wire             _atomics_T_16 = s2_req_cmd == 5'hF;	// @[generators/rocket-chip/src/main/scala/rocket/DCache.scala:333:19, :581:81, generators/rocket-chip/src/main/scala/util/package.scala:16:47]
  wire             nodeOut_a_deq_valid = s2_valid_uncached_pending | s2_valid_cached_miss & ~(release_ack_wait & (s2_req_addr[21:6] ^ release_ack_addr[21:6]) == 16'h0) & ~s2_victim_dirty;	// @[generators/rocket-chip/src/main/scala/rocket/AMOALU.scala:45:49, generators/rocket-chip/src/main/scala/rocket/DCache.scala:220:33, :221:29, :333:19, :419:60, :424:64, :598:32, :600:{8,27,43,118,127}, :601:91, generators/rocket-chip/src/main/scala/util/Misc.scala:38:9]
  wire             _GEN_17 = ~s2_write | _metaArb_io_in_3_bits_data_c_cat_T_24 | ~io_cpu_resp_bits_has_data_0 | _atomics_T_16 | _atomics_T_14 | _atomics_T_12 | _atomics_T_10 | _atomics_T_8 | _atomics_T_6 | _atomics_T_4 | _atomics_T_2 | _atomics_T;	// @[generators/rocket-chip/src/main/scala/rocket/Consts.scala:85:68, :86:{49,76}, generators/rocket-chip/src/main/scala/rocket/DCache.scala:581:81, :603:8, :605:8]
  wire             _io_errors_bus_valid_T = nodeOut_d_ready & auto_out_d_valid;	// @[generators/rocket-chip/src/main/scala/rocket/DCache.scala:665:18, :716:51, :718:20, :746:68, :747:22, src/main/scala/chisel3/util/Decoupled.scala:52:35]
  wire [12:0]      _beats1_decode_T_1 = 13'h3F << auto_out_d_bits_size;	// @[generators/rocket-chip/src/main/scala/util/package.scala:235:71]
  wire [3:0]       beats1 = auto_out_d_bits_opcode[0] ? ~(_beats1_decode_T_1[5:2]) : 4'h0;	// @[generators/rocket-chip/src/main/scala/rocket/HellaCache.scala:234:14, generators/rocket-chip/src/main/scala/tilelink/Edges.scala:106:36, :221:14, generators/rocket-chip/src/main/scala/util/package.scala:235:{46,71,76}]
  reg  [3:0]       counter;	// @[generators/rocket-chip/src/main/scala/tilelink/Edges.scala:229:27]
  wire [3:0]       _counter1_T = counter - 4'h1;	// @[generators/rocket-chip/src/main/scala/tilelink/Edges.scala:229:27, :230:28]
  wire             d_last = counter == 4'h1 | beats1 == 4'h0;	// @[generators/rocket-chip/src/main/scala/rocket/HellaCache.scala:234:14, generators/rocket-chip/src/main/scala/tilelink/Edges.scala:221:14, :229:27, :232:{25,33,43}, generators/rocket-chip/src/main/scala/util/package.scala:16:47]
  wire             grantIsUncachedData = auto_out_d_bits_opcode == 3'h1;	// @[generators/rocket-chip/src/main/scala/util/Misc.scala:38:36, generators/rocket-chip/src/main/scala/util/package.scala:16:47]
  wire             grantIsUncached = grantIsUncachedData | auto_out_d_bits_opcode == 3'h0 | auto_out_d_bits_opcode == 3'h2;	// @[generators/rocket-chip/src/main/scala/util/Misc.scala:38:36, generators/rocket-chip/src/main/scala/util/Replacement.scala:168:70, generators/rocket-chip/src/main/scala/util/package.scala:16:47, :73:59]
  wire             grantIsRefill = auto_out_d_bits_opcode == 3'h5;	// @[generators/rocket-chip/src/main/scala/util/package.scala:16:47]
  wire             grantIsCached = auto_out_d_bits_opcode == 3'h4 | grantIsRefill;	// @[generators/rocket-chip/src/main/scala/util/package.scala:16:47, :73:59]
  wire             grantIsVoluntary = auto_out_d_bits_opcode == 3'h6;	// @[generators/rocket-chip/src/main/scala/rocket/DCache.scala:659:32, generators/rocket-chip/src/main/scala/util/package.scala:16:47]
  reg              grantInProgress;	// @[generators/rocket-chip/src/main/scala/rocket/DCache.scala:661:32]
  reg  [2:0]       blockProbeAfterGrantCount;	// @[generators/rocket-chip/src/main/scala/rocket/DCache.scala:662:42]
  wire             _metaArb_io_in_4_valid_T = release_state == 4'h6;	// @[generators/rocket-chip/src/main/scala/rocket/DCache.scala:222:30, generators/rocket-chip/src/main/scala/util/package.scala:16:47]
  wire             _nodeOut_c_valid_T_1 = release_state == 4'h9;	// @[generators/rocket-chip/src/main/scala/rocket/DCache.scala:222:30, generators/rocket-chip/src/main/scala/util/package.scala:16:47]
  wire             _canAcceptCachedGrant_T_4 = _canAcceptCachedGrant_T | _metaArb_io_in_4_valid_T | _nodeOut_c_valid_T_1;	// @[generators/rocket-chip/src/main/scala/util/package.scala:16:47, :73:59]
  wire             _GEN_18 = _io_errors_bus_valid_T & grantIsCached;	// @[generators/rocket-chip/src/main/scala/rocket/DCache.scala:669:26, generators/rocket-chip/src/main/scala/util/package.scala:73:59, src/main/scala/chisel3/util/Decoupled.scala:52:35]
  wire             _GEN_19 = auto_out_d_bits_source & d_last;	// @[generators/rocket-chip/src/main/scala/rocket/DCache.scala:680:17, generators/rocket-chip/src/main/scala/tilelink/Edges.scala:232:33]
  wire             _GEN_20 = grantIsRefill & dataArb_io_in_0_valid;	// @[generators/rocket-chip/src/main/scala/rocket/DCache.scala:511:44, :716:23, generators/rocket-chip/src/main/scala/util/package.scala:16:47]
  wire             nodeOut_e_valid = ~_GEN_20 & auto_out_d_valid & ~(|counter) & grantIsCached & ~_canAcceptCachedGrant_T_4;	// @[generators/rocket-chip/src/main/scala/rocket/DCache.scala:664:30, :708:18, :716:{23,51}, :717:20, generators/rocket-chip/src/main/scala/tilelink/Edges.scala:229:27, :231:25, generators/rocket-chip/src/main/scala/util/package.scala:73:59]
  assign dataArb_io_in_1_bits_addr = {s2_req_addr[11:6], beats1 & ~_counter1_T, 2'h0};	// @[generators/rocket-chip/src/main/scala/rocket/DCache.scala:94:20, :333:19, :722:32, :739:36, generators/rocket-chip/src/main/scala/rocket/HellaCache.scala:234:14, generators/rocket-chip/src/main/scala/tilelink/Edges.scala:221:14, :230:28, :234:{25,27}]
  assign metaArb_io_in_3_valid = grantIsCached & d_last & _io_errors_bus_valid_T & ~auto_out_d_bits_denied;	// @[generators/rocket-chip/src/main/scala/rocket/DCache.scala:735:{53,56}, generators/rocket-chip/src/main/scala/tilelink/Edges.scala:232:33, generators/rocket-chip/src/main/scala/util/package.scala:73:59, src/main/scala/chisel3/util/Decoupled.scala:52:35]
  wire [3:0]       _metaArb_io_in_3_bits_data_T_1 = {_metaArb_io_in_3_bits_data_c_cat_T_23 | _metaArb_io_in_3_bits_data_c_cat_T_24 | s2_sc | _metaArb_io_in_3_bits_data_c_cat_T_28 | _metaArb_io_in_3_bits_data_c_cat_T_29 | _metaArb_io_in_3_bits_data_c_cat_T_30 | _metaArb_io_in_3_bits_data_c_cat_T_31 | _metaArb_io_in_3_bits_data_c_cat_T_35 | _metaArb_io_in_3_bits_data_c_cat_T_36 | _metaArb_io_in_3_bits_data_c_cat_T_37 | _metaArb_io_in_3_bits_data_c_cat_T_38 | _metaArb_io_in_3_bits_data_c_cat_T_39, _metaArb_io_in_3_bits_data_c_cat_T_23 | _metaArb_io_in_3_bits_data_c_cat_T_24 | s2_sc | _metaArb_io_in_3_bits_data_c_cat_T_28 | _metaArb_io_in_3_bits_data_c_cat_T_29 | _metaArb_io_in_3_bits_data_c_cat_T_30 | _metaArb_io_in_3_bits_data_c_cat_T_31 | _metaArb_io_in_3_bits_data_c_cat_T_35 | _metaArb_io_in_3_bits_data_c_cat_T_36 | _metaArb_io_in_3_bits_data_c_cat_T_37 | _metaArb_io_in_3_bits_data_c_cat_T_38 | _metaArb_io_in_3_bits_data_c_cat_T_39 | _metaArb_io_in_3_bits_data_c_cat_T_46 | s2_lr, auto_out_d_bits_param};	// @[generators/rocket-chip/src/main/scala/rocket/Consts.scala:86:{32,49,76}, :87:{54,64}, generators/rocket-chip/src/main/scala/tilelink/Metadata.scala:84:18, generators/rocket-chip/src/main/scala/util/package.scala:16:47]
  assign metaArb_io_in_3_bits_data = {_metaArb_io_in_3_bits_data_T_1 == 4'hC ? 2'h3 : _metaArb_io_in_3_bits_data_T_1 == 4'h4 | _metaArb_io_in_3_bits_data_T_1 == 4'h0 ? 2'h2 : {1'h0, _metaArb_io_in_3_bits_data_T_1 == 4'h1}, s2_req_addr[31:12]};	// @[generators/rocket-chip/src/main/scala/rocket/DCache.scala:269:27, :282:26, :333:19, :461:68, :740:134, :821:23, :1007:122, generators/rocket-chip/src/main/scala/rocket/HellaCache.scala:234:14, generators/rocket-chip/src/main/scala/rocket/TLB.scala:474:82, generators/rocket-chip/src/main/scala/tilelink/Metadata.scala:84:{18,38}, generators/rocket-chip/src/main/scala/util/package.scala:16:47]
  reg              blockUncachedGrant;	// @[generators/rocket-chip/src/main/scala/rocket/DCache.scala:744:33]
  wire             _GEN_21 = grantIsUncachedData & (blockUncachedGrant | s1_valid);	// @[generators/rocket-chip/src/main/scala/rocket/DCache.scala:176:25, :744:33, :746:{31,54}, generators/rocket-chip/src/main/scala/util/package.scala:16:47]
  assign nodeOut_d_ready = ~(_GEN_21 | _GEN_20) & (~grantIsCached | ((|counter) | auto_out_e_ready) & ~_canAcceptCachedGrant_T_4);	// @[generators/rocket-chip/src/main/scala/rocket/DCache.scala:664:30, :665:{18,24,50,69}, :716:{23,51}, :718:20, :746:{31,68}, :747:22, generators/rocket-chip/src/main/scala/tilelink/Edges.scala:229:27, :231:25, generators/rocket-chip/src/main/scala/util/package.scala:73:59]
  wire             io_cpu_req_ready_0 = _GEN_21 ? ~(auto_out_d_valid | metaArb__grant_T_5 | _GEN_0) & _io_cpu_req_ready_T_4 : ~(metaArb__grant_T_5 | _GEN_0) & _io_cpu_req_ready_T_4;	// @[generators/rocket-chip/src/main/scala/rocket/DCache.scala:227:{20,73}, :252:{33,45,64}, :261:{34,53}, :269:{79,98}, :746:{31,68}, :749:29, :750:26, src/main/scala/chisel3/util/Arbiter.scala:45:68]
  wire             _GEN_22 = _GEN_21 & auto_out_d_valid;	// @[generators/rocket-chip/src/main/scala/rocket/DCache.scala:715:26, :746:{31,68}, :749:29, :751:32]
  assign dataArb_io_in_1_valid = _GEN_22 | auto_out_d_valid & grantIsRefill & ~_canAcceptCachedGrant_T_4;	// @[generators/rocket-chip/src/main/scala/rocket/DCache.scala:664:30, :715:{26,61}, :746:68, :749:29, :751:32, generators/rocket-chip/src/main/scala/util/package.scala:16:47, :73:59]
  assign dataArb_io_in_1_bits_write = ~_GEN_21 | ~auto_out_d_valid;	// @[generators/rocket-chip/src/main/scala/rocket/DCache.scala:721:33, :746:{31,68}, :749:29, :752:37]
  wire             block_probe_for_core_progress = (|blockProbeAfterGrantCount) | (|(lrscCount[6:2]));	// @[generators/rocket-chip/src/main/scala/rocket/DCache.scala:466:26, :467:29, :662:42, :663:35, :760:71]
  wire             nodeOut_b_ready = ~metaArb__grant_T_3 & ~(block_probe_for_core_progress | releaseInFlight | release_ack_wait & (auto_out_b_bits_address[21:6] ^ release_ack_addr[21:6]) == 16'h0 | grantInProgress | s1_valid | s2_valid);	// @[generators/rocket-chip/src/main/scala/diplomacy/LazyModule.scala:366:18, generators/rocket-chip/src/main/scala/rocket/AMOALU.scala:45:49, generators/rocket-chip/src/main/scala/rocket/DCache.scala:176:25, :220:33, :221:29, :325:25, :328:46, :661:32, :760:71, :761:{62,88,163}, :764:{44,47,119}, src/main/scala/chisel3/util/Arbiter.scala:45:{68,78}]
  wire             _io_cpu_perf_release_T = auto_out_c_ready & nodeOut_c_valid;	// @[generators/rocket-chip/src/main/scala/rocket/DCache.scala:818:21, :844:47, :845:22, :848:48, :849:22, src/main/scala/chisel3/util/Decoupled.scala:52:35]
  wire [12:0]      _GEN_23 = {10'h0, nodeOut_c_bits_size};	// @[generators/rocket-chip/src/main/scala/rocket/DCache.scala:853:48, :857:102, :858:52, generators/rocket-chip/src/main/scala/util/package.scala:235:71]
  wire [12:0]      _beats1_decode_T_5 = 13'h3F << _GEN_23;	// @[generators/rocket-chip/src/main/scala/util/package.scala:235:71]
  wire [3:0]       beats1_1 = nodeOut_c_bits_opcode[0] ? ~(_beats1_decode_T_5[5:2]) : 4'h0;	// @[generators/rocket-chip/src/main/scala/rocket/DCache.scala:853:48, :857:102, :858:52, generators/rocket-chip/src/main/scala/rocket/HellaCache.scala:234:14, generators/rocket-chip/src/main/scala/tilelink/Edges.scala:102:36, :221:14, generators/rocket-chip/src/main/scala/util/package.scala:235:{46,71,76}]
  reg  [3:0]       counter_1;	// @[generators/rocket-chip/src/main/scala/tilelink/Edges.scala:229:27]
  wire [3:0]       _counter1_T_1 = counter_1 - 4'h1;	// @[generators/rocket-chip/src/main/scala/tilelink/Edges.scala:229:27, :230:28]
  wire             c_first = counter_1 == 4'h0;	// @[generators/rocket-chip/src/main/scala/rocket/HellaCache.scala:234:14, generators/rocket-chip/src/main/scala/tilelink/Edges.scala:229:27, :231:25]
  wire             releaseDone = (counter_1 == 4'h1 | beats1_1 == 4'h0) & _io_cpu_perf_release_T;	// @[generators/rocket-chip/src/main/scala/rocket/HellaCache.scala:234:14, generators/rocket-chip/src/main/scala/tilelink/Edges.scala:221:14, :229:27, :232:{25,33,43}, :233:22, generators/rocket-chip/src/main/scala/util/package.scala:16:47, src/main/scala/chisel3/util/Decoupled.scala:52:35]
  reg              s1_release_data_valid;	// @[generators/rocket-chip/src/main/scala/rocket/DCache.scala:795:38]
  reg              s2_release_data_valid;	// @[generators/rocket-chip/src/main/scala/rocket/DCache.scala:796:38]
  wire             releaseRejected = s2_release_data_valid & ~_io_cpu_perf_release_T;	// @[generators/rocket-chip/src/main/scala/rocket/DCache.scala:796:38, :797:{44,47}, src/main/scala/chisel3/util/Decoupled.scala:52:35]
  wire [4:0]       _releaseDataBeat_T_5 = {1'h0, beats1_1 & ~_counter1_T_1} + {3'h0, releaseRejected ? 2'h0 : {1'h0, s1_release_data_valid} + {1'h0, s2_release_data_valid}};	// @[generators/rocket-chip/src/main/scala/rocket/DCache.scala:94:20, :269:27, :282:26, :795:38, :796:38, :797:44, :798:{43,48,93}, :1007:122, generators/rocket-chip/src/main/scala/rocket/HellaCache.scala:234:14, generators/rocket-chip/src/main/scala/tilelink/Edges.scala:221:14, :230:28, :234:{25,27}, generators/rocket-chip/src/main/scala/util/Replacement.scala:168:70]
  assign s1_nack = s2_probe ? s2_prb_ack_data | (|s2_probe_state_state) | ~releaseDone | _GEN_16 | _GEN_15 : _GEN_16 | _GEN_15;	// @[generators/rocket-chip/src/main/scala/rocket/DCache.scala:282:75, :327:25, :378:33, :440:{24,82,92}, :565:{18,36,46}, :818:21, :830:22, :833:{24,34}, generators/rocket-chip/src/main/scala/tilelink/Edges.scala:233:22, generators/rocket-chip/src/main/scala/tilelink/Metadata.scala:50:45, generators/rocket-chip/src/main/scala/util/Misc.scala:38:9]
  wire             _GEN_24 = release_state == 4'h4;	// @[generators/rocket-chip/src/main/scala/rocket/DCache.scala:222:30, :821:23, :835:25]
  assign metaArb_io_in_6_valid = _GEN_24 | auto_out_b_valid & (~block_probe_for_core_progress | (|lrscCount) & ~(|(lrscCount[6:2])));	// @[generators/rocket-chip/src/main/scala/rocket/DCache.scala:466:26, :467:29, :468:{34,40,43}, :760:71, :763:{26,44,48,79}, :835:{25,44}, :836:30]
  assign metaArb_io_in_6_bits_idx = _GEN_24 ? metaArb_io_in_4_bits_idx : auto_out_b_bits_address[11:6];	// @[generators/rocket-chip/src/main/scala/rocket/DCache.scala:766:29, :835:{25,44}, :837:33, :1193:47]
  wire             _GEN_25 = release_state == 4'h5;	// @[generators/rocket-chip/src/main/scala/rocket/DCache.scala:222:30, :831:29, :844:25]
  wire             _GEN_26 = release_state == 4'h3;	// @[generators/rocket-chip/src/main/scala/rocket/DCache.scala:222:30, :827:29, :848:25]
  assign nodeOut_c_valid = _GEN_26 | _GEN_25 | s2_probe & ~s2_prb_ack_data | s2_release_data_valid & ~(c_first & release_ack_wait);	// @[generators/rocket-chip/src/main/scala/rocket/DCache.scala:220:33, :327:25, :796:38, :804:{18,117,120,130}, :818:21, :820:28, :822:36, :824:45, :844:{25,47}, :845:22, :848:{25,48}, :849:22, generators/rocket-chip/src/main/scala/tilelink/Edges.scala:231:25, generators/rocket-chip/src/main/scala/util/Misc.scala:38:9]
  wire             _GEN_27 = _canAcceptCachedGrant_T | _metaArb_io_in_4_valid_T | _nodeOut_c_valid_T_1;	// @[generators/rocket-chip/src/main/scala/util/package.scala:16:47, :73:59]
  assign nodeOut_c_bits_opcode = _GEN_27 ? {2'h3, ~_nodeOut_c_valid_T_1} : {2'h2, _inWriteback_T_1};	// @[generators/rocket-chip/src/main/scala/rocket/DCache.scala:848:48, :853:48, :854:21, :857:102, :858:52, :859:23, :864:23, generators/rocket-chip/src/main/scala/rocket/HellaCache.scala:234:14, generators/rocket-chip/src/main/scala/rocket/TLB.scala:474:82, generators/rocket-chip/src/main/scala/util/package.scala:16:47, :73:59]
  assign nodeOut_c_bits_size = _GEN_27 ? 3'h6 : probe_bits_size;	// @[generators/rocket-chip/src/main/scala/rocket/DCache.scala:178:29, :853:48, :857:102, :858:52, generators/rocket-chip/src/main/scala/util/package.scala:16:47, :73:59]
  assign releaseWay = _GEN_27 ? metaArb_io_in_2_bits_way_en : s2_probe_way;	// @[generators/rocket-chip/src/main/scala/rocket/DCache.scala:377:31, :426:33, :807:14, :857:102, :871:18, generators/rocket-chip/src/main/scala/util/package.scala:73:59]
  assign dataArb_io_in_2_valid = inWriteback & ~(_releaseDataBeat_T_5[4]);	// @[generators/rocket-chip/src/main/scala/rocket/DCache.scala:798:43, :894:{41,60}, generators/rocket-chip/src/main/scala/util/package.scala:73:59]
  assign dataArb_io_in_2_bits_addr = {metaArb_io_in_4_bits_idx, _releaseDataBeat_T_5[3:0], 2'h0};	// @[generators/rocket-chip/src/main/scala/rocket/DCache.scala:94:20, :798:43, :897:{72,90}, :1193:47, generators/rocket-chip/src/main/scala/rocket/HellaCache.scala:234:14]
  assign metaArb_io_in_4_valid = _metaArb_io_in_4_valid_T | release_state == 4'h7;	// @[generators/rocket-chip/src/main/scala/rocket/DCache.scala:222:30, :827:29, generators/rocket-chip/src/main/scala/util/package.scala:16:47, :73:59]
  assign metaArb_io_in_7_bits_data = {_GEN_27 ? 2'h0 : _GEN_14 ? 2'h2 : _GEN_11 ? 2'h1 : _GEN_10 ? 2'h0 : {1'h0, _GEN_9 | _GEN_8 | _GEN_7}, probe_bits_address[31:12]};	// @[generators/rocket-chip/src/main/scala/rocket/DCache.scala:94:20, :178:29, :269:27, :282:26, :806:27, :857:102, :870:14, :907:{78,97}, :1007:122, generators/rocket-chip/src/main/scala/rocket/HellaCache.scala:234:14, generators/rocket-chip/src/main/scala/rocket/TLB.scala:474:82, generators/rocket-chip/src/main/scala/util/Misc.scala:38:{36,63}, :56:20, generators/rocket-chip/src/main/scala/util/package.scala:16:47, :73:59]
  reg              io_cpu_s2_xcpt_REG;	// @[generators/rocket-chip/src/main/scala/rocket/DCache.scala:926:32]
  assign io_cpu_s2_xcpt_pf_ld_0 = io_cpu_s2_xcpt_REG & s2_tlb_xcpt_pf_ld;	// @[generators/rocket-chip/src/main/scala/rocket/DCache.scala:336:24, :926:{24,32}]
  assign io_cpu_s2_xcpt_pf_st_0 = io_cpu_s2_xcpt_REG & s2_tlb_xcpt_pf_st;	// @[generators/rocket-chip/src/main/scala/rocket/DCache.scala:336:24, :926:{24,32}]
  assign io_cpu_s2_xcpt_ae_ld_0 = io_cpu_s2_xcpt_REG & s2_tlb_xcpt_ae_ld;	// @[generators/rocket-chip/src/main/scala/rocket/DCache.scala:336:24, :926:{24,32}]
  assign io_cpu_s2_xcpt_ae_st_0 = io_cpu_s2_xcpt_REG & s2_tlb_xcpt_ae_st;	// @[generators/rocket-chip/src/main/scala/rocket/DCache.scala:336:24, :926:{24,32}]
  assign io_cpu_s2_xcpt_ma_ld_0 = io_cpu_s2_xcpt_REG & s2_tlb_xcpt_ma_ld;	// @[generators/rocket-chip/src/main/scala/rocket/DCache.scala:336:24, :926:{24,32}]
  assign io_cpu_s2_xcpt_ma_st_0 = io_cpu_s2_xcpt_REG & s2_tlb_xcpt_ma_st;	// @[generators/rocket-chip/src/main/scala/rocket/DCache.scala:336:24, :926:{24,32}]
  reg              doUncachedResp;	// @[generators/rocket-chip/src/main/scala/rocket/DCache.scala:941:31]
  wire             io_cpu_replay_next_0 = _io_errors_bus_valid_T & grantIsUncachedData;	// @[generators/rocket-chip/src/main/scala/rocket/DCache.scala:943:39, generators/rocket-chip/src/main/scala/util/package.scala:16:47, src/main/scala/chisel3/util/Decoupled.scala:52:35]
  `ifndef SYNTHESIS	// @[generators/rocket-chip/src/main/scala/rocket/DCache.scala:1179:11]
    wire _GEN_28 = _io_errors_bus_valid_T & ~grantIsCached;	// @[generators/rocket-chip/src/main/scala/rocket/DCache.scala:669:26, generators/rocket-chip/src/main/scala/util/package.scala:73:59, src/main/scala/chisel3/util/Decoupled.scala:52:35]
    always @(posedge clock) begin	// @[generators/rocket-chip/src/main/scala/rocket/DCache.scala:1179:11]
      if (~reset & ~(~(_pstore_drain_opportunistic_T | _pstore_drain_opportunistic_T_1 | _pstore_drain_opportunistic_T_2 | _pstore_drain_opportunistic_T_28 | _pstore_drain_opportunistic_T_30 | _pstore_drain_opportunistic_T_31 | _pstore_drain_opportunistic_T_32 | _pstore_drain_opportunistic_T_33 | _pstore_drain_opportunistic_T_37 | _pstore_drain_opportunistic_T_38 | _pstore_drain_opportunistic_T_39 | _pstore_drain_opportunistic_T_40 | _pstore_drain_opportunistic_T_41 | (_pstore_drain_opportunistic_T_25 | _pstore_drain_opportunistic_T_50 | _pstore_drain_opportunistic_T_28 | _pstore_drain_opportunistic_T_30 | _pstore_drain_opportunistic_T_31 | _pstore_drain_opportunistic_T_32 | _pstore_drain_opportunistic_T_33 | _pstore_drain_opportunistic_T_37 | _pstore_drain_opportunistic_T_38 | _pstore_drain_opportunistic_T_39 | _pstore_drain_opportunistic_T_40 | _pstore_drain_opportunistic_T_41) & _pstore_drain_opportunistic_T_50) | ~_dataArb_io_in_3_valid_res_T_2)) begin	// @[generators/rocket-chip/src/main/scala/rocket/Consts.scala:86:{49,76}, generators/rocket-chip/src/main/scala/rocket/DCache.scala:1178:15, :1179:{11,12,28}, :1183:21, :1184:23, generators/rocket-chip/src/main/scala/util/package.scala:16:47, :73:59]
        if (`ASSERT_VERBOSE_COND_)	// @[generators/rocket-chip/src/main/scala/rocket/DCache.scala:1179:11]
          $error("Assertion failed\n    at DCache.scala:1179 assert(!needsRead(req) || res)\n");	// @[generators/rocket-chip/src/main/scala/rocket/DCache.scala:1179:11]
        if (`STOP_COND_)	// @[generators/rocket-chip/src/main/scala/rocket/DCache.scala:1179:11]
          $fatal;	// @[generators/rocket-chip/src/main/scala/rocket/DCache.scala:1179:11]
      end
      if (~reset & ~(~(s1_valid_masked & _io_cpu_perf_canAcceptLoadThenLoad_T_51) | (&(s1_mask_xwr | ~io_cpu_s1_data_mask)))) begin	// @[generators/rocket-chip/src/main/scala/rocket/AMOALU.scala:22:16, generators/rocket-chip/src/main/scala/rocket/Consts.scala:86:49, generators/rocket-chip/src/main/scala/rocket/DCache.scala:180:34, :323:{9,10,28,53,69,71,93}]
        if (`ASSERT_VERBOSE_COND_)	// @[generators/rocket-chip/src/main/scala/rocket/DCache.scala:323:9]
          $error("Assertion failed\n    at DCache.scala:323 assert(!(s1_valid_masked && s1_req.cmd === M_PWR) || (s1_mask_xwr | ~io.cpu.s1_data.mask).andR)\n");	// @[generators/rocket-chip/src/main/scala/rocket/DCache.scala:323:9]
        if (`STOP_COND_)	// @[generators/rocket-chip/src/main/scala/rocket/DCache.scala:323:9]
          $fatal;	// @[generators/rocket-chip/src/main/scala/rocket/DCache.scala:323:9]
      end
      if (~reset & ~(~(_pstore_drain_opportunistic_T | _pstore_drain_opportunistic_T_1 | _pstore_drain_opportunistic_T_2 | _pstore_drain_opportunistic_T_28 | _pstore_drain_opportunistic_T_30 | _pstore_drain_opportunistic_T_31 | _pstore_drain_opportunistic_T_32 | _pstore_drain_opportunistic_T_33 | _pstore_drain_opportunistic_T_37 | _pstore_drain_opportunistic_T_38 | _pstore_drain_opportunistic_T_39 | _pstore_drain_opportunistic_T_40 | _pstore_drain_opportunistic_T_41 | (_pstore_drain_opportunistic_T_25 | _pstore_drain_opportunistic_T_50 | _pstore_drain_opportunistic_T_28 | _pstore_drain_opportunistic_T_30 | _pstore_drain_opportunistic_T_31 | _pstore_drain_opportunistic_T_32 | _pstore_drain_opportunistic_T_33 | _pstore_drain_opportunistic_T_37 | _pstore_drain_opportunistic_T_38 | _pstore_drain_opportunistic_T_39 | _pstore_drain_opportunistic_T_40 | _pstore_drain_opportunistic_T_41) & _pstore_drain_opportunistic_T_50) | ~_pstore_drain_opportunistic_res_T_2)) begin	// @[generators/rocket-chip/src/main/scala/rocket/Consts.scala:86:{49,76}, generators/rocket-chip/src/main/scala/rocket/DCache.scala:1178:15, :1179:{11,12,28}, :1183:21, :1184:23, generators/rocket-chip/src/main/scala/util/package.scala:16:47, :73:59]
        if (`ASSERT_VERBOSE_COND_)	// @[generators/rocket-chip/src/main/scala/rocket/DCache.scala:1179:11]
          $error("Assertion failed\n    at DCache.scala:1179 assert(!needsRead(req) || res)\n");	// @[generators/rocket-chip/src/main/scala/rocket/DCache.scala:1179:11]
        if (`STOP_COND_)	// @[generators/rocket-chip/src/main/scala/rocket/DCache.scala:1179:11]
          $fatal;	// @[generators/rocket-chip/src/main/scala/rocket/DCache.scala:1179:11]
      end
      if (~reset & ~(pstore1_rmw | (_dataArb_io_in_0_valid_T_4 | pstore1_held) == pstore1_valid)) begin	// @[generators/rocket-chip/src/main/scala/rocket/DCache.scala:323:9, :492:44, :498:29, :500:{72,96}, :501:38, :504:{9,22,63}]
        if (`ASSERT_VERBOSE_COND_)	// @[generators/rocket-chip/src/main/scala/rocket/DCache.scala:504:9]
          $error("Assertion failed\n    at DCache.scala:504 assert(pstore1_rmw || pstore1_valid_not_rmw(io.cpu.s2_kill) === pstore1_valid)\n");	// @[generators/rocket-chip/src/main/scala/rocket/DCache.scala:504:9]
        if (`STOP_COND_)	// @[generators/rocket-chip/src/main/scala/rocket/DCache.scala:504:9]
          $fatal;	// @[generators/rocket-chip/src/main/scala/rocket/DCache.scala:504:9]
      end
      if (_GEN_18 & ~reset & ~cached_grant_wait) begin	// @[generators/rocket-chip/src/main/scala/rocket/DCache.scala:217:34, :323:9, :669:26, :671:13]
        if (`ASSERT_VERBOSE_COND_)	// @[generators/rocket-chip/src/main/scala/rocket/DCache.scala:671:13]
          $error("Assertion failed: A GrantData was unexpected by the dcache.\n    at DCache.scala:671 assert(cached_grant_wait, \"A GrantData was unexpected by the dcache.\")\n");	// @[generators/rocket-chip/src/main/scala/rocket/DCache.scala:671:13]
        if (`STOP_COND_)	// @[generators/rocket-chip/src/main/scala/rocket/DCache.scala:671:13]
          $fatal;	// @[generators/rocket-chip/src/main/scala/rocket/DCache.scala:671:13]
      end
      if (_GEN_28 & grantIsUncached & _GEN_19 & ~reset & ~uncachedInFlight_0) begin	// @[generators/rocket-chip/src/main/scala/rocket/DCache.scala:230:33, :323:9, :669:26, :680:17, :681:17, generators/rocket-chip/src/main/scala/util/package.scala:73:59]
        if (`ASSERT_VERBOSE_COND_)	// @[generators/rocket-chip/src/main/scala/rocket/DCache.scala:681:17]
          $error("Assertion failed: An AccessAck was unexpected by the dcache.\n    at DCache.scala:681 assert(f, \"An AccessAck was unexpected by the dcache.\") // TODO must handle Ack coming back on same cycle!\n");	// @[generators/rocket-chip/src/main/scala/rocket/DCache.scala:681:17]
        if (`STOP_COND_)	// @[generators/rocket-chip/src/main/scala/rocket/DCache.scala:681:17]
          $fatal;	// @[generators/rocket-chip/src/main/scala/rocket/DCache.scala:681:17]
      end
      if (_GEN_28 & ~grantIsUncached & grantIsVoluntary & ~reset & ~release_ack_wait) begin	// @[generators/rocket-chip/src/main/scala/rocket/DCache.scala:220:33, :323:9, :659:32, :669:26, :678:35, :702:13, generators/rocket-chip/src/main/scala/util/package.scala:73:59]
        if (`ASSERT_VERBOSE_COND_)	// @[generators/rocket-chip/src/main/scala/rocket/DCache.scala:702:13]
          $error("Assertion failed: A ReleaseAck was unexpected by the dcache.\n    at DCache.scala:702 assert(release_ack_wait, \"A ReleaseAck was unexpected by the dcache.\") // TODO should handle Ack coming back on same cycle!\n");	// @[generators/rocket-chip/src/main/scala/rocket/DCache.scala:702:13]
        if (`STOP_COND_)	// @[generators/rocket-chip/src/main/scala/rocket/DCache.scala:702:13]
          $fatal;	// @[generators/rocket-chip/src/main/scala/rocket/DCache.scala:702:13]
      end
      if (~reset & (auto_out_e_ready & nodeOut_e_valid) != (_io_errors_bus_valid_T & ~(|counter) & grantIsCached)) begin	// @[generators/rocket-chip/src/main/scala/rocket/DCache.scala:323:9, :708:18, :710:{9,24,54}, :716:51, :717:20, generators/rocket-chip/src/main/scala/tilelink/Edges.scala:229:27, :231:25, generators/rocket-chip/src/main/scala/util/package.scala:73:59, src/main/scala/chisel3/util/Decoupled.scala:52:35]
        if (`ASSERT_VERBOSE_COND_)	// @[generators/rocket-chip/src/main/scala/rocket/DCache.scala:710:9]
          $error("Assertion failed\n    at DCache.scala:710 assert(tl_out.e.fire === (tl_out.d.fire && d_first && grantIsCached))\n");	// @[generators/rocket-chip/src/main/scala/rocket/DCache.scala:710:9]
        if (`STOP_COND_)	// @[generators/rocket-chip/src/main/scala/rocket/DCache.scala:710:9]
          $fatal;	// @[generators/rocket-chip/src/main/scala/rocket/DCache.scala:710:9]
      end
      if (s2_want_victimize & ~reset & ~(s2_valid_flush_line | s2_flush_valid_pre_tag_ecc | io_cpu_s2_nack_0)) begin	// @[generators/rocket-chip/src/main/scala/rocket/DCache.scala:323:9, :349:43, :413:75, :421:123, :439:86, :811:{13,52}]
        if (`ASSERT_VERBOSE_COND_)	// @[generators/rocket-chip/src/main/scala/rocket/DCache.scala:811:13]
          $error("Assertion failed\n    at DCache.scala:811 assert(s2_valid_flush_line || s2_flush_valid || io.cpu.s2_nack)\n");	// @[generators/rocket-chip/src/main/scala/rocket/DCache.scala:811:13]
        if (`STOP_COND_)	// @[generators/rocket-chip/src/main/scala/rocket/DCache.scala:811:13]
          $fatal;	// @[generators/rocket-chip/src/main/scala/rocket/DCache.scala:811:13]
      end
      if (doUncachedResp & ~reset & s2_valid_hit_pre_data_ecc_and_waw) begin	// @[generators/rocket-chip/src/main/scala/rocket/DCache.scala:323:9, :412:89, :941:31, :945:11]
        if (`ASSERT_VERBOSE_COND_)	// @[generators/rocket-chip/src/main/scala/rocket/DCache.scala:945:11]
          $error("Assertion failed\n    at DCache.scala:945 assert(!s2_valid_hit)\n");	// @[generators/rocket-chip/src/main/scala/rocket/DCache.scala:945:11]
        if (`STOP_COND_)	// @[generators/rocket-chip/src/main/scala/rocket/DCache.scala:945:11]
          $fatal;	// @[generators/rocket-chip/src/main/scala/rocket/DCache.scala:945:11]
      end
    end // always @(posedge)
  `endif // not def SYNTHESIS
  wire [15:0]      io_cpu_resp_bits_data_zeroed = s2_req_addr[1] ? s2_data[31:16] : s2_data[15:0];	// @[generators/rocket-chip/src/main/scala/rocket/AMOALU.scala:42:{24,37,55}, generators/rocket-chip/src/main/scala/rocket/DCache.scala:333:19, :373:18, generators/rocket-chip/src/main/scala/util/Misc.scala:210:26]
  wire [7:0]       io_cpu_resp_bits_data_zeroed_1 = s2_sc ? 8'h0 : s2_req_addr[0] ? io_cpu_resp_bits_data_zeroed[15:8] : io_cpu_resp_bits_data_zeroed[7:0];	// @[generators/rocket-chip/src/main/scala/rocket/AMOALU.scala:42:{24,37,55}, :44:23, generators/rocket-chip/src/main/scala/rocket/DCache.scala:284:18, :333:19, generators/rocket-chip/src/main/scala/util/Misc.scala:210:26, generators/rocket-chip/src/main/scala/util/package.scala:16:47]
  reg              REG;	// @[generators/rocket-chip/src/main/scala/rocket/DCache.scala:1001:18]
  assign metaArb_io_in_0_bits_idx = flushCounter[5:0];	// @[generators/rocket-chip/src/main/scala/rocket/DCache.scala:219:29, :1010:44]
  wire [12:0]      _io_cpu_perf_release_beats1_decode_T_1 = 13'h3F << _GEN_23;	// @[generators/rocket-chip/src/main/scala/util/package.scala:235:71]
  wire [3:0]       io_cpu_perf_release_beats1 = nodeOut_c_bits_opcode[0] ? ~(_io_cpu_perf_release_beats1_decode_T_1[5:2]) : 4'h0;	// @[generators/rocket-chip/src/main/scala/rocket/DCache.scala:853:48, :857:102, :858:52, generators/rocket-chip/src/main/scala/rocket/HellaCache.scala:234:14, generators/rocket-chip/src/main/scala/tilelink/Edges.scala:102:36, :221:14, generators/rocket-chip/src/main/scala/util/package.scala:235:{46,71,76}]
  reg  [3:0]       io_cpu_perf_release_counter;	// @[generators/rocket-chip/src/main/scala/tilelink/Edges.scala:229:27]
  wire [3:0]       _release_state_T_14 = s2_victim_dirty & ~(s2_valid_flush_line & s2_req_size[1]) ? 4'h1 : 4'h6;	// @[generators/rocket-chip/src/main/scala/rocket/DCache.scala:333:19, :413:75, :812:{46,60}, :813:{27,44,47}, generators/rocket-chip/src/main/scala/util/Misc.scala:38:9, generators/rocket-chip/src/main/scala/util/package.scala:16:47]
  wire [3:0]       _release_state_T_15 = {1'h0, releaseDone, 2'h3};	// @[generators/rocket-chip/src/main/scala/rocket/DCache.scala:269:27, :282:26, :827:29, :1007:122, generators/rocket-chip/src/main/scala/rocket/HellaCache.scala:234:14, generators/rocket-chip/src/main/scala/tilelink/Edges.scala:233:22]
  wire [3:0]       _GEN_29 = s2_prb_ack_data ? 4'h2 : (|s2_probe_state_state) ? 4'h3 : 4'h5;	// @[generators/rocket-chip/src/main/scala/rocket/DCache.scala:378:33, :822:36, :823:23, :824:45, :827:{23,29}, :831:{23,29}, generators/rocket-chip/src/main/scala/tilelink/Metadata.scala:50:45, generators/rocket-chip/src/main/scala/util/Misc.scala:38:9, generators/rocket-chip/src/main/scala/util/package.scala:16:47]
  wire             _GEN_30 = _io_errors_bus_valid_T & grantIsCached & d_last;	// @[generators/rocket-chip/src/main/scala/rocket/DCache.scala:625:24, :668:24, :669:26, :672:20, :673:27, generators/rocket-chip/src/main/scala/tilelink/Edges.scala:232:33, generators/rocket-chip/src/main/scala/util/package.scala:73:59, src/main/scala/chisel3/util/Decoupled.scala:52:35]
  wire             _GEN_31 = _GEN_24 & ~metaArb__grant_T_3;	// @[generators/rocket-chip/src/main/scala/rocket/DCache.scala:818:21, :835:{25,44}, :839:37, :840:23, src/main/scala/chisel3/util/Arbiter.scala:45:{68,78}]
  wire [7:0]       flushCounterNext = {1'h0, flushCounter} + 8'h1;	// @[generators/rocket-chip/src/main/scala/rocket/DCache.scala:219:29, :269:27, :282:26, :476:51, :1002:39, :1007:122, generators/rocket-chip/src/main/scala/rocket/HellaCache.scala:234:14]
  wire             _GEN_32 = _GEN_25 & releaseDone | _GEN_31;	// @[generators/rocket-chip/src/main/scala/rocket/DCache.scala:818:21, :835:44, :839:37, :840:23, :844:{25,47}, :846:{26,42}, generators/rocket-chip/src/main/scala/tilelink/Edges.scala:233:22]
  wire [31:0]      s0_tlb_req_vaddr = {resetting ? {io_cpu_req_bits_addr[31:12], metaArb_io_in_0_bits_idx} : _GEN ? {io_cpu_req_bits_addr[31:12], s2_req_addr[11:6]} : metaArb_io_in_4_valid ? {io_cpu_req_bits_addr[31:12], probe_bits_address[11:6]} : metaArb_io_in_6_valid ? (_GEN_24 ? probe_bits_address[31:6] : auto_out_b_bits_address[31:6]) : io_cpu_req_bits_addr[31:6], io_cpu_req_bits_addr[5:0]};	// @[generators/rocket-chip/src/main/scala/diplomacy/LazyModule.scala:366:18, generators/rocket-chip/src/main/scala/rocket/DCache.scala:178:29, :187:{21,84}, :218:26, :239:89, :333:19, :739:36, :763:26, :767:30, :835:{25,44}, :836:30, :838:34, :906:36, :1010:44, :1011:36, generators/rocket-chip/src/main/scala/rocket/HellaCache.scala:234:14, generators/rocket-chip/src/main/scala/util/package.scala:73:59, src/main/scala/chisel3/util/Arbiter.scala:137:15, :139:26, :141:19]
  wire [3:0]       _GEN_33 = s1_tlb_req_vaddr[15:12] ^ 4'h8;	// @[generators/rocket-chip/src/main/scala/diplomacy/Parameters.scala:137:31, generators/rocket-chip/src/main/scala/rocket/DCache.scala:202:29, generators/rocket-chip/src/main/scala/util/package.scala:16:47]
  wire [9:0]       _GEN_34 = s1_tlb_req_vaddr[25:16] ^ 10'h200;	// @[generators/rocket-chip/src/main/scala/diplomacy/Parameters.scala:137:31, generators/rocket-chip/src/main/scala/rocket/DCache.scala:202:29]
  wire [5:0]       _GEN_35 = {s1_tlb_req_vaddr[31:28], ~(s1_tlb_req_vaddr[27:26])};	// @[generators/rocket-chip/src/main/scala/diplomacy/Parameters.scala:137:{31,41,46}, generators/rocket-chip/src/main/scala/rocket/DCache.scala:202:29]
  wire [8:0]       _GEN_36 = s1_tlb_req_vaddr[20:12] ^ 9'h100;	// @[generators/rocket-chip/src/main/scala/diplomacy/Parameters.scala:137:31, generators/rocket-chip/src/main/scala/rocket/DCache.scala:202:29]
  wire [13:0]      tlb__cacheable_T_5 = s1_tlb_req_vaddr[31:18] ^ 14'h2000;	// @[generators/rocket-chip/src/main/scala/diplomacy/Parameters.scala:137:31, generators/rocket-chip/src/main/scala/rocket/DCache.scala:202:29]
  wire [25:0]      tlb__legal_address_T_85 = s1_tlb_req_vaddr[31:6] ^ 26'h2000001;	// @[generators/rocket-chip/src/main/scala/diplomacy/Parameters.scala:137:31, generators/rocket-chip/src/main/scala/rocket/DCache.scala:202:29]
  wire [25:0]      tlb__legal_address_T_90 = s1_tlb_req_vaddr[31:6] ^ 26'h2000002;	// @[generators/rocket-chip/src/main/scala/diplomacy/Parameters.scala:137:31, generators/rocket-chip/src/main/scala/rocket/DCache.scala:202:29]
  wire [25:0]      tlb__legal_address_T_95 = s1_tlb_req_vaddr[31:6] ^ 26'h2000003;	// @[generators/rocket-chip/src/main/scala/diplomacy/Parameters.scala:137:31, generators/rocket-chip/src/main/scala/rocket/DCache.scala:202:29]
  wire [25:0]      tlb__legal_address_T_100 = s1_tlb_req_vaddr[31:6] ^ 26'h2000004;	// @[generators/rocket-chip/src/main/scala/diplomacy/Parameters.scala:137:31, generators/rocket-chip/src/main/scala/rocket/DCache.scala:202:29]
  wire [25:0]      tlb__legal_address_T_105 = s1_tlb_req_vaddr[31:6] ^ 26'h2000005;	// @[generators/rocket-chip/src/main/scala/diplomacy/Parameters.scala:137:31, generators/rocket-chip/src/main/scala/rocket/DCache.scala:202:29]
  wire [25:0]      tlb__legal_address_T_110 = s1_tlb_req_vaddr[31:6] ^ 26'h2000006;	// @[generators/rocket-chip/src/main/scala/diplomacy/Parameters.scala:137:31, generators/rocket-chip/src/main/scala/rocket/DCache.scala:202:29]
  wire [25:0]      tlb__legal_address_T_115 = s1_tlb_req_vaddr[31:6] ^ 26'h2000007;	// @[generators/rocket-chip/src/main/scala/diplomacy/Parameters.scala:137:31, generators/rocket-chip/src/main/scala/rocket/DCache.scala:202:29]
  wire             tlb_legal_address = {s1_tlb_req_vaddr[31:13], ~(s1_tlb_req_vaddr[12])} == 20'h0 | {s1_tlb_req_vaddr[31:29], s1_tlb_req_vaddr[28:12] ^ 17'h10020} == 20'h0 | {s1_tlb_req_vaddr[31:29], s1_tlb_req_vaddr[28:12] ^ 17'h10010} == 20'h0 | {s1_tlb_req_vaddr[31:29], s1_tlb_req_vaddr[28:12] ^ 17'h10030} == 20'h0 | {s1_tlb_req_vaddr[31:30], s1_tlb_req_vaddr[29:28] ^ 2'h2} == 4'h0 | {s1_tlb_req_vaddr[31:16], _GEN_33} == 20'h0 | {s1_tlb_req_vaddr[31:16], s1_tlb_req_vaddr[15:12] ^ 4'hA} == 20'h0 | {s1_tlb_req_vaddr[31:16], s1_tlb_req_vaddr[15:12] ^ 4'hB} == 20'h0 | {s1_tlb_req_vaddr[31:15], s1_tlb_req_vaddr[14:12] ^ 3'h6} == 20'h0 | {s1_tlb_req_vaddr[31:26], _GEN_34} == 16'h0 | ~(|_GEN_35) | ~(|(s1_tlb_req_vaddr[31:12])) | {s1_tlb_req_vaddr[31:17], ~(s1_tlb_req_vaddr[16])} == 16'h0 | {s1_tlb_req_vaddr[31:21], _GEN_36} == 20'h0 | {s1_tlb_req_vaddr[31:21], s1_tlb_req_vaddr[20:12] ^ 9'h110} == 20'h0 | {s1_tlb_req_vaddr[31:15], s1_tlb_req_vaddr[14:12] ^ 3'h5} == 20'h0 | {tlb__cacheable_T_5, s1_tlb_req_vaddr[8:6]} == 17'h0 | {tlb__legal_address_T_85[25:12], tlb__legal_address_T_85[2:0]} == 17'h0 | {tlb__legal_address_T_90[25:12], tlb__legal_address_T_90[2:0]} == 17'h0 | {tlb__legal_address_T_95[25:12], tlb__legal_address_T_95[2:0]} == 17'h0 | {tlb__legal_address_T_100[25:12], tlb__legal_address_T_100[2:0]} == 17'h0 | {tlb__legal_address_T_105[25:12], tlb__legal_address_T_105[2:0]} == 17'h0 | {tlb__legal_address_T_110[25:12], tlb__legal_address_T_110[2:0]} == 17'h0 | {tlb__legal_address_T_115[25:12], tlb__legal_address_T_115[2:0]} == 17'h0;	// @[generators/rocket-chip/src/main/scala/diplomacy/Parameters.scala:137:{31,41,46,59}, generators/rocket-chip/src/main/scala/rocket/AMOALU.scala:45:49, generators/rocket-chip/src/main/scala/rocket/DCache.scala:94:20, :202:29, generators/rocket-chip/src/main/scala/rocket/HellaCache.scala:234:14, :300:14, generators/rocket-chip/src/main/scala/rocket/TLB.scala:416:67, :474:82, generators/rocket-chip/src/main/scala/util/package.scala:16:47]
  wire             tlb_cacheable = tlb_legal_address & ~(tlb__cacheable_T_5[13]);	// @[generators/rocket-chip/src/main/scala/diplomacy/Parameters.scala:137:{31,41,46,59}, generators/rocket-chip/src/main/scala/rocket/TLB.scala:416:67, :419:19]
  wire             tlb_deny_access_to_debug = ~io_ptw_status_debug & ~(|(s1_tlb_req_vaddr[31:12]));	// @[generators/rocket-chip/src/main/scala/diplomacy/Parameters.scala:137:{41,46,59}, generators/rocket-chip/src/main/scala/rocket/DCache.scala:202:29, generators/rocket-chip/src/main/scala/rocket/TLB.scala:424:{39,50}]
  wire [15:0]      _GEN_37 = {s1_tlb_req_vaddr[31:18], s1_tlb_req_vaddr[16:15]};	// @[generators/rocket-chip/src/main/scala/diplomacy/Parameters.scala:137:{41,46}, generators/rocket-chip/src/main/scala/rocket/DCache.scala:202:29]
  wire [16:0]      _GEN_38 = {s1_tlb_req_vaddr[31:18], s1_tlb_req_vaddr[16], _GEN_33[3:2]};	// @[generators/rocket-chip/src/main/scala/diplomacy/Parameters.scala:137:{31,41,46}, generators/rocket-chip/src/main/scala/rocket/DCache.scala:202:29]
  wire [15:0]      _GEN_39 = {s1_tlb_req_vaddr[31:21], _GEN_36[8:6], s1_tlb_req_vaddr[15:14]};	// @[generators/rocket-chip/src/main/scala/diplomacy/Parameters.scala:137:{31,41,46}, generators/rocket-chip/src/main/scala/rocket/DCache.scala:202:29]
  wire [14:0]      _GEN_40 = {s1_tlb_req_vaddr[31:26], _GEN_34[9:2], s1_tlb_req_vaddr[16]};	// @[generators/rocket-chip/src/main/scala/diplomacy/Parameters.scala:137:{31,41,46}, generators/rocket-chip/src/main/scala/rocket/DCache.scala:202:29]
  wire [15:0]      _GEN_41 = {s1_tlb_req_vaddr[31:29], s1_tlb_req_vaddr[28:18] ^ 11'h400, s1_tlb_req_vaddr[15:14]};	// @[generators/rocket-chip/src/main/scala/diplomacy/Parameters.scala:137:{31,41,46}, generators/rocket-chip/src/main/scala/rocket/DCache.scala:202:29]
  wire             _GEN_42 = s1_tlb_req_vaddr[31:18] != 14'h2000;	// @[generators/rocket-chip/src/main/scala/diplomacy/Parameters.scala:137:{31,41,46,59}, generators/rocket-chip/src/main/scala/rocket/DCache.scala:202:29]
  wire [3:0]       _GEN_43 = s1_tlb_req_vaddr[3:0] & (4'h1 << s1_tlb_req_size) - 4'h1;	// @[generators/rocket-chip/src/main/scala/rocket/DCache.scala:202:29, generators/rocket-chip/src/main/scala/rocket/TLB.scala:546:{39,69}, generators/rocket-chip/src/main/scala/util/package.scala:16:47, src/main/scala/chisel3/util/OneHot.scala:58:35]
  wire             tlb__cmd_lrsc_T = s1_tlb_req_cmd == 5'h6;	// @[generators/rocket-chip/src/main/scala/rocket/DCache.scala:202:29, generators/rocket-chip/src/main/scala/util/package.scala:16:47]
  wire             tlb__cmd_lrsc_T_1 = s1_tlb_req_cmd == 5'h7;	// @[generators/rocket-chip/src/main/scala/rocket/DCache.scala:202:29, generators/rocket-chip/src/main/scala/util/package.scala:16:47]
  wire             tlb__cmd_read_T_7 = s1_tlb_req_cmd == 5'h4;	// @[generators/rocket-chip/src/main/scala/rocket/DCache.scala:202:29, generators/rocket-chip/src/main/scala/util/package.scala:16:47]
  wire             tlb__cmd_read_T_8 = s1_tlb_req_cmd == 5'h9;	// @[generators/rocket-chip/src/main/scala/rocket/DCache.scala:202:29, generators/rocket-chip/src/main/scala/util/package.scala:16:47]
  wire             tlb__cmd_read_T_9 = s1_tlb_req_cmd == 5'hA;	// @[generators/rocket-chip/src/main/scala/rocket/DCache.scala:202:29, generators/rocket-chip/src/main/scala/util/package.scala:16:47]
  wire             tlb__cmd_read_T_10 = s1_tlb_req_cmd == 5'hB;	// @[generators/rocket-chip/src/main/scala/rocket/DCache.scala:202:29, generators/rocket-chip/src/main/scala/util/package.scala:16:47]
  wire             tlb__cmd_read_T_14 = s1_tlb_req_cmd == 5'h8;	// @[generators/rocket-chip/src/main/scala/rocket/DCache.scala:202:29, generators/rocket-chip/src/main/scala/util/package.scala:16:47]
  wire             tlb__cmd_read_T_15 = s1_tlb_req_cmd == 5'hC;	// @[generators/rocket-chip/src/main/scala/rocket/DCache.scala:202:29, generators/rocket-chip/src/main/scala/util/package.scala:16:47]
  wire             tlb__cmd_read_T_16 = s1_tlb_req_cmd == 5'hD;	// @[generators/rocket-chip/src/main/scala/rocket/DCache.scala:202:29, generators/rocket-chip/src/main/scala/util/package.scala:16:47]
  wire             tlb__cmd_read_T_17 = s1_tlb_req_cmd == 5'hE;	// @[generators/rocket-chip/src/main/scala/rocket/DCache.scala:202:29, generators/rocket-chip/src/main/scala/util/package.scala:16:47]
  wire             tlb__cmd_read_T_18 = s1_tlb_req_cmd == 5'hF;	// @[generators/rocket-chip/src/main/scala/rocket/DCache.scala:202:29, generators/rocket-chip/src/main/scala/util/package.scala:16:47]
  wire             tlb_cmd_put_partial = s1_tlb_req_cmd == 5'h11;	// @[generators/rocket-chip/src/main/scala/rocket/DCache.scala:202:29, generators/rocket-chip/src/main/scala/rocket/TLB.scala:569:41]
  wire             tlb_cmd_read = s1_tlb_req_cmd == 5'h0 | s1_tlb_req_cmd == 5'h10 | tlb__cmd_lrsc_T | tlb__cmd_lrsc_T_1 | tlb__cmd_read_T_7 | tlb__cmd_read_T_8 | tlb__cmd_read_T_9 | tlb__cmd_read_T_10 | tlb__cmd_read_T_14 | tlb__cmd_read_T_15 | tlb__cmd_read_T_16 | tlb__cmd_read_T_17 | tlb__cmd_read_T_18;	// @[generators/rocket-chip/src/main/scala/rocket/Consts.scala:85:68, generators/rocket-chip/src/main/scala/rocket/DCache.scala:94:20, :202:29, generators/rocket-chip/src/main/scala/util/package.scala:16:47]
  wire             tlb_cmd_write = s1_tlb_req_cmd == 5'h1 | tlb_cmd_put_partial | tlb__cmd_lrsc_T_1 | tlb__cmd_read_T_7 | tlb__cmd_read_T_8 | tlb__cmd_read_T_9 | tlb__cmd_read_T_10 | tlb__cmd_read_T_14 | tlb__cmd_read_T_15 | tlb__cmd_read_T_16 | tlb__cmd_read_T_17 | tlb__cmd_read_T_18;	// @[generators/rocket-chip/src/main/scala/rocket/Consts.scala:86:{32,76}, generators/rocket-chip/src/main/scala/rocket/DCache.scala:202:29, generators/rocket-chip/src/main/scala/rocket/TLB.scala:546:69, :569:41, generators/rocket-chip/src/main/scala/util/package.scala:16:47]
  wire             tlb_ae_array = (|_GEN_43) & tlb_legal_address & (~(|_GEN_37) | ~(|_GEN_38) | ~(|_GEN_39) | ~(|_GEN_40) | ~(|_GEN_35) | ~(|_GEN_41)) | (tlb__cmd_lrsc_T | tlb__cmd_lrsc_T_1) & ~tlb_cacheable;	// @[generators/rocket-chip/src/main/scala/diplomacy/Parameters.scala:137:{41,46,59}, generators/rocket-chip/src/main/scala/rocket/TLB.scala:416:67, :419:19, :546:{39,77}, :578:{8,37}, :579:{8,19}, generators/rocket-chip/src/main/scala/tilelink/Parameters.scala:616:89, generators/rocket-chip/src/main/scala/util/package.scala:16:47, :73:59]
  wire [2:0]       _s2_data_T_1 = io_cpu_replay_next_0 | inWriteback | s1_did_read ? (~_io_errors_bus_valid_T | grantIsCached | ~(grantIsUncached & grantIsUncachedData) ? {1'h0, inWriteback ? releaseWay : s1_hit_way} : 3'h4) : 3'h0;	// @[generators/rocket-chip/src/main/scala/rocket/DCache.scala:253:30, :269:27, :282:26, :317:{32,61}, :371:27, :373:28, :625:24, :668:24, :669:26, :678:35, :685:34, :688:25, :807:14, :857:102, :871:18, :943:39, :1007:122, generators/rocket-chip/src/main/scala/rocket/HellaCache.scala:234:14, generators/rocket-chip/src/main/scala/util/Replacement.scala:168:70, generators/rocket-chip/src/main/scala/util/package.scala:16:47, :37:27, :73:59, src/main/scala/chisel3/util/Decoupled.scala:52:35]
  wire             _probe_bits_T = nodeOut_b_ready & auto_out_b_valid;	// @[generators/rocket-chip/src/main/scala/rocket/DCache.scala:764:44, src/main/scala/chisel3/util/Decoupled.scala:52:35]
  wire             s1_valid_not_nacked = s1_valid & ~s1_nack;	// @[generators/rocket-chip/src/main/scala/rocket/DCache.scala:176:25, :181:{38,41}, :565:36, :818:21, :833:24]
  wire [1:0]       _s1_meta_hit_state_T_9 = (_s1_meta_hit_state_T & ~s1_flush_valid ? _tag_array_RW0_rdata[21:20] : 2'h0) | (_s1_meta_hit_state_T_4 & ~s1_flush_valid ? _tag_array_RW0_rdata[43:42] : 2'h0);	// @[generators/rocket-chip/src/main/scala/rocket/DCache.scala:94:20, :209:27, :309:80, :311:83, :313:{41,59,62}, :314:19, generators/rocket-chip/src/main/scala/rocket/HellaCache.scala:234:14, generators/rocket-chip/src/main/scala/util/DescribedSRAM.scala:17:26]
  wire             _s2_victim_way_T = s1_valid_not_nacked | s1_flush_valid;	// @[generators/rocket-chip/src/main/scala/rocket/DCache.scala:181:38, :209:27, :339:29]
  wire             _GEN_44 = s2_valid_hit_pre_data_ecc_and_waw & s2_lr & ~cached_grant_wait | s2_valid_cached_miss;	// @[generators/rocket-chip/src/main/scala/rocket/DCache.scala:217:34, :227:54, :412:89, :419:60, :472:{32,54}, generators/rocket-chip/src/main/scala/util/package.scala:16:47]
  wire             advance_pstore1 = pstore1_valid & pstore2_valid == dataArb_io_in_0_bits_write;	// @[generators/rocket-chip/src/main/scala/rocket/DCache.scala:495:30, :501:38, :511:44, :516:{61,79}]
  wire             _io_cpu_perf_acquire_T = auto_out_a_ready & nodeOut_a_deq_valid;	// @[generators/rocket-chip/src/main/scala/rocket/DCache.scala:598:32, src/main/scala/chisel3/util/Decoupled.scala:52:35]
  wire             _GEN_45 = _io_cpu_perf_acquire_T & ~s2_pma_cacheable;	// @[generators/rocket-chip/src/main/scala/rocket/DCache.scala:230:33, :337:19, :418:21, :625:24, :626:24, :628:18, :629:13, src/main/scala/chisel3/util/Decoupled.scala:52:35]
  wire             _GEN_46 = _io_cpu_perf_acquire_T & s2_pma_cacheable;	// @[generators/rocket-chip/src/main/scala/rocket/DCache.scala:217:34, :337:19, :625:24, :626:24, src/main/scala/chisel3/util/Decoupled.scala:52:35]
  wire             _GEN_47 = ~_io_errors_bus_valid_T | grantIsCached | ~(grantIsUncached & grantIsUncachedData);	// @[generators/rocket-chip/src/main/scala/rocket/DCache.scala:339:48, :625:24, :668:24, :669:26, :678:35, :685:34, :689:22, generators/rocket-chip/src/main/scala/util/package.scala:16:47, :73:59, src/main/scala/chisel3/util/Decoupled.scala:52:35]
  wire             _GEN_48 = _GEN_27 & _io_cpu_perf_release_T & c_first;	// @[generators/rocket-chip/src/main/scala/rocket/DCache.scala:668:24, :857:102, :873:39, :874:26, generators/rocket-chip/src/main/scala/tilelink/Edges.scala:231:25, generators/rocket-chip/src/main/scala/util/package.scala:73:59, src/main/scala/chisel3/util/Decoupled.scala:52:35]
  always @(posedge clock) begin
    if (reset) begin
      s1_valid <= 1'h0;	// @[generators/rocket-chip/src/main/scala/rocket/DCache.scala:176:25, :269:27, :282:26, :1007:122, generators/rocket-chip/src/main/scala/rocket/HellaCache.scala:234:14]
      s1_probe <= 1'h0;	// @[generators/rocket-chip/src/main/scala/rocket/DCache.scala:177:25, :269:27, :282:26, :1007:122, generators/rocket-chip/src/main/scala/rocket/HellaCache.scala:234:14]
      cached_grant_wait <= 1'h0;	// @[generators/rocket-chip/src/main/scala/rocket/DCache.scala:217:34, :269:27, :282:26, :1007:122, generators/rocket-chip/src/main/scala/rocket/HellaCache.scala:234:14]
      resetting <= 1'h0;	// @[generators/rocket-chip/src/main/scala/rocket/DCache.scala:218:26, :269:27, :282:26, :1007:122, generators/rocket-chip/src/main/scala/rocket/HellaCache.scala:234:14]
      flushCounter <= 7'h40;	// @[generators/rocket-chip/src/main/scala/rocket/DCache.scala:219:29]
      release_ack_wait <= 1'h0;	// @[generators/rocket-chip/src/main/scala/rocket/DCache.scala:220:33, :269:27, :282:26, :1007:122, generators/rocket-chip/src/main/scala/rocket/HellaCache.scala:234:14]
      release_state <= 4'h0;	// @[generators/rocket-chip/src/main/scala/rocket/DCache.scala:222:30, generators/rocket-chip/src/main/scala/rocket/HellaCache.scala:234:14]
      uncachedInFlight_0 <= 1'h0;	// @[generators/rocket-chip/src/main/scala/rocket/DCache.scala:230:33, :269:27, :282:26, :1007:122, generators/rocket-chip/src/main/scala/rocket/HellaCache.scala:234:14]
      s2_valid <= 1'h0;	// @[generators/rocket-chip/src/main/scala/rocket/DCache.scala:269:27, :282:26, :325:25, :1007:122, generators/rocket-chip/src/main/scala/rocket/HellaCache.scala:234:14]
      s2_probe <= 1'h0;	// @[generators/rocket-chip/src/main/scala/rocket/DCache.scala:269:27, :282:26, :327:25, :1007:122, generators/rocket-chip/src/main/scala/rocket/HellaCache.scala:234:14]
      lrscCount <= 7'h0;	// @[generators/rocket-chip/src/main/scala/rocket/DCache.scala:466:26]
      pstore2_valid <= 1'h0;	// @[generators/rocket-chip/src/main/scala/rocket/DCache.scala:269:27, :282:26, :495:30, :1007:122, generators/rocket-chip/src/main/scala/rocket/HellaCache.scala:234:14]
      pstore1_held <= 1'h0;	// @[generators/rocket-chip/src/main/scala/rocket/DCache.scala:269:27, :282:26, :498:29, :1007:122, generators/rocket-chip/src/main/scala/rocket/HellaCache.scala:234:14]
      counter <= 4'h0;	// @[generators/rocket-chip/src/main/scala/rocket/HellaCache.scala:234:14, generators/rocket-chip/src/main/scala/tilelink/Edges.scala:229:27]
      grantInProgress <= 1'h0;	// @[generators/rocket-chip/src/main/scala/rocket/DCache.scala:269:27, :282:26, :661:32, :1007:122, generators/rocket-chip/src/main/scala/rocket/HellaCache.scala:234:14]
      blockProbeAfterGrantCount <= 3'h0;	// @[generators/rocket-chip/src/main/scala/rocket/DCache.scala:662:42, generators/rocket-chip/src/main/scala/util/Replacement.scala:168:70]
      counter_1 <= 4'h0;	// @[generators/rocket-chip/src/main/scala/rocket/HellaCache.scala:234:14, generators/rocket-chip/src/main/scala/tilelink/Edges.scala:229:27]
      io_cpu_perf_release_counter <= 4'h0;	// @[generators/rocket-chip/src/main/scala/rocket/HellaCache.scala:234:14, generators/rocket-chip/src/main/scala/tilelink/Edges.scala:229:27]
    end
    else begin
      s1_valid <= io_cpu_req_ready_0 & io_cpu_req_valid;	// @[generators/rocket-chip/src/main/scala/rocket/DCache.scala:176:25, :269:79, :746:68, :749:29, src/main/scala/chisel3/util/Decoupled.scala:52:35]
      s1_probe <= _GEN_31 | _probe_bits_T;	// @[generators/rocket-chip/src/main/scala/rocket/DCache.scala:177:25, :818:21, :835:44, :839:37, :840:23, :841:18, src/main/scala/chisel3/util/Decoupled.scala:52:35]
      cached_grant_wait <= ~_GEN_30 & (_GEN_46 | cached_grant_wait);	// @[generators/rocket-chip/src/main/scala/rocket/DCache.scala:217:34, :625:24, :626:24, :668:24, :669:26, :672:20, :673:27]
      resetting <= ~(resetting & flushCounterNext[7:6] == 2'h2) & (REG | resetting);	// @[generators/rocket-chip/src/main/scala/rocket/DCache.scala:218:26, :1001:{18,34,46}, :1002:39, :1003:{37,57}, :1044:20, :1046:22, :1047:17, generators/rocket-chip/src/main/scala/rocket/TLB.scala:474:82]
      if (resetting)	// @[generators/rocket-chip/src/main/scala/rocket/DCache.scala:218:26]
        flushCounter <= flushCounterNext[6:0];	// @[generators/rocket-chip/src/main/scala/rocket/DCache.scala:219:29, :1002:39, :1045:18]
      release_ack_wait <= _GEN_48 | (~_io_errors_bus_valid_T | grantIsCached | grantIsUncached | ~grantIsVoluntary) & release_ack_wait;	// @[generators/rocket-chip/src/main/scala/rocket/DCache.scala:220:33, :625:24, :659:32, :668:24, :669:26, :701:36, :703:24, :857:102, :873:39, :874:26, generators/rocket-chip/src/main/scala/util/package.scala:73:59, src/main/scala/chisel3/util/Decoupled.scala:52:35]
      if (~metaArb__grant_T_2 & metaArb_io_in_4_valid)	// @[generators/rocket-chip/src/main/scala/util/package.scala:73:59, src/main/scala/chisel3/util/Arbiter.scala:45:{68,78}, src/main/scala/chisel3/util/Decoupled.scala:52:35]
        release_state <= 4'h0;	// @[generators/rocket-chip/src/main/scala/rocket/DCache.scala:222:30, generators/rocket-chip/src/main/scala/rocket/HellaCache.scala:234:14]
      else if (_GEN_27) begin	// @[generators/rocket-chip/src/main/scala/util/package.scala:73:59]
        if (releaseDone)	// @[generators/rocket-chip/src/main/scala/tilelink/Edges.scala:233:22]
          release_state <= 4'h6;	// @[generators/rocket-chip/src/main/scala/rocket/DCache.scala:222:30, generators/rocket-chip/src/main/scala/util/package.scala:16:47]
        else if (_GEN_26) begin	// @[generators/rocket-chip/src/main/scala/rocket/DCache.scala:848:25]
          if (_GEN_25) begin	// @[generators/rocket-chip/src/main/scala/rocket/DCache.scala:844:25]
            if (releaseDone | _GEN_31)	// @[generators/rocket-chip/src/main/scala/rocket/DCache.scala:818:21, :835:44, :839:37, :840:23, :846:{26,42}, generators/rocket-chip/src/main/scala/tilelink/Edges.scala:233:22]
              release_state <= 4'h0;	// @[generators/rocket-chip/src/main/scala/rocket/DCache.scala:222:30, generators/rocket-chip/src/main/scala/rocket/HellaCache.scala:234:14]
            else if (s2_probe)	// @[generators/rocket-chip/src/main/scala/rocket/DCache.scala:327:25]
              release_state <= _GEN_29;	// @[generators/rocket-chip/src/main/scala/rocket/DCache.scala:222:30, :822:36, :823:23, :824:45]
            else if (s2_want_victimize)	// @[generators/rocket-chip/src/main/scala/rocket/DCache.scala:421:123]
              release_state <= _release_state_T_14;	// @[generators/rocket-chip/src/main/scala/rocket/DCache.scala:222:30, :813:27]
          end
          else if (_GEN_31)	// @[generators/rocket-chip/src/main/scala/rocket/DCache.scala:818:21, :835:44, :839:37, :840:23]
            release_state <= 4'h0;	// @[generators/rocket-chip/src/main/scala/rocket/DCache.scala:222:30, generators/rocket-chip/src/main/scala/rocket/HellaCache.scala:234:14]
          else if (s2_probe) begin	// @[generators/rocket-chip/src/main/scala/rocket/DCache.scala:327:25]
            if (s2_prb_ack_data)	// @[generators/rocket-chip/src/main/scala/util/Misc.scala:38:9]
              release_state <= 4'h2;	// @[generators/rocket-chip/src/main/scala/rocket/DCache.scala:222:30, generators/rocket-chip/src/main/scala/util/package.scala:16:47]
            else if (|s2_probe_state_state)	// @[generators/rocket-chip/src/main/scala/rocket/DCache.scala:378:33, generators/rocket-chip/src/main/scala/tilelink/Metadata.scala:50:45]
              release_state <= 4'h3;	// @[generators/rocket-chip/src/main/scala/rocket/DCache.scala:222:30, :827:29]
            else if (releaseDone)	// @[generators/rocket-chip/src/main/scala/tilelink/Edges.scala:233:22]
              release_state <= 4'h0;	// @[generators/rocket-chip/src/main/scala/rocket/DCache.scala:222:30, generators/rocket-chip/src/main/scala/rocket/HellaCache.scala:234:14]
            else	// @[generators/rocket-chip/src/main/scala/tilelink/Edges.scala:233:22]
              release_state <= 4'h5;	// @[generators/rocket-chip/src/main/scala/rocket/DCache.scala:222:30, :831:29]
          end
          else if (s2_want_victimize)	// @[generators/rocket-chip/src/main/scala/rocket/DCache.scala:421:123]
            release_state <= _release_state_T_14;	// @[generators/rocket-chip/src/main/scala/rocket/DCache.scala:222:30, :813:27]
        end
        else if (_GEN_32)	// @[generators/rocket-chip/src/main/scala/rocket/DCache.scala:818:21, :835:44, :839:37, :840:23, :844:47, :846:{26,42}]
          release_state <= 4'h0;	// @[generators/rocket-chip/src/main/scala/rocket/DCache.scala:222:30, generators/rocket-chip/src/main/scala/rocket/HellaCache.scala:234:14]
        else if (s2_probe) begin	// @[generators/rocket-chip/src/main/scala/rocket/DCache.scala:327:25]
          if (s2_prb_ack_data)	// @[generators/rocket-chip/src/main/scala/util/Misc.scala:38:9]
            release_state <= 4'h2;	// @[generators/rocket-chip/src/main/scala/rocket/DCache.scala:222:30, generators/rocket-chip/src/main/scala/util/package.scala:16:47]
          else if (|s2_probe_state_state)	// @[generators/rocket-chip/src/main/scala/rocket/DCache.scala:378:33, generators/rocket-chip/src/main/scala/tilelink/Metadata.scala:50:45]
            release_state <= _release_state_T_15;	// @[generators/rocket-chip/src/main/scala/rocket/DCache.scala:222:30, :827:29]
          else if (releaseDone)	// @[generators/rocket-chip/src/main/scala/tilelink/Edges.scala:233:22]
            release_state <= 4'h0;	// @[generators/rocket-chip/src/main/scala/rocket/DCache.scala:222:30, generators/rocket-chip/src/main/scala/rocket/HellaCache.scala:234:14]
          else	// @[generators/rocket-chip/src/main/scala/tilelink/Edges.scala:233:22]
            release_state <= 4'h5;	// @[generators/rocket-chip/src/main/scala/rocket/DCache.scala:222:30, :831:29]
        end
        else if (s2_want_victimize)	// @[generators/rocket-chip/src/main/scala/rocket/DCache.scala:421:123]
          release_state <= _release_state_T_14;	// @[generators/rocket-chip/src/main/scala/rocket/DCache.scala:222:30, :813:27]
      end
      else if (_inWriteback_T_1) begin	// @[generators/rocket-chip/src/main/scala/util/package.scala:16:47]
        if (releaseDone)	// @[generators/rocket-chip/src/main/scala/tilelink/Edges.scala:233:22]
          release_state <= 4'h7;	// @[generators/rocket-chip/src/main/scala/rocket/DCache.scala:222:30, :827:29]
        else if (_GEN_32)	// @[generators/rocket-chip/src/main/scala/rocket/DCache.scala:818:21, :835:44, :839:37, :840:23, :844:47, :846:{26,42}]
          release_state <= 4'h0;	// @[generators/rocket-chip/src/main/scala/rocket/DCache.scala:222:30, generators/rocket-chip/src/main/scala/rocket/HellaCache.scala:234:14]
        else if (s2_probe)	// @[generators/rocket-chip/src/main/scala/rocket/DCache.scala:327:25]
          release_state <= _GEN_29;	// @[generators/rocket-chip/src/main/scala/rocket/DCache.scala:222:30, :822:36, :823:23, :824:45]
        else if (s2_want_victimize)	// @[generators/rocket-chip/src/main/scala/rocket/DCache.scala:421:123]
          release_state <= _release_state_T_14;	// @[generators/rocket-chip/src/main/scala/rocket/DCache.scala:222:30, :813:27]
      end
      else if (_GEN_26) begin	// @[generators/rocket-chip/src/main/scala/rocket/DCache.scala:848:25]
        if (releaseDone)	// @[generators/rocket-chip/src/main/scala/tilelink/Edges.scala:233:22]
          release_state <= 4'h7;	// @[generators/rocket-chip/src/main/scala/rocket/DCache.scala:222:30, :827:29]
        else if (_GEN_32)	// @[generators/rocket-chip/src/main/scala/rocket/DCache.scala:818:21, :835:44, :839:37, :840:23, :844:47, :846:{26,42}]
          release_state <= 4'h0;	// @[generators/rocket-chip/src/main/scala/rocket/DCache.scala:222:30, generators/rocket-chip/src/main/scala/rocket/HellaCache.scala:234:14]
        else if (s2_probe)	// @[generators/rocket-chip/src/main/scala/rocket/DCache.scala:327:25]
          release_state <= _GEN_29;	// @[generators/rocket-chip/src/main/scala/rocket/DCache.scala:222:30, :822:36, :823:23, :824:45]
        else if (s2_want_victimize)	// @[generators/rocket-chip/src/main/scala/rocket/DCache.scala:421:123]
          release_state <= _release_state_T_14;	// @[generators/rocket-chip/src/main/scala/rocket/DCache.scala:222:30, :813:27]
      end
      else if (_GEN_32)	// @[generators/rocket-chip/src/main/scala/rocket/DCache.scala:818:21, :835:44, :839:37, :840:23, :844:47, :846:{26,42}]
        release_state <= 4'h0;	// @[generators/rocket-chip/src/main/scala/rocket/DCache.scala:222:30, generators/rocket-chip/src/main/scala/rocket/HellaCache.scala:234:14]
      else if (s2_probe) begin	// @[generators/rocket-chip/src/main/scala/rocket/DCache.scala:327:25]
        if (s2_prb_ack_data)	// @[generators/rocket-chip/src/main/scala/util/Misc.scala:38:9]
          release_state <= 4'h2;	// @[generators/rocket-chip/src/main/scala/rocket/DCache.scala:222:30, generators/rocket-chip/src/main/scala/util/package.scala:16:47]
        else if (|s2_probe_state_state)	// @[generators/rocket-chip/src/main/scala/rocket/DCache.scala:378:33, generators/rocket-chip/src/main/scala/tilelink/Metadata.scala:50:45]
          release_state <= _release_state_T_15;	// @[generators/rocket-chip/src/main/scala/rocket/DCache.scala:222:30, :827:29]
        else if (releaseDone)	// @[generators/rocket-chip/src/main/scala/tilelink/Edges.scala:233:22]
          release_state <= 4'h0;	// @[generators/rocket-chip/src/main/scala/rocket/DCache.scala:222:30, generators/rocket-chip/src/main/scala/rocket/HellaCache.scala:234:14]
        else	// @[generators/rocket-chip/src/main/scala/tilelink/Edges.scala:233:22]
          release_state <= 4'h5;	// @[generators/rocket-chip/src/main/scala/rocket/DCache.scala:222:30, :831:29]
      end
      else if (s2_want_victimize)	// @[generators/rocket-chip/src/main/scala/rocket/DCache.scala:421:123]
        release_state <= _release_state_T_14;	// @[generators/rocket-chip/src/main/scala/rocket/DCache.scala:222:30, :813:27]
      uncachedInFlight_0 <= (~_io_errors_bus_valid_T | grantIsCached | ~(grantIsUncached & _GEN_19)) & (_GEN_45 | uncachedInFlight_0);	// @[generators/rocket-chip/src/main/scala/rocket/DCache.scala:230:33, :625:24, :626:24, :628:18, :629:13, :668:24, :669:26, :678:35, :680:{17,28}, :682:13, generators/rocket-chip/src/main/scala/util/package.scala:73:59, src/main/scala/chisel3/util/Decoupled.scala:52:35]
      s2_valid <= s1_valid_masked & ~(s1_req_cmd == 5'h14 | s1_req_cmd == 5'h15 | s1_req_cmd == 5'h16);	// @[generators/rocket-chip/src/main/scala/rocket/DCache.scala:180:34, :190:25, :207:{30,57,71,85}, :325:{25,42,45}]
      s2_probe <= s1_probe;	// @[generators/rocket-chip/src/main/scala/rocket/DCache.scala:177:25, :327:25]
      if (s1_probe)	// @[generators/rocket-chip/src/main/scala/rocket/DCache.scala:177:25]
        lrscCount <= 7'h0;	// @[generators/rocket-chip/src/main/scala/rocket/DCache.scala:466:26]
      else if (s2_valid_masked & (|(lrscCount[6:2])))	// @[generators/rocket-chip/src/main/scala/rocket/DCache.scala:331:42, :466:26, :467:29, :477:29]
        lrscCount <= 7'h3;	// @[generators/rocket-chip/src/main/scala/rocket/DCache.scala:466:26]
      else if (|lrscCount)	// @[generators/rocket-chip/src/main/scala/rocket/DCache.scala:466:26, :468:34]
        lrscCount <= lrscCount - 7'h1;	// @[generators/rocket-chip/src/main/scala/rocket/DCache.scala:466:26, :476:51]
      else if (_GEN_44)	// @[generators/rocket-chip/src/main/scala/rocket/DCache.scala:472:54]
        lrscCount <= s2_hit ? 7'h4F : 7'h0;	// @[generators/rocket-chip/src/main/scala/rocket/DCache.scala:466:26, :473:21, generators/rocket-chip/src/main/scala/util/Misc.scala:35:9]
      pstore2_valid <= pstore2_valid & ~dataArb_io_in_0_bits_write | advance_pstore1;	// @[generators/rocket-chip/src/main/scala/rocket/DCache.scala:495:30, :511:44, :515:91, :516:61, :517:{34,51}]
      pstore1_held <= (_pstore1_held_T & ~s2_sc_fail | pstore1_held) & pstore2_valid & ~dataArb_io_in_0_bits_write;	// @[generators/rocket-chip/src/main/scala/rocket/DCache.scala:471:26, :484:{46,58,61}, :495:30, :498:29, :511:44, :515:{54,88,91}]
      if (_io_errors_bus_valid_T) begin	// @[src/main/scala/chisel3/util/Decoupled.scala:52:35]
        if (|counter)	// @[generators/rocket-chip/src/main/scala/tilelink/Edges.scala:229:27, :231:25]
          counter <= _counter1_T;	// @[generators/rocket-chip/src/main/scala/tilelink/Edges.scala:229:27, :230:28]
        else	// @[generators/rocket-chip/src/main/scala/tilelink/Edges.scala:231:25]
          counter <= beats1;	// @[generators/rocket-chip/src/main/scala/tilelink/Edges.scala:221:14, :229:27]
      end
      if (_GEN_18)	// @[generators/rocket-chip/src/main/scala/rocket/DCache.scala:669:26]
        grantInProgress <= ~d_last;	// @[generators/rocket-chip/src/main/scala/rocket/DCache.scala:661:32, :670:23, :672:20, :674:25, generators/rocket-chip/src/main/scala/tilelink/Edges.scala:232:33]
      if (_GEN_30)	// @[generators/rocket-chip/src/main/scala/rocket/DCache.scala:625:24, :668:24, :669:26, :672:20, :673:27]
        blockProbeAfterGrantCount <= 3'h7;	// @[generators/rocket-chip/src/main/scala/rocket/DCache.scala:662:42, generators/rocket-chip/src/main/scala/util/package.scala:16:47]
      else if (|blockProbeAfterGrantCount)	// @[generators/rocket-chip/src/main/scala/rocket/DCache.scala:662:42, :663:35]
        blockProbeAfterGrantCount <= blockProbeAfterGrantCount - 3'h1;	// @[generators/rocket-chip/src/main/scala/rocket/DCache.scala:662:42, :663:99]
      if (_io_cpu_perf_release_T) begin	// @[src/main/scala/chisel3/util/Decoupled.scala:52:35]
        if (c_first)	// @[generators/rocket-chip/src/main/scala/tilelink/Edges.scala:231:25]
          counter_1 <= beats1_1;	// @[generators/rocket-chip/src/main/scala/tilelink/Edges.scala:221:14, :229:27]
        else	// @[generators/rocket-chip/src/main/scala/tilelink/Edges.scala:231:25]
          counter_1 <= _counter1_T_1;	// @[generators/rocket-chip/src/main/scala/tilelink/Edges.scala:229:27, :230:28]
        if (io_cpu_perf_release_counter == 4'h0)	// @[generators/rocket-chip/src/main/scala/rocket/HellaCache.scala:234:14, generators/rocket-chip/src/main/scala/tilelink/Edges.scala:229:27, :231:25]
          io_cpu_perf_release_counter <= io_cpu_perf_release_beats1;	// @[generators/rocket-chip/src/main/scala/tilelink/Edges.scala:221:14, :229:27]
        else	// @[generators/rocket-chip/src/main/scala/tilelink/Edges.scala:231:25]
          io_cpu_perf_release_counter <= io_cpu_perf_release_counter - 4'h1;	// @[generators/rocket-chip/src/main/scala/tilelink/Edges.scala:229:27, :230:28]
      end
    end
    if (s2_want_victimize) begin	// @[generators/rocket-chip/src/main/scala/rocket/DCache.scala:421:123]
      probe_bits_param <= 2'h0;	// @[generators/rocket-chip/src/main/scala/rocket/DCache.scala:94:20, :178:29, generators/rocket-chip/src/main/scala/rocket/HellaCache.scala:234:14]
      probe_bits_size <= 3'h0;	// @[generators/rocket-chip/src/main/scala/rocket/DCache.scala:178:29, generators/rocket-chip/src/main/scala/util/Replacement.scala:168:70]
      probe_bits_address <= {s2_valid_flush_line ? s2_req_addr[31:12] : (s2_victim_way_r ? 20'h0 : s2_meta_corrected_r[19:0]) | (s2_victim_way_r ? s2_meta_corrected_r_1[19:0] : 20'h0), s2_req_addr[11:6], 6'h0};	// @[generators/rocket-chip/src/main/scala/rocket/DCache.scala:178:29, :333:19, :355:{61,99}, :413:75, :425:41, :427:{26,82}, :816:{76,96}, generators/rocket-chip/src/main/scala/rocket/HellaCache.scala:300:14, generators/rocket-chip/src/main/scala/rocket/TLB.scala:516:74, src/main/scala/chisel3/util/Mux.scala:30:73]
    end
    else if (_probe_bits_T) begin	// @[src/main/scala/chisel3/util/Decoupled.scala:52:35]
      probe_bits_param <= auto_out_b_bits_param;	// @[generators/rocket-chip/src/main/scala/rocket/DCache.scala:178:29]
      probe_bits_size <= auto_out_b_bits_size;	// @[generators/rocket-chip/src/main/scala/rocket/DCache.scala:178:29]
      probe_bits_address <= auto_out_b_bits_address;	// @[generators/rocket-chip/src/main/scala/rocket/DCache.scala:178:29]
    end
    probe_bits_source <= ~s2_want_victimize & (_probe_bits_T ? auto_out_b_bits_source : probe_bits_source);	// @[generators/rocket-chip/src/main/scala/rocket/DCache.scala:178:29, :421:123, :810:25, :816:18, src/main/scala/chisel3/util/Decoupled.scala:52:35]
    if (metaArb_io_out_valid & ~metaArb_io_out_bits_write) begin	// @[generators/rocket-chip/src/main/scala/rocket/DCache.scala:184:{40,43}, src/main/scala/chisel3/util/Arbiter.scala:139:26, :141:19, :148:31]
      s1_vaddr <= s0_tlb_req_vaddr;	// @[generators/rocket-chip/src/main/scala/rocket/DCache.scala:187:21, :190:25]
      s1_req_tag <= io_cpu_req_bits_tag;	// @[generators/rocket-chip/src/main/scala/rocket/DCache.scala:190:25]
      s1_req_cmd <= io_cpu_req_bits_cmd;	// @[generators/rocket-chip/src/main/scala/rocket/DCache.scala:190:25]
      s1_req_size <= io_cpu_req_bits_size;	// @[generators/rocket-chip/src/main/scala/rocket/DCache.scala:190:25]
      s1_req_signed <= io_cpu_req_bits_signed;	// @[generators/rocket-chip/src/main/scala/rocket/DCache.scala:190:25]
      s1_req_dprv <= 2'h3;	// @[generators/rocket-chip/src/main/scala/rocket/DCache.scala:190:25, generators/rocket-chip/src/main/scala/rocket/HellaCache.scala:234:14]
      s1_req_dv <= io_cpu_req_bits_dv;	// @[generators/rocket-chip/src/main/scala/rocket/DCache.scala:190:25]
      s1_tlb_req_vaddr <= s0_tlb_req_vaddr;	// @[generators/rocket-chip/src/main/scala/rocket/DCache.scala:187:21, :202:29]
      s1_tlb_req_size <= io_cpu_req_bits_size;	// @[generators/rocket-chip/src/main/scala/rocket/DCache.scala:202:29]
      s1_tlb_req_cmd <= io_cpu_req_bits_cmd;	// @[generators/rocket-chip/src/main/scala/rocket/DCache.scala:202:29]
      s1_tlb_req_prv <= 2'h3;	// @[generators/rocket-chip/src/main/scala/rocket/DCache.scala:202:29, generators/rocket-chip/src/main/scala/rocket/HellaCache.scala:234:14]
      s1_did_read <= ~dataArb__grant_T_1 & io_cpu_req_valid & (_pstore_drain_opportunistic_T | _pstore_drain_opportunistic_T_1 | _pstore_drain_opportunistic_T_2 | _pstore_drain_opportunistic_T_28 | _pstore_drain_opportunistic_T_30 | _pstore_drain_opportunistic_T_31 | _pstore_drain_opportunistic_T_32 | _pstore_drain_opportunistic_T_33 | _pstore_drain_opportunistic_T_37 | _pstore_drain_opportunistic_T_38 | _pstore_drain_opportunistic_T_39 | _pstore_drain_opportunistic_T_40 | _pstore_drain_opportunistic_T_41 | (_pstore_drain_opportunistic_T_25 | _pstore_drain_opportunistic_T_50 | _pstore_drain_opportunistic_T_28 | _pstore_drain_opportunistic_T_30 | _pstore_drain_opportunistic_T_31 | _pstore_drain_opportunistic_T_32 | _pstore_drain_opportunistic_T_33 | _pstore_drain_opportunistic_T_37 | _pstore_drain_opportunistic_T_38 | _pstore_drain_opportunistic_T_39 | _pstore_drain_opportunistic_T_40 | _pstore_drain_opportunistic_T_41) & _pstore_drain_opportunistic_T_50);	// @[generators/rocket-chip/src/main/scala/rocket/Consts.scala:86:{49,76}, generators/rocket-chip/src/main/scala/rocket/DCache.scala:253:{30,54}, :1183:21, :1184:23, generators/rocket-chip/src/main/scala/util/package.scala:16:47, src/main/scala/chisel3/util/Arbiter.scala:45:{68,78}]
    end
    s1_flush_valid <= 1'h0;	// @[generators/rocket-chip/src/main/scala/rocket/DCache.scala:209:27, :269:27, :282:26, :1007:122, generators/rocket-chip/src/main/scala/rocket/HellaCache.scala:234:14]
    if (_GEN_48)	// @[generators/rocket-chip/src/main/scala/rocket/DCache.scala:668:24, :857:102, :873:39, :874:26]
      release_ack_addr <= probe_bits_address;	// @[generators/rocket-chip/src/main/scala/rocket/DCache.scala:178:29, :221:29]
    if (_GEN_46)	// @[generators/rocket-chip/src/main/scala/rocket/DCache.scala:217:34, :223:23, :625:24, :626:24]
      refill_way <= metaArb_io_in_2_bits_way_en;	// @[generators/rocket-chip/src/main/scala/rocket/DCache.scala:223:23, :426:33]
    if (_GEN_45) begin	// @[generators/rocket-chip/src/main/scala/rocket/DCache.scala:230:33, :625:24, :626:24, :628:18, :629:13]
      uncachedReqs_0_addr <= s2_req_addr;	// @[generators/rocket-chip/src/main/scala/rocket/DCache.scala:231:25, :333:19]
      uncachedReqs_0_tag <= s2_req_tag;	// @[generators/rocket-chip/src/main/scala/rocket/DCache.scala:231:25, :333:19]
      uncachedReqs_0_size <= s2_req_size;	// @[generators/rocket-chip/src/main/scala/rocket/DCache.scala:231:25, :333:19]
      uncachedReqs_0_signed <= s2_req_signed;	// @[generators/rocket-chip/src/main/scala/rocket/DCache.scala:231:25, :333:19]
    end
    s2_not_nacked_in_s1 <= ~s1_nack;	// @[generators/rocket-chip/src/main/scala/rocket/DCache.scala:181:41, :329:36, :565:36, :818:21, :833:24]
    if (_GEN_47) begin	// @[generators/rocket-chip/src/main/scala/rocket/DCache.scala:339:48, :668:24, :669:26]
      if (_s2_victim_way_T) begin	// @[generators/rocket-chip/src/main/scala/rocket/DCache.scala:339:29]
        s2_req_addr <= {s1_tlb_req_vaddr[31:12], s1_vaddr[11:0]};	// @[generators/rocket-chip/src/main/scala/rocket/DCache.scala:190:25, :191:78, :202:29, :292:{21,99}, :333:19]
        s2_req_tag <= s1_req_tag;	// @[generators/rocket-chip/src/main/scala/rocket/DCache.scala:190:25, :333:19]
        s2_req_cmd <= s1_req_cmd;	// @[generators/rocket-chip/src/main/scala/rocket/DCache.scala:190:25, :333:19]
        s2_req_size <= s1_req_size;	// @[generators/rocket-chip/src/main/scala/rocket/DCache.scala:190:25, :333:19]
        s2_req_signed <= s1_req_signed;	// @[generators/rocket-chip/src/main/scala/rocket/DCache.scala:190:25, :333:19]
      end
    end
    else begin	// @[generators/rocket-chip/src/main/scala/rocket/DCache.scala:339:48, :668:24, :669:26]
      s2_req_addr <= {s1_tlb_req_vaddr[31:12], s1_vaddr[11:2], uncachedReqs_0_addr[1:0]};	// @[generators/rocket-chip/src/main/scala/rocket/DCache.scala:190:25, :202:29, :231:25, :292:99, :333:19, :695:41, :696:{26,45}]
      s2_req_tag <= uncachedReqs_0_tag;	// @[generators/rocket-chip/src/main/scala/rocket/DCache.scala:231:25, :333:19]
      s2_req_cmd <= 5'h0;	// @[generators/rocket-chip/src/main/scala/rocket/DCache.scala:94:20, :333:19]
      s2_req_size <= uncachedReqs_0_size;	// @[generators/rocket-chip/src/main/scala/rocket/DCache.scala:231:25, :333:19]
      s2_req_signed <= uncachedReqs_0_signed;	// @[generators/rocket-chip/src/main/scala/rocket/DCache.scala:231:25, :333:19]
    end
    if (_s2_victim_way_T) begin	// @[generators/rocket-chip/src/main/scala/rocket/DCache.scala:339:29]
      s2_req_dprv <= s1_req_dprv;	// @[generators/rocket-chip/src/main/scala/rocket/DCache.scala:190:25, :333:19]
      s2_req_dv <= s1_req_dv;	// @[generators/rocket-chip/src/main/scala/rocket/DCache.scala:190:25, :333:19]
      s2_tlb_xcpt_ae_ld <= tlb_cmd_read & (tlb_ae_array | ~(tlb_legal_address & ~tlb_deny_access_to_debug));	// @[generators/rocket-chip/src/main/scala/rocket/Consts.scala:85:68, generators/rocket-chip/src/main/scala/rocket/DCache.scala:336:24, generators/rocket-chip/src/main/scala/rocket/TLB.scala:416:67, :424:50, :425:{41,44}, :578:37, :582:{24,44,46}]
      s2_tlb_xcpt_ae_st <= (tlb_cmd_write | s1_tlb_req_cmd == 5'h5 | s1_tlb_req_cmd == 5'h17) & (tlb_ae_array | ~(tlb_legal_address & (~(|_GEN_37) | ~(|_GEN_38) | ~(|_GEN_39) | ~(|_GEN_40) | ~(|_GEN_35) | ~(|_GEN_41) | ~_GEN_42) & ~tlb_deny_access_to_debug)) | tlb_cmd_put_partial & ~(tlb_legal_address & (~(|_GEN_37) | ~(|_GEN_38) | ~(|_GEN_39) | ~(|_GEN_40) | ~(|_GEN_35) | ~(|_GEN_41) | ~_GEN_42) | tlb_cacheable) | (tlb__cmd_read_T_7 | tlb__cmd_read_T_8 | tlb__cmd_read_T_9 | tlb__cmd_read_T_10) & ~(tlb_legal_address & (~(|_GEN_37) | ~(|_GEN_38) | ~(|_GEN_39) | ~(|_GEN_40) | ~(|_GEN_35) | ~(|_GEN_41)) | tlb_cacheable) | (tlb__cmd_read_T_14 | tlb__cmd_read_T_15 | tlb__cmd_read_T_16 | tlb__cmd_read_T_17 | tlb__cmd_read_T_18) & ~(tlb_legal_address & (~(|_GEN_37) | ~(|_GEN_38) | ~(|_GEN_39) | ~(|_GEN_40) | ~(|_GEN_35) | ~(|_GEN_41)) | tlb_cacheable);	// @[generators/rocket-chip/src/main/scala/diplomacy/Parameters.scala:137:{41,46,59}, generators/rocket-chip/src/main/scala/rocket/Consts.scala:86:76, generators/rocket-chip/src/main/scala/rocket/DCache.scala:202:29, :336:24, generators/rocket-chip/src/main/scala/rocket/TLB.scala:416:67, :419:19, :424:50, :425:44, :426:45, :540:39, :541:39, :542:39, :569:41, :573:35, :578:37, :584:{8,35,37}, :585:{8,26}, :586:{8,26,53}, :587:{8,29}, generators/rocket-chip/src/main/scala/tilelink/Parameters.scala:616:89, generators/rocket-chip/src/main/scala/util/package.scala:16:47, :73:59]
      s2_tlb_xcpt_ma_ld <= (|_GEN_43) & tlb_cmd_read;	// @[generators/rocket-chip/src/main/scala/rocket/Consts.scala:85:68, generators/rocket-chip/src/main/scala/rocket/DCache.scala:336:24, generators/rocket-chip/src/main/scala/rocket/TLB.scala:546:{39,77}, :641:31]
      s2_tlb_xcpt_ma_st <= (|_GEN_43) & tlb_cmd_write;	// @[generators/rocket-chip/src/main/scala/rocket/Consts.scala:86:76, generators/rocket-chip/src/main/scala/rocket/DCache.scala:336:24, generators/rocket-chip/src/main/scala/rocket/TLB.scala:546:{39,77}, :642:31]
      s2_pma_cacheable <= tlb_cacheable;	// @[generators/rocket-chip/src/main/scala/rocket/DCache.scala:337:19, generators/rocket-chip/src/main/scala/rocket/TLB.scala:419:19]
      s2_vaddr_r <= s1_vaddr;	// @[generators/rocket-chip/src/main/scala/rocket/DCache.scala:190:25, :345:31]
      s2_hit_state_state <= _s1_meta_hit_state_T_9;	// @[generators/rocket-chip/src/main/scala/rocket/DCache.scala:314:19, :380:31]
      s2_victim_way_r <= _lfsr_prng_io_out_0;	// @[generators/rocket-chip/src/main/scala/rocket/DCache.scala:425:41, src/main/scala/chisel3/util/random/PRNG.scala:91:22]
    end
    s2_tlb_xcpt_pf_ld <= ~_s2_victim_way_T & s2_tlb_xcpt_pf_ld;	// @[generators/rocket-chip/src/main/scala/rocket/DCache.scala:336:24, :339:{29,48}, :342:17]
    s2_tlb_xcpt_pf_st <= ~_s2_victim_way_T & s2_tlb_xcpt_pf_st;	// @[generators/rocket-chip/src/main/scala/rocket/DCache.scala:336:24, :339:{29,48}, :342:17]
    if (_GEN_47) begin	// @[generators/rocket-chip/src/main/scala/rocket/DCache.scala:338:34, :339:48, :668:24, :669:26]
    end
    else	// @[generators/rocket-chip/src/main/scala/rocket/DCache.scala:338:34, :668:24, :669:26]
      s2_uncached_resp_addr <= uncachedReqs_0_addr;	// @[generators/rocket-chip/src/main/scala/rocket/DCache.scala:231:25, :338:34]
    s2_flush_valid_pre_tag_ecc <= s1_flush_valid;	// @[generators/rocket-chip/src/main/scala/rocket/DCache.scala:209:27, :349:43]
    if (_s2_victim_way_T | s1_probe) begin	// @[generators/rocket-chip/src/main/scala/rocket/DCache.scala:177:25, :339:29, :351:62]
      s2_meta_corrected_r <= _tag_array_RW0_rdata[21:0];	// @[generators/rocket-chip/src/main/scala/rocket/DCache.scala:355:61, generators/rocket-chip/src/main/scala/util/DescribedSRAM.scala:17:26]
      s2_meta_corrected_r_1 <= _tag_array_RW0_rdata[43:22];	// @[generators/rocket-chip/src/main/scala/rocket/DCache.scala:355:61, generators/rocket-chip/src/main/scala/util/DescribedSRAM.scala:17:26]
    end
    if (s1_valid | inWriteback | io_cpu_replay_next_0)	// @[generators/rocket-chip/src/main/scala/rocket/DCache.scala:176:25, :360:38, :943:39, generators/rocket-chip/src/main/scala/util/package.scala:73:59]
      s2_data <= (_s2_data_T_1[0] ? _data_io_resp_0 : 32'h0) | (_s2_data_T_1[1] ? _data_io_resp_1 : 32'h0) | (_s2_data_T_1[2] ? auto_out_d_bits_data : 32'h0);	// @[generators/rocket-chip/src/main/scala/rocket/DCache.scala:94:20, :139:20, :373:{18,28}, generators/rocket-chip/src/main/scala/rocket/HellaCache.scala:234:14, src/main/scala/chisel3/util/Mux.scala:30:73, :32:36]
    if (s1_probe) begin	// @[generators/rocket-chip/src/main/scala/rocket/DCache.scala:177:25]
      s2_probe_way <= s1_hit_way;	// @[generators/rocket-chip/src/main/scala/rocket/DCache.scala:377:31, generators/rocket-chip/src/main/scala/util/package.scala:37:27]
      s2_probe_state_state <= _s1_meta_hit_state_T_9;	// @[generators/rocket-chip/src/main/scala/rocket/DCache.scala:314:19, :378:33]
    end
    if (s1_valid_not_nacked)	// @[generators/rocket-chip/src/main/scala/rocket/DCache.scala:181:38]
      s2_hit_way <= s1_hit_way;	// @[generators/rocket-chip/src/main/scala/rocket/DCache.scala:379:29, generators/rocket-chip/src/main/scala/util/package.scala:37:27]
    if (_GEN_44)	// @[generators/rocket-chip/src/main/scala/rocket/DCache.scala:472:54]
      lrscAddr <= s2_req_addr[31:6];	// @[generators/rocket-chip/src/main/scala/rocket/DCache.scala:333:19, :469:21, :470:49]
    if (s1_valid_not_nacked & s1_write) begin	// @[generators/rocket-chip/src/main/scala/rocket/Consts.scala:86:76, generators/rocket-chip/src/main/scala/rocket/DCache.scala:181:38, :486:63]
      pstore1_cmd <= s1_req_cmd;	// @[generators/rocket-chip/src/main/scala/rocket/DCache.scala:190:25, :486:30]
      pstore1_addr <= s1_vaddr;	// @[generators/rocket-chip/src/main/scala/rocket/DCache.scala:190:25, :487:31]
      pstore1_data <= io_cpu_s1_data_data;	// @[generators/rocket-chip/src/main/scala/rocket/DCache.scala:488:31]
      pstore1_way <= s1_hit_way;	// @[generators/rocket-chip/src/main/scala/rocket/DCache.scala:489:30, generators/rocket-chip/src/main/scala/util/package.scala:37:27]
      pstore1_mask <= _io_cpu_perf_canAcceptLoadThenLoad_T_51 ? io_cpu_s1_data_mask : s1_mask_xwr;	// @[generators/rocket-chip/src/main/scala/rocket/AMOALU.scala:22:16, generators/rocket-chip/src/main/scala/rocket/Consts.scala:86:49, generators/rocket-chip/src/main/scala/rocket/DCache.scala:321:20, :490:31]
      pstore1_rmw <= _io_cpu_perf_canAcceptLoadThenLoad_T_1 | _io_cpu_perf_canAcceptLoadThenLoad_T_2 | _io_cpu_perf_canAcceptLoadThenLoad_T_3 | _io_cpu_perf_canAcceptLoadThenLoad_T_29 | _io_cpu_perf_canAcceptLoadThenLoad_T_31 | _io_cpu_perf_canAcceptLoadThenLoad_T_32 | _io_cpu_perf_canAcceptLoadThenLoad_T_33 | _io_cpu_perf_canAcceptLoadThenLoad_T_34 | _io_cpu_perf_canAcceptLoadThenLoad_T_38 | _io_cpu_perf_canAcceptLoadThenLoad_T_39 | _io_cpu_perf_canAcceptLoadThenLoad_T_40 | _io_cpu_perf_canAcceptLoadThenLoad_T_41 | _io_cpu_perf_canAcceptLoadThenLoad_T_42 | (_io_cpu_perf_canAcceptLoadThenLoad_T_26 | _io_cpu_perf_canAcceptLoadThenLoad_T_51 | _io_cpu_perf_canAcceptLoadThenLoad_T_29 | _io_cpu_perf_canAcceptLoadThenLoad_T_31 | _io_cpu_perf_canAcceptLoadThenLoad_T_32 | _io_cpu_perf_canAcceptLoadThenLoad_T_33 | _io_cpu_perf_canAcceptLoadThenLoad_T_34 | _io_cpu_perf_canAcceptLoadThenLoad_T_38 | _io_cpu_perf_canAcceptLoadThenLoad_T_39 | _io_cpu_perf_canAcceptLoadThenLoad_T_40 | _io_cpu_perf_canAcceptLoadThenLoad_T_41 | _io_cpu_perf_canAcceptLoadThenLoad_T_42) & _io_cpu_perf_canAcceptLoadThenLoad_T_51;	// @[generators/rocket-chip/src/main/scala/rocket/Consts.scala:86:{32,49,76}, generators/rocket-chip/src/main/scala/rocket/DCache.scala:492:44, :1183:21, :1184:23, generators/rocket-chip/src/main/scala/util/package.scala:16:47]
    end
    pstore_drain_on_miss_REG <= io_cpu_s2_nack_0;	// @[generators/rocket-chip/src/main/scala/rocket/DCache.scala:439:86, :497:56]
    if (advance_pstore1) begin	// @[generators/rocket-chip/src/main/scala/rocket/DCache.scala:516:61]
      pstore2_addr <= pstore1_addr;	// @[generators/rocket-chip/src/main/scala/rocket/DCache.scala:487:31, :518:31]
      pstore2_way <= pstore1_way;	// @[generators/rocket-chip/src/main/scala/rocket/DCache.scala:489:30, :519:30]
      pstore2_storegen_data_r <= _amoalus_0_io_out[7:0];	// @[generators/rocket-chip/src/main/scala/rocket/DCache.scala:522:{22,44}, :975:26]
      pstore2_storegen_data_r_1 <= _amoalus_0_io_out[15:8];	// @[generators/rocket-chip/src/main/scala/rocket/DCache.scala:522:{22,44}, :975:26]
      pstore2_storegen_data_r_2 <= _amoalus_0_io_out[23:16];	// @[generators/rocket-chip/src/main/scala/rocket/DCache.scala:522:{22,44}, :975:26]
      pstore2_storegen_data_r_3 <= _amoalus_0_io_out[31:24];	// @[generators/rocket-chip/src/main/scala/rocket/DCache.scala:522:{22,44}, :975:26]
      pstore2_storegen_mask <= pstore1_mask;	// @[generators/rocket-chip/src/main/scala/rocket/DCache.scala:490:31, :525:19]
    end
    if (_GEN_22)	// @[generators/rocket-chip/src/main/scala/rocket/DCache.scala:715:26, :746:68, :749:29, :751:32]
      blockUncachedGrant <= dataArb_io_in_0_valid;	// @[generators/rocket-chip/src/main/scala/rocket/DCache.scala:511:44, :744:33]
    else	// @[generators/rocket-chip/src/main/scala/rocket/DCache.scala:715:26, :746:68, :749:29, :751:32]
      blockUncachedGrant <= dataArb_io_out_valid;	// @[generators/rocket-chip/src/main/scala/rocket/DCache.scala:744:33, src/main/scala/chisel3/util/Arbiter.scala:148:31]
    s1_release_data_valid <= ~dataArb__grant_T & dataArb_io_in_2_valid;	// @[generators/rocket-chip/src/main/scala/rocket/DCache.scala:795:38, :894:41, src/main/scala/chisel3/util/Arbiter.scala:45:{68,78}, src/main/scala/chisel3/util/Decoupled.scala:52:35]
    s2_release_data_valid <= s1_release_data_valid & ~releaseRejected;	// @[generators/rocket-chip/src/main/scala/rocket/DCache.scala:795:38, :796:{38,61,64}, :797:44]
    io_cpu_s2_xcpt_REG <= s1_valid & ~io_cpu_s1_kill & (s1_read | s1_write | s1_req_cmd == 5'h5 & s1_req_size[0] | s1_req_cmd == 5'h17) & ~s1_nack;	// @[generators/rocket-chip/src/main/scala/rocket/Consts.scala:85:68, :86:76, generators/rocket-chip/src/main/scala/rocket/DCache.scala:176:25, :180:37, :181:41, :190:25, :208:{34,50,64}, :264:{55,69}, :565:36, :818:21, :833:24, :925:65, :926:32, generators/rocket-chip/src/main/scala/util/package.scala:16:47]
    doUncachedResp <= io_cpu_replay_next_0;	// @[generators/rocket-chip/src/main/scala/rocket/DCache.scala:941:31, :943:39]
    REG <= reset;	// @[generators/rocket-chip/src/main/scala/rocket/DCache.scala:1001:18]
  end // always @(posedge)
  `ifdef ENABLE_INITIAL_REG_
    `ifdef FIRRTL_BEFORE_INITIAL
      `FIRRTL_BEFORE_INITIAL
    `endif // FIRRTL_BEFORE_INITIAL
    logic [31:0] _RANDOM[0:72];
    initial begin
      `ifdef INIT_RANDOM_PROLOG_
        `INIT_RANDOM_PROLOG_
      `endif // INIT_RANDOM_PROLOG_
      `ifdef RANDOMIZE_REG_INIT
        for (logic [6:0] i = 7'h0; i < 7'h49; i += 7'h1) begin
          _RANDOM[i] = `RANDOM;
        end
        s1_valid = _RANDOM[7'h26][1];	// @[generators/rocket-chip/src/main/scala/rocket/DCache.scala:176:25]
        s1_probe = _RANDOM[7'h26][2];	// @[generators/rocket-chip/src/main/scala/rocket/DCache.scala:176:25, :177:25]
        probe_bits_param = _RANDOM[7'h26][7:6];	// @[generators/rocket-chip/src/main/scala/rocket/DCache.scala:176:25, :178:29]
        probe_bits_size = _RANDOM[7'h26][10:8];	// @[generators/rocket-chip/src/main/scala/rocket/DCache.scala:176:25, :178:29]
        probe_bits_source = _RANDOM[7'h26][11];	// @[generators/rocket-chip/src/main/scala/rocket/DCache.scala:176:25, :178:29]
        probe_bits_address = {_RANDOM[7'h26][31:12], _RANDOM[7'h27][11:0]};	// @[generators/rocket-chip/src/main/scala/rocket/DCache.scala:176:25, :178:29]
        s1_vaddr = {_RANDOM[7'h28][31:19], _RANDOM[7'h29][18:0]};	// @[generators/rocket-chip/src/main/scala/rocket/DCache.scala:190:25]
        s1_req_tag = _RANDOM[7'h29][24:19];	// @[generators/rocket-chip/src/main/scala/rocket/DCache.scala:190:25]
        s1_req_cmd = _RANDOM[7'h29][29:25];	// @[generators/rocket-chip/src/main/scala/rocket/DCache.scala:190:25]
        s1_req_size = _RANDOM[7'h29][31:30];	// @[generators/rocket-chip/src/main/scala/rocket/DCache.scala:190:25]
        s1_req_signed = _RANDOM[7'h2A][0];	// @[generators/rocket-chip/src/main/scala/rocket/DCache.scala:190:25]
        s1_req_dprv = _RANDOM[7'h2A][2:1];	// @[generators/rocket-chip/src/main/scala/rocket/DCache.scala:190:25]
        s1_req_dv = _RANDOM[7'h2A][3];	// @[generators/rocket-chip/src/main/scala/rocket/DCache.scala:190:25]
        s1_tlb_req_vaddr = {_RANDOM[7'h2B][31:11], _RANDOM[7'h2C][10:0]};	// @[generators/rocket-chip/src/main/scala/rocket/DCache.scala:202:29]
        s1_tlb_req_size = _RANDOM[7'h2C][13:12];	// @[generators/rocket-chip/src/main/scala/rocket/DCache.scala:202:29]
        s1_tlb_req_cmd = _RANDOM[7'h2C][18:14];	// @[generators/rocket-chip/src/main/scala/rocket/DCache.scala:202:29]
        s1_tlb_req_prv = _RANDOM[7'h2C][20:19];	// @[generators/rocket-chip/src/main/scala/rocket/DCache.scala:202:29]
        s1_flush_valid = _RANDOM[7'h2C][22];	// @[generators/rocket-chip/src/main/scala/rocket/DCache.scala:202:29, :209:27]
        cached_grant_wait = _RANDOM[7'h2F][17];	// @[generators/rocket-chip/src/main/scala/rocket/DCache.scala:217:34]
        resetting = _RANDOM[7'h2F][18];	// @[generators/rocket-chip/src/main/scala/rocket/DCache.scala:217:34, :218:26]
        flushCounter = _RANDOM[7'h2F][25:19];	// @[generators/rocket-chip/src/main/scala/rocket/DCache.scala:217:34, :219:29]
        release_ack_wait = _RANDOM[7'h2F][26];	// @[generators/rocket-chip/src/main/scala/rocket/DCache.scala:217:34, :220:33]
        release_ack_addr = {_RANDOM[7'h2F][31:27], _RANDOM[7'h30][26:0]};	// @[generators/rocket-chip/src/main/scala/rocket/DCache.scala:217:34, :221:29]
        release_state = _RANDOM[7'h30][30:27];	// @[generators/rocket-chip/src/main/scala/rocket/DCache.scala:221:29, :222:30]
        refill_way = {_RANDOM[7'h30][31], _RANDOM[7'h31][0]};	// @[generators/rocket-chip/src/main/scala/rocket/DCache.scala:221:29, :223:23]
        uncachedInFlight_0 = _RANDOM[7'h31][1];	// @[generators/rocket-chip/src/main/scala/rocket/DCache.scala:223:23, :230:33]
        uncachedReqs_0_addr = {_RANDOM[7'h31][31:2], _RANDOM[7'h32][1:0]};	// @[generators/rocket-chip/src/main/scala/rocket/DCache.scala:223:23, :231:25]
        uncachedReqs_0_tag = _RANDOM[7'h32][7:2];	// @[generators/rocket-chip/src/main/scala/rocket/DCache.scala:231:25]
        uncachedReqs_0_size = _RANDOM[7'h32][14:13];	// @[generators/rocket-chip/src/main/scala/rocket/DCache.scala:231:25]
        uncachedReqs_0_signed = _RANDOM[7'h32][15];	// @[generators/rocket-chip/src/main/scala/rocket/DCache.scala:231:25]
        s1_did_read = _RANDOM[7'h33][26];	// @[generators/rocket-chip/src/main/scala/rocket/DCache.scala:253:30]
        s2_valid = _RANDOM[7'h33][28];	// @[generators/rocket-chip/src/main/scala/rocket/DCache.scala:253:30, :325:25]
        s2_probe = _RANDOM[7'h33][29];	// @[generators/rocket-chip/src/main/scala/rocket/DCache.scala:253:30, :327:25]
        s2_not_nacked_in_s1 = _RANDOM[7'h33][30];	// @[generators/rocket-chip/src/main/scala/rocket/DCache.scala:253:30, :329:36]
        s2_req_addr = {_RANDOM[7'h33][31], _RANDOM[7'h34][30:0]};	// @[generators/rocket-chip/src/main/scala/rocket/DCache.scala:253:30, :333:19]
        s2_req_tag = {_RANDOM[7'h34][31], _RANDOM[7'h35][4:0]};	// @[generators/rocket-chip/src/main/scala/rocket/DCache.scala:333:19]
        s2_req_cmd = _RANDOM[7'h35][9:5];	// @[generators/rocket-chip/src/main/scala/rocket/DCache.scala:333:19]
        s2_req_size = _RANDOM[7'h35][11:10];	// @[generators/rocket-chip/src/main/scala/rocket/DCache.scala:333:19]
        s2_req_signed = _RANDOM[7'h35][12];	// @[generators/rocket-chip/src/main/scala/rocket/DCache.scala:333:19]
        s2_req_dprv = _RANDOM[7'h35][14:13];	// @[generators/rocket-chip/src/main/scala/rocket/DCache.scala:333:19]
        s2_req_dv = _RANDOM[7'h35][15];	// @[generators/rocket-chip/src/main/scala/rocket/DCache.scala:333:19]
        s2_tlb_xcpt_pf_ld = _RANDOM[7'h38][25];	// @[generators/rocket-chip/src/main/scala/rocket/DCache.scala:336:24]
        s2_tlb_xcpt_pf_st = _RANDOM[7'h38][26];	// @[generators/rocket-chip/src/main/scala/rocket/DCache.scala:336:24]
        s2_tlb_xcpt_ae_ld = _RANDOM[7'h38][31];	// @[generators/rocket-chip/src/main/scala/rocket/DCache.scala:336:24]
        s2_tlb_xcpt_ae_st = _RANDOM[7'h39][0];	// @[generators/rocket-chip/src/main/scala/rocket/DCache.scala:336:24]
        s2_tlb_xcpt_ma_ld = _RANDOM[7'h39][2];	// @[generators/rocket-chip/src/main/scala/rocket/DCache.scala:336:24]
        s2_tlb_xcpt_ma_st = _RANDOM[7'h39][3];	// @[generators/rocket-chip/src/main/scala/rocket/DCache.scala:336:24]
        s2_pma_cacheable = _RANDOM[7'h3B][29];	// @[generators/rocket-chip/src/main/scala/rocket/DCache.scala:337:19]
        s2_uncached_resp_addr = {_RANDOM[7'h3C][31:7], _RANDOM[7'h3D][6:0]};	// @[generators/rocket-chip/src/main/scala/rocket/DCache.scala:338:34]
        s2_vaddr_r = {_RANDOM[7'h3D][31:7], _RANDOM[7'h3E][6:0]};	// @[generators/rocket-chip/src/main/scala/rocket/DCache.scala:338:34, :345:31]
        s2_flush_valid_pre_tag_ecc = _RANDOM[7'h3E][7];	// @[generators/rocket-chip/src/main/scala/rocket/DCache.scala:345:31, :349:43]
        s2_meta_corrected_r = {_RANDOM[7'h3E][31:12], _RANDOM[7'h3F][1:0]};	// @[generators/rocket-chip/src/main/scala/rocket/DCache.scala:345:31, :355:61]
        s2_meta_corrected_r_1 = _RANDOM[7'h3F][23:2];	// @[generators/rocket-chip/src/main/scala/rocket/DCache.scala:355:61]
        s2_data = {_RANDOM[7'h3F][31:24], _RANDOM[7'h40][23:0]};	// @[generators/rocket-chip/src/main/scala/rocket/DCache.scala:355:61, :373:18]
        s2_probe_way = _RANDOM[7'h40][25:24];	// @[generators/rocket-chip/src/main/scala/rocket/DCache.scala:373:18, :377:31]
        s2_probe_state_state = _RANDOM[7'h40][27:26];	// @[generators/rocket-chip/src/main/scala/rocket/DCache.scala:373:18, :378:33]
        s2_hit_way = _RANDOM[7'h40][29:28];	// @[generators/rocket-chip/src/main/scala/rocket/DCache.scala:373:18, :379:29]
        s2_hit_state_state = _RANDOM[7'h40][31:30];	// @[generators/rocket-chip/src/main/scala/rocket/DCache.scala:373:18, :380:31]
        s2_victim_way_r = _RANDOM[7'h41][1];	// @[generators/rocket-chip/src/main/scala/rocket/DCache.scala:425:41]
        lrscCount = _RANDOM[7'h41][8:2];	// @[generators/rocket-chip/src/main/scala/rocket/DCache.scala:425:41, :466:26]
        lrscAddr = {_RANDOM[7'h41][31:9], _RANDOM[7'h42][2:0]};	// @[generators/rocket-chip/src/main/scala/rocket/DCache.scala:425:41, :469:21]
        pstore1_cmd = _RANDOM[7'h42][8:4];	// @[generators/rocket-chip/src/main/scala/rocket/DCache.scala:469:21, :486:30]
        pstore1_addr = {_RANDOM[7'h42][31:9], _RANDOM[7'h43][8:0]};	// @[generators/rocket-chip/src/main/scala/rocket/DCache.scala:469:21, :487:31]
        pstore1_data = {_RANDOM[7'h43][31:9], _RANDOM[7'h44][8:0]};	// @[generators/rocket-chip/src/main/scala/rocket/DCache.scala:487:31, :488:31]
        pstore1_way = _RANDOM[7'h44][10:9];	// @[generators/rocket-chip/src/main/scala/rocket/DCache.scala:488:31, :489:30]
        pstore1_mask = _RANDOM[7'h44][14:11];	// @[generators/rocket-chip/src/main/scala/rocket/DCache.scala:488:31, :490:31]
        pstore1_rmw = _RANDOM[7'h44][15];	// @[generators/rocket-chip/src/main/scala/rocket/DCache.scala:488:31, :492:44]
        pstore2_valid = _RANDOM[7'h44][16];	// @[generators/rocket-chip/src/main/scala/rocket/DCache.scala:488:31, :495:30]
        pstore_drain_on_miss_REG = _RANDOM[7'h44][17];	// @[generators/rocket-chip/src/main/scala/rocket/DCache.scala:488:31, :497:56]
        pstore1_held = _RANDOM[7'h44][18];	// @[generators/rocket-chip/src/main/scala/rocket/DCache.scala:488:31, :498:29]
        pstore2_addr = {_RANDOM[7'h44][31:19], _RANDOM[7'h45][18:0]};	// @[generators/rocket-chip/src/main/scala/rocket/DCache.scala:488:31, :518:31]
        pstore2_way = _RANDOM[7'h45][20:19];	// @[generators/rocket-chip/src/main/scala/rocket/DCache.scala:518:31, :519:30]
        pstore2_storegen_data_r = _RANDOM[7'h45][28:21];	// @[generators/rocket-chip/src/main/scala/rocket/DCache.scala:518:31, :522:22]
        pstore2_storegen_data_r_1 = {_RANDOM[7'h45][31:29], _RANDOM[7'h46][4:0]};	// @[generators/rocket-chip/src/main/scala/rocket/DCache.scala:518:31, :522:22]
        pstore2_storegen_data_r_2 = _RANDOM[7'h46][12:5];	// @[generators/rocket-chip/src/main/scala/rocket/DCache.scala:522:22]
        pstore2_storegen_data_r_3 = _RANDOM[7'h46][20:13];	// @[generators/rocket-chip/src/main/scala/rocket/DCache.scala:522:22]
        pstore2_storegen_mask = _RANDOM[7'h46][24:21];	// @[generators/rocket-chip/src/main/scala/rocket/DCache.scala:522:22, :525:19]
        counter = _RANDOM[7'h46][29:26];	// @[generators/rocket-chip/src/main/scala/rocket/DCache.scala:522:22, generators/rocket-chip/src/main/scala/tilelink/Edges.scala:229:27]
        grantInProgress = _RANDOM[7'h46][30];	// @[generators/rocket-chip/src/main/scala/rocket/DCache.scala:522:22, :661:32]
        blockProbeAfterGrantCount = {_RANDOM[7'h46][31], _RANDOM[7'h47][1:0]};	// @[generators/rocket-chip/src/main/scala/rocket/DCache.scala:522:22, :662:42]
        blockUncachedGrant = _RANDOM[7'h47][2];	// @[generators/rocket-chip/src/main/scala/rocket/DCache.scala:662:42, :744:33]
        counter_1 = _RANDOM[7'h47][6:3];	// @[generators/rocket-chip/src/main/scala/rocket/DCache.scala:662:42, generators/rocket-chip/src/main/scala/tilelink/Edges.scala:229:27]
        s1_release_data_valid = _RANDOM[7'h47][7];	// @[generators/rocket-chip/src/main/scala/rocket/DCache.scala:662:42, :795:38]
        s2_release_data_valid = _RANDOM[7'h47][8];	// @[generators/rocket-chip/src/main/scala/rocket/DCache.scala:662:42, :796:38]
        io_cpu_s2_xcpt_REG = _RANDOM[7'h47][9];	// @[generators/rocket-chip/src/main/scala/rocket/DCache.scala:662:42, :926:32]
        doUncachedResp = _RANDOM[7'h48][10];	// @[generators/rocket-chip/src/main/scala/rocket/DCache.scala:941:31]
        REG = _RANDOM[7'h48][11];	// @[generators/rocket-chip/src/main/scala/rocket/DCache.scala:941:31, :1001:18]
        io_cpu_perf_release_counter = _RANDOM[7'h48][19:16];	// @[generators/rocket-chip/src/main/scala/rocket/DCache.scala:941:31, generators/rocket-chip/src/main/scala/tilelink/Edges.scala:229:27]
      `endif // RANDOMIZE_REG_INIT
    end // initial
    `ifdef FIRRTL_AFTER_INITIAL
      `FIRRTL_AFTER_INITIAL
    `endif // FIRRTL_AFTER_INITIAL
  `endif // ENABLE_INITIAL_REG_
  OptimizationBarrier tlb_entries_barrier (	// @[generators/rocket-chip/src/main/scala/util/package.scala:259:25]
    .io_x_u        (1'h0),	// @[generators/rocket-chip/src/main/scala/rocket/DCache.scala:269:27, :282:26, :1007:122, generators/rocket-chip/src/main/scala/rocket/HellaCache.scala:234:14]
    .io_x_ae_ptw   (1'h0),	// @[generators/rocket-chip/src/main/scala/rocket/DCache.scala:269:27, :282:26, :1007:122, generators/rocket-chip/src/main/scala/rocket/HellaCache.scala:234:14]
    .io_x_ae_final (1'h0),	// @[generators/rocket-chip/src/main/scala/rocket/DCache.scala:269:27, :282:26, :1007:122, generators/rocket-chip/src/main/scala/rocket/HellaCache.scala:234:14]
    .io_x_pf       (1'h0),	// @[generators/rocket-chip/src/main/scala/rocket/DCache.scala:269:27, :282:26, :1007:122, generators/rocket-chip/src/main/scala/rocket/HellaCache.scala:234:14]
    .io_x_gf       (1'h0),	// @[generators/rocket-chip/src/main/scala/rocket/DCache.scala:269:27, :282:26, :1007:122, generators/rocket-chip/src/main/scala/rocket/HellaCache.scala:234:14]
    .io_x_sw       (1'h0),	// @[generators/rocket-chip/src/main/scala/rocket/DCache.scala:269:27, :282:26, :1007:122, generators/rocket-chip/src/main/scala/rocket/HellaCache.scala:234:14]
    .io_x_sx       (1'h0),	// @[generators/rocket-chip/src/main/scala/rocket/DCache.scala:269:27, :282:26, :1007:122, generators/rocket-chip/src/main/scala/rocket/HellaCache.scala:234:14]
    .io_x_sr       (1'h0),	// @[generators/rocket-chip/src/main/scala/rocket/DCache.scala:269:27, :282:26, :1007:122, generators/rocket-chip/src/main/scala/rocket/HellaCache.scala:234:14]
    .io_x_pw       (1'h0),	// @[generators/rocket-chip/src/main/scala/rocket/DCache.scala:269:27, :282:26, :1007:122, generators/rocket-chip/src/main/scala/rocket/HellaCache.scala:234:14]
    .io_x_px       (1'h0),	// @[generators/rocket-chip/src/main/scala/rocket/DCache.scala:269:27, :282:26, :1007:122, generators/rocket-chip/src/main/scala/rocket/HellaCache.scala:234:14]
    .io_x_pr       (1'h0),	// @[generators/rocket-chip/src/main/scala/rocket/DCache.scala:269:27, :282:26, :1007:122, generators/rocket-chip/src/main/scala/rocket/HellaCache.scala:234:14]
    .io_x_ppp      (1'h0),	// @[generators/rocket-chip/src/main/scala/rocket/DCache.scala:269:27, :282:26, :1007:122, generators/rocket-chip/src/main/scala/rocket/HellaCache.scala:234:14]
    .io_x_pal      (1'h0),	// @[generators/rocket-chip/src/main/scala/rocket/DCache.scala:269:27, :282:26, :1007:122, generators/rocket-chip/src/main/scala/rocket/HellaCache.scala:234:14]
    .io_x_paa      (1'h0),	// @[generators/rocket-chip/src/main/scala/rocket/DCache.scala:269:27, :282:26, :1007:122, generators/rocket-chip/src/main/scala/rocket/HellaCache.scala:234:14]
    .io_x_eff      (1'h0),	// @[generators/rocket-chip/src/main/scala/rocket/DCache.scala:269:27, :282:26, :1007:122, generators/rocket-chip/src/main/scala/rocket/HellaCache.scala:234:14]
    .io_x_c        (1'h0),	// @[generators/rocket-chip/src/main/scala/rocket/DCache.scala:269:27, :282:26, :1007:122, generators/rocket-chip/src/main/scala/rocket/HellaCache.scala:234:14]
    .io_y_u        (/* unused */),
    .io_y_ae_ptw   (/* unused */),
    .io_y_ae_final (/* unused */),
    .io_y_pf       (/* unused */),
    .io_y_gf       (/* unused */),
    .io_y_sw       (/* unused */),
    .io_y_sx       (/* unused */),
    .io_y_sr       (/* unused */),
    .io_y_pw       (/* unused */),
    .io_y_px       (/* unused */),
    .io_y_pr       (/* unused */),
    .io_y_ppp      (/* unused */),
    .io_y_pal      (/* unused */),
    .io_y_paa      (/* unused */),
    .io_y_eff      (/* unused */),
    .io_y_c        (/* unused */)
  );
  OptimizationBarrier tlb_entries_barrier_1 (	// @[generators/rocket-chip/src/main/scala/util/package.scala:259:25]
    .io_x_u        (1'h0),	// @[generators/rocket-chip/src/main/scala/rocket/DCache.scala:269:27, :282:26, :1007:122, generators/rocket-chip/src/main/scala/rocket/HellaCache.scala:234:14]
    .io_x_ae_ptw   (1'h0),	// @[generators/rocket-chip/src/main/scala/rocket/DCache.scala:269:27, :282:26, :1007:122, generators/rocket-chip/src/main/scala/rocket/HellaCache.scala:234:14]
    .io_x_ae_final (1'h0),	// @[generators/rocket-chip/src/main/scala/rocket/DCache.scala:269:27, :282:26, :1007:122, generators/rocket-chip/src/main/scala/rocket/HellaCache.scala:234:14]
    .io_x_pf       (1'h0),	// @[generators/rocket-chip/src/main/scala/rocket/DCache.scala:269:27, :282:26, :1007:122, generators/rocket-chip/src/main/scala/rocket/HellaCache.scala:234:14]
    .io_x_gf       (1'h0),	// @[generators/rocket-chip/src/main/scala/rocket/DCache.scala:269:27, :282:26, :1007:122, generators/rocket-chip/src/main/scala/rocket/HellaCache.scala:234:14]
    .io_x_sw       (1'h0),	// @[generators/rocket-chip/src/main/scala/rocket/DCache.scala:269:27, :282:26, :1007:122, generators/rocket-chip/src/main/scala/rocket/HellaCache.scala:234:14]
    .io_x_sx       (1'h0),	// @[generators/rocket-chip/src/main/scala/rocket/DCache.scala:269:27, :282:26, :1007:122, generators/rocket-chip/src/main/scala/rocket/HellaCache.scala:234:14]
    .io_x_sr       (1'h0),	// @[generators/rocket-chip/src/main/scala/rocket/DCache.scala:269:27, :282:26, :1007:122, generators/rocket-chip/src/main/scala/rocket/HellaCache.scala:234:14]
    .io_x_pw       (1'h0),	// @[generators/rocket-chip/src/main/scala/rocket/DCache.scala:269:27, :282:26, :1007:122, generators/rocket-chip/src/main/scala/rocket/HellaCache.scala:234:14]
    .io_x_px       (1'h0),	// @[generators/rocket-chip/src/main/scala/rocket/DCache.scala:269:27, :282:26, :1007:122, generators/rocket-chip/src/main/scala/rocket/HellaCache.scala:234:14]
    .io_x_pr       (1'h0),	// @[generators/rocket-chip/src/main/scala/rocket/DCache.scala:269:27, :282:26, :1007:122, generators/rocket-chip/src/main/scala/rocket/HellaCache.scala:234:14]
    .io_x_ppp      (1'h0),	// @[generators/rocket-chip/src/main/scala/rocket/DCache.scala:269:27, :282:26, :1007:122, generators/rocket-chip/src/main/scala/rocket/HellaCache.scala:234:14]
    .io_x_pal      (1'h0),	// @[generators/rocket-chip/src/main/scala/rocket/DCache.scala:269:27, :282:26, :1007:122, generators/rocket-chip/src/main/scala/rocket/HellaCache.scala:234:14]
    .io_x_paa      (1'h0),	// @[generators/rocket-chip/src/main/scala/rocket/DCache.scala:269:27, :282:26, :1007:122, generators/rocket-chip/src/main/scala/rocket/HellaCache.scala:234:14]
    .io_x_eff      (1'h0),	// @[generators/rocket-chip/src/main/scala/rocket/DCache.scala:269:27, :282:26, :1007:122, generators/rocket-chip/src/main/scala/rocket/HellaCache.scala:234:14]
    .io_x_c        (1'h0),	// @[generators/rocket-chip/src/main/scala/rocket/DCache.scala:269:27, :282:26, :1007:122, generators/rocket-chip/src/main/scala/rocket/HellaCache.scala:234:14]
    .io_y_u        (/* unused */),
    .io_y_ae_ptw   (/* unused */),
    .io_y_ae_final (/* unused */),
    .io_y_pf       (/* unused */),
    .io_y_gf       (/* unused */),
    .io_y_sw       (/* unused */),
    .io_y_sx       (/* unused */),
    .io_y_sr       (/* unused */),
    .io_y_pw       (/* unused */),
    .io_y_px       (/* unused */),
    .io_y_pr       (/* unused */),
    .io_y_ppp      (/* unused */),
    .io_y_pal      (/* unused */),
    .io_y_paa      (/* unused */),
    .io_y_eff      (/* unused */),
    .io_y_c        (/* unused */)
  );
  OptimizationBarrier tlb_entries_barrier_2 (	// @[generators/rocket-chip/src/main/scala/util/package.scala:259:25]
    .io_x_u        (1'h0),	// @[generators/rocket-chip/src/main/scala/rocket/DCache.scala:269:27, :282:26, :1007:122, generators/rocket-chip/src/main/scala/rocket/HellaCache.scala:234:14]
    .io_x_ae_ptw   (1'h0),	// @[generators/rocket-chip/src/main/scala/rocket/DCache.scala:269:27, :282:26, :1007:122, generators/rocket-chip/src/main/scala/rocket/HellaCache.scala:234:14]
    .io_x_ae_final (1'h0),	// @[generators/rocket-chip/src/main/scala/rocket/DCache.scala:269:27, :282:26, :1007:122, generators/rocket-chip/src/main/scala/rocket/HellaCache.scala:234:14]
    .io_x_pf       (1'h0),	// @[generators/rocket-chip/src/main/scala/rocket/DCache.scala:269:27, :282:26, :1007:122, generators/rocket-chip/src/main/scala/rocket/HellaCache.scala:234:14]
    .io_x_gf       (1'h0),	// @[generators/rocket-chip/src/main/scala/rocket/DCache.scala:269:27, :282:26, :1007:122, generators/rocket-chip/src/main/scala/rocket/HellaCache.scala:234:14]
    .io_x_sw       (1'h0),	// @[generators/rocket-chip/src/main/scala/rocket/DCache.scala:269:27, :282:26, :1007:122, generators/rocket-chip/src/main/scala/rocket/HellaCache.scala:234:14]
    .io_x_sx       (1'h0),	// @[generators/rocket-chip/src/main/scala/rocket/DCache.scala:269:27, :282:26, :1007:122, generators/rocket-chip/src/main/scala/rocket/HellaCache.scala:234:14]
    .io_x_sr       (1'h0),	// @[generators/rocket-chip/src/main/scala/rocket/DCache.scala:269:27, :282:26, :1007:122, generators/rocket-chip/src/main/scala/rocket/HellaCache.scala:234:14]
    .io_x_pw       (1'h0),	// @[generators/rocket-chip/src/main/scala/rocket/DCache.scala:269:27, :282:26, :1007:122, generators/rocket-chip/src/main/scala/rocket/HellaCache.scala:234:14]
    .io_x_px       (1'h0),	// @[generators/rocket-chip/src/main/scala/rocket/DCache.scala:269:27, :282:26, :1007:122, generators/rocket-chip/src/main/scala/rocket/HellaCache.scala:234:14]
    .io_x_pr       (1'h0),	// @[generators/rocket-chip/src/main/scala/rocket/DCache.scala:269:27, :282:26, :1007:122, generators/rocket-chip/src/main/scala/rocket/HellaCache.scala:234:14]
    .io_x_ppp      (1'h0),	// @[generators/rocket-chip/src/main/scala/rocket/DCache.scala:269:27, :282:26, :1007:122, generators/rocket-chip/src/main/scala/rocket/HellaCache.scala:234:14]
    .io_x_pal      (1'h0),	// @[generators/rocket-chip/src/main/scala/rocket/DCache.scala:269:27, :282:26, :1007:122, generators/rocket-chip/src/main/scala/rocket/HellaCache.scala:234:14]
    .io_x_paa      (1'h0),	// @[generators/rocket-chip/src/main/scala/rocket/DCache.scala:269:27, :282:26, :1007:122, generators/rocket-chip/src/main/scala/rocket/HellaCache.scala:234:14]
    .io_x_eff      (1'h0),	// @[generators/rocket-chip/src/main/scala/rocket/DCache.scala:269:27, :282:26, :1007:122, generators/rocket-chip/src/main/scala/rocket/HellaCache.scala:234:14]
    .io_x_c        (1'h0),	// @[generators/rocket-chip/src/main/scala/rocket/DCache.scala:269:27, :282:26, :1007:122, generators/rocket-chip/src/main/scala/rocket/HellaCache.scala:234:14]
    .io_y_u        (/* unused */),
    .io_y_ae_ptw   (/* unused */),
    .io_y_ae_final (/* unused */),
    .io_y_pf       (/* unused */),
    .io_y_gf       (/* unused */),
    .io_y_sw       (/* unused */),
    .io_y_sx       (/* unused */),
    .io_y_sr       (/* unused */),
    .io_y_pw       (/* unused */),
    .io_y_px       (/* unused */),
    .io_y_pr       (/* unused */),
    .io_y_ppp      (/* unused */),
    .io_y_pal      (/* unused */),
    .io_y_paa      (/* unused */),
    .io_y_eff      (/* unused */),
    .io_y_c        (/* unused */)
  );
  OptimizationBarrier tlb_entries_barrier_3 (	// @[generators/rocket-chip/src/main/scala/util/package.scala:259:25]
    .io_x_u        (1'h0),	// @[generators/rocket-chip/src/main/scala/rocket/DCache.scala:269:27, :282:26, :1007:122, generators/rocket-chip/src/main/scala/rocket/HellaCache.scala:234:14]
    .io_x_ae_ptw   (1'h0),	// @[generators/rocket-chip/src/main/scala/rocket/DCache.scala:269:27, :282:26, :1007:122, generators/rocket-chip/src/main/scala/rocket/HellaCache.scala:234:14]
    .io_x_ae_final (1'h0),	// @[generators/rocket-chip/src/main/scala/rocket/DCache.scala:269:27, :282:26, :1007:122, generators/rocket-chip/src/main/scala/rocket/HellaCache.scala:234:14]
    .io_x_pf       (1'h0),	// @[generators/rocket-chip/src/main/scala/rocket/DCache.scala:269:27, :282:26, :1007:122, generators/rocket-chip/src/main/scala/rocket/HellaCache.scala:234:14]
    .io_x_gf       (1'h0),	// @[generators/rocket-chip/src/main/scala/rocket/DCache.scala:269:27, :282:26, :1007:122, generators/rocket-chip/src/main/scala/rocket/HellaCache.scala:234:14]
    .io_x_sw       (1'h0),	// @[generators/rocket-chip/src/main/scala/rocket/DCache.scala:269:27, :282:26, :1007:122, generators/rocket-chip/src/main/scala/rocket/HellaCache.scala:234:14]
    .io_x_sx       (1'h0),	// @[generators/rocket-chip/src/main/scala/rocket/DCache.scala:269:27, :282:26, :1007:122, generators/rocket-chip/src/main/scala/rocket/HellaCache.scala:234:14]
    .io_x_sr       (1'h0),	// @[generators/rocket-chip/src/main/scala/rocket/DCache.scala:269:27, :282:26, :1007:122, generators/rocket-chip/src/main/scala/rocket/HellaCache.scala:234:14]
    .io_x_pw       (1'h0),	// @[generators/rocket-chip/src/main/scala/rocket/DCache.scala:269:27, :282:26, :1007:122, generators/rocket-chip/src/main/scala/rocket/HellaCache.scala:234:14]
    .io_x_px       (1'h0),	// @[generators/rocket-chip/src/main/scala/rocket/DCache.scala:269:27, :282:26, :1007:122, generators/rocket-chip/src/main/scala/rocket/HellaCache.scala:234:14]
    .io_x_pr       (1'h0),	// @[generators/rocket-chip/src/main/scala/rocket/DCache.scala:269:27, :282:26, :1007:122, generators/rocket-chip/src/main/scala/rocket/HellaCache.scala:234:14]
    .io_x_ppp      (1'h0),	// @[generators/rocket-chip/src/main/scala/rocket/DCache.scala:269:27, :282:26, :1007:122, generators/rocket-chip/src/main/scala/rocket/HellaCache.scala:234:14]
    .io_x_pal      (1'h0),	// @[generators/rocket-chip/src/main/scala/rocket/DCache.scala:269:27, :282:26, :1007:122, generators/rocket-chip/src/main/scala/rocket/HellaCache.scala:234:14]
    .io_x_paa      (1'h0),	// @[generators/rocket-chip/src/main/scala/rocket/DCache.scala:269:27, :282:26, :1007:122, generators/rocket-chip/src/main/scala/rocket/HellaCache.scala:234:14]
    .io_x_eff      (1'h0),	// @[generators/rocket-chip/src/main/scala/rocket/DCache.scala:269:27, :282:26, :1007:122, generators/rocket-chip/src/main/scala/rocket/HellaCache.scala:234:14]
    .io_x_c        (1'h0),	// @[generators/rocket-chip/src/main/scala/rocket/DCache.scala:269:27, :282:26, :1007:122, generators/rocket-chip/src/main/scala/rocket/HellaCache.scala:234:14]
    .io_y_u        (/* unused */),
    .io_y_ae_ptw   (/* unused */),
    .io_y_ae_final (/* unused */),
    .io_y_pf       (/* unused */),
    .io_y_gf       (/* unused */),
    .io_y_sw       (/* unused */),
    .io_y_sx       (/* unused */),
    .io_y_sr       (/* unused */),
    .io_y_pw       (/* unused */),
    .io_y_px       (/* unused */),
    .io_y_pr       (/* unused */),
    .io_y_ppp      (/* unused */),
    .io_y_pal      (/* unused */),
    .io_y_paa      (/* unused */),
    .io_y_eff      (/* unused */),
    .io_y_c        (/* unused */)
  );
  OptimizationBarrier tlb_entries_barrier_4 (	// @[generators/rocket-chip/src/main/scala/util/package.scala:259:25]
    .io_x_u        (1'h0),	// @[generators/rocket-chip/src/main/scala/rocket/DCache.scala:269:27, :282:26, :1007:122, generators/rocket-chip/src/main/scala/rocket/HellaCache.scala:234:14]
    .io_x_ae_ptw   (1'h0),	// @[generators/rocket-chip/src/main/scala/rocket/DCache.scala:269:27, :282:26, :1007:122, generators/rocket-chip/src/main/scala/rocket/HellaCache.scala:234:14]
    .io_x_ae_final (1'h0),	// @[generators/rocket-chip/src/main/scala/rocket/DCache.scala:269:27, :282:26, :1007:122, generators/rocket-chip/src/main/scala/rocket/HellaCache.scala:234:14]
    .io_x_pf       (1'h0),	// @[generators/rocket-chip/src/main/scala/rocket/DCache.scala:269:27, :282:26, :1007:122, generators/rocket-chip/src/main/scala/rocket/HellaCache.scala:234:14]
    .io_x_gf       (1'h0),	// @[generators/rocket-chip/src/main/scala/rocket/DCache.scala:269:27, :282:26, :1007:122, generators/rocket-chip/src/main/scala/rocket/HellaCache.scala:234:14]
    .io_x_sw       (1'h0),	// @[generators/rocket-chip/src/main/scala/rocket/DCache.scala:269:27, :282:26, :1007:122, generators/rocket-chip/src/main/scala/rocket/HellaCache.scala:234:14]
    .io_x_sx       (1'h0),	// @[generators/rocket-chip/src/main/scala/rocket/DCache.scala:269:27, :282:26, :1007:122, generators/rocket-chip/src/main/scala/rocket/HellaCache.scala:234:14]
    .io_x_sr       (1'h0),	// @[generators/rocket-chip/src/main/scala/rocket/DCache.scala:269:27, :282:26, :1007:122, generators/rocket-chip/src/main/scala/rocket/HellaCache.scala:234:14]
    .io_x_pw       (1'h0),	// @[generators/rocket-chip/src/main/scala/rocket/DCache.scala:269:27, :282:26, :1007:122, generators/rocket-chip/src/main/scala/rocket/HellaCache.scala:234:14]
    .io_x_px       (1'h0),	// @[generators/rocket-chip/src/main/scala/rocket/DCache.scala:269:27, :282:26, :1007:122, generators/rocket-chip/src/main/scala/rocket/HellaCache.scala:234:14]
    .io_x_pr       (1'h0),	// @[generators/rocket-chip/src/main/scala/rocket/DCache.scala:269:27, :282:26, :1007:122, generators/rocket-chip/src/main/scala/rocket/HellaCache.scala:234:14]
    .io_x_ppp      (1'h0),	// @[generators/rocket-chip/src/main/scala/rocket/DCache.scala:269:27, :282:26, :1007:122, generators/rocket-chip/src/main/scala/rocket/HellaCache.scala:234:14]
    .io_x_pal      (1'h0),	// @[generators/rocket-chip/src/main/scala/rocket/DCache.scala:269:27, :282:26, :1007:122, generators/rocket-chip/src/main/scala/rocket/HellaCache.scala:234:14]
    .io_x_paa      (1'h0),	// @[generators/rocket-chip/src/main/scala/rocket/DCache.scala:269:27, :282:26, :1007:122, generators/rocket-chip/src/main/scala/rocket/HellaCache.scala:234:14]
    .io_x_eff      (1'h0),	// @[generators/rocket-chip/src/main/scala/rocket/DCache.scala:269:27, :282:26, :1007:122, generators/rocket-chip/src/main/scala/rocket/HellaCache.scala:234:14]
    .io_x_c        (1'h0),	// @[generators/rocket-chip/src/main/scala/rocket/DCache.scala:269:27, :282:26, :1007:122, generators/rocket-chip/src/main/scala/rocket/HellaCache.scala:234:14]
    .io_y_u        (/* unused */),
    .io_y_ae_ptw   (/* unused */),
    .io_y_ae_final (/* unused */),
    .io_y_pf       (/* unused */),
    .io_y_gf       (/* unused */),
    .io_y_sw       (/* unused */),
    .io_y_sx       (/* unused */),
    .io_y_sr       (/* unused */),
    .io_y_pw       (/* unused */),
    .io_y_px       (/* unused */),
    .io_y_pr       (/* unused */),
    .io_y_ppp      (/* unused */),
    .io_y_pal      (/* unused */),
    .io_y_paa      (/* unused */),
    .io_y_eff      (/* unused */),
    .io_y_c        (/* unused */)
  );
  OptimizationBarrier tlb_entries_barrier_5 (	// @[generators/rocket-chip/src/main/scala/util/package.scala:259:25]
    .io_x_u        (1'h0),	// @[generators/rocket-chip/src/main/scala/rocket/DCache.scala:269:27, :282:26, :1007:122, generators/rocket-chip/src/main/scala/rocket/HellaCache.scala:234:14]
    .io_x_ae_ptw   (1'h0),	// @[generators/rocket-chip/src/main/scala/rocket/DCache.scala:269:27, :282:26, :1007:122, generators/rocket-chip/src/main/scala/rocket/HellaCache.scala:234:14]
    .io_x_ae_final (1'h0),	// @[generators/rocket-chip/src/main/scala/rocket/DCache.scala:269:27, :282:26, :1007:122, generators/rocket-chip/src/main/scala/rocket/HellaCache.scala:234:14]
    .io_x_pf       (1'h0),	// @[generators/rocket-chip/src/main/scala/rocket/DCache.scala:269:27, :282:26, :1007:122, generators/rocket-chip/src/main/scala/rocket/HellaCache.scala:234:14]
    .io_x_gf       (1'h0),	// @[generators/rocket-chip/src/main/scala/rocket/DCache.scala:269:27, :282:26, :1007:122, generators/rocket-chip/src/main/scala/rocket/HellaCache.scala:234:14]
    .io_x_sw       (1'h0),	// @[generators/rocket-chip/src/main/scala/rocket/DCache.scala:269:27, :282:26, :1007:122, generators/rocket-chip/src/main/scala/rocket/HellaCache.scala:234:14]
    .io_x_sx       (1'h0),	// @[generators/rocket-chip/src/main/scala/rocket/DCache.scala:269:27, :282:26, :1007:122, generators/rocket-chip/src/main/scala/rocket/HellaCache.scala:234:14]
    .io_x_sr       (1'h0),	// @[generators/rocket-chip/src/main/scala/rocket/DCache.scala:269:27, :282:26, :1007:122, generators/rocket-chip/src/main/scala/rocket/HellaCache.scala:234:14]
    .io_x_pw       (1'h0),	// @[generators/rocket-chip/src/main/scala/rocket/DCache.scala:269:27, :282:26, :1007:122, generators/rocket-chip/src/main/scala/rocket/HellaCache.scala:234:14]
    .io_x_px       (1'h0),	// @[generators/rocket-chip/src/main/scala/rocket/DCache.scala:269:27, :282:26, :1007:122, generators/rocket-chip/src/main/scala/rocket/HellaCache.scala:234:14]
    .io_x_pr       (1'h0),	// @[generators/rocket-chip/src/main/scala/rocket/DCache.scala:269:27, :282:26, :1007:122, generators/rocket-chip/src/main/scala/rocket/HellaCache.scala:234:14]
    .io_x_ppp      (1'h0),	// @[generators/rocket-chip/src/main/scala/rocket/DCache.scala:269:27, :282:26, :1007:122, generators/rocket-chip/src/main/scala/rocket/HellaCache.scala:234:14]
    .io_x_pal      (1'h0),	// @[generators/rocket-chip/src/main/scala/rocket/DCache.scala:269:27, :282:26, :1007:122, generators/rocket-chip/src/main/scala/rocket/HellaCache.scala:234:14]
    .io_x_paa      (1'h0),	// @[generators/rocket-chip/src/main/scala/rocket/DCache.scala:269:27, :282:26, :1007:122, generators/rocket-chip/src/main/scala/rocket/HellaCache.scala:234:14]
    .io_x_eff      (1'h0),	// @[generators/rocket-chip/src/main/scala/rocket/DCache.scala:269:27, :282:26, :1007:122, generators/rocket-chip/src/main/scala/rocket/HellaCache.scala:234:14]
    .io_x_c        (1'h0),	// @[generators/rocket-chip/src/main/scala/rocket/DCache.scala:269:27, :282:26, :1007:122, generators/rocket-chip/src/main/scala/rocket/HellaCache.scala:234:14]
    .io_y_u        (/* unused */),
    .io_y_ae_ptw   (/* unused */),
    .io_y_ae_final (/* unused */),
    .io_y_pf       (/* unused */),
    .io_y_gf       (/* unused */),
    .io_y_sw       (/* unused */),
    .io_y_sx       (/* unused */),
    .io_y_sr       (/* unused */),
    .io_y_pw       (/* unused */),
    .io_y_px       (/* unused */),
    .io_y_pr       (/* unused */),
    .io_y_ppp      (/* unused */),
    .io_y_pal      (/* unused */),
    .io_y_paa      (/* unused */),
    .io_y_eff      (/* unused */),
    .io_y_c        (/* unused */)
  );
  OptimizationBarrier pma_checker_entries_barrier (	// @[generators/rocket-chip/src/main/scala/util/package.scala:259:25]
    .io_x_u        (1'h0),	// @[generators/rocket-chip/src/main/scala/rocket/DCache.scala:269:27, :282:26, :1007:122, generators/rocket-chip/src/main/scala/rocket/HellaCache.scala:234:14]
    .io_x_ae_ptw   (1'h0),	// @[generators/rocket-chip/src/main/scala/rocket/DCache.scala:269:27, :282:26, :1007:122, generators/rocket-chip/src/main/scala/rocket/HellaCache.scala:234:14]
    .io_x_ae_final (1'h0),	// @[generators/rocket-chip/src/main/scala/rocket/DCache.scala:269:27, :282:26, :1007:122, generators/rocket-chip/src/main/scala/rocket/HellaCache.scala:234:14]
    .io_x_pf       (1'h0),	// @[generators/rocket-chip/src/main/scala/rocket/DCache.scala:269:27, :282:26, :1007:122, generators/rocket-chip/src/main/scala/rocket/HellaCache.scala:234:14]
    .io_x_gf       (1'h0),	// @[generators/rocket-chip/src/main/scala/rocket/DCache.scala:269:27, :282:26, :1007:122, generators/rocket-chip/src/main/scala/rocket/HellaCache.scala:234:14]
    .io_x_sw       (1'h0),	// @[generators/rocket-chip/src/main/scala/rocket/DCache.scala:269:27, :282:26, :1007:122, generators/rocket-chip/src/main/scala/rocket/HellaCache.scala:234:14]
    .io_x_sx       (1'h0),	// @[generators/rocket-chip/src/main/scala/rocket/DCache.scala:269:27, :282:26, :1007:122, generators/rocket-chip/src/main/scala/rocket/HellaCache.scala:234:14]
    .io_x_sr       (1'h0),	// @[generators/rocket-chip/src/main/scala/rocket/DCache.scala:269:27, :282:26, :1007:122, generators/rocket-chip/src/main/scala/rocket/HellaCache.scala:234:14]
    .io_x_pw       (1'h0),	// @[generators/rocket-chip/src/main/scala/rocket/DCache.scala:269:27, :282:26, :1007:122, generators/rocket-chip/src/main/scala/rocket/HellaCache.scala:234:14]
    .io_x_px       (1'h0),	// @[generators/rocket-chip/src/main/scala/rocket/DCache.scala:269:27, :282:26, :1007:122, generators/rocket-chip/src/main/scala/rocket/HellaCache.scala:234:14]
    .io_x_pr       (1'h0),	// @[generators/rocket-chip/src/main/scala/rocket/DCache.scala:269:27, :282:26, :1007:122, generators/rocket-chip/src/main/scala/rocket/HellaCache.scala:234:14]
    .io_x_ppp      (1'h0),	// @[generators/rocket-chip/src/main/scala/rocket/DCache.scala:269:27, :282:26, :1007:122, generators/rocket-chip/src/main/scala/rocket/HellaCache.scala:234:14]
    .io_x_pal      (1'h0),	// @[generators/rocket-chip/src/main/scala/rocket/DCache.scala:269:27, :282:26, :1007:122, generators/rocket-chip/src/main/scala/rocket/HellaCache.scala:234:14]
    .io_x_paa      (1'h0),	// @[generators/rocket-chip/src/main/scala/rocket/DCache.scala:269:27, :282:26, :1007:122, generators/rocket-chip/src/main/scala/rocket/HellaCache.scala:234:14]
    .io_x_eff      (1'h0),	// @[generators/rocket-chip/src/main/scala/rocket/DCache.scala:269:27, :282:26, :1007:122, generators/rocket-chip/src/main/scala/rocket/HellaCache.scala:234:14]
    .io_x_c        (1'h0),	// @[generators/rocket-chip/src/main/scala/rocket/DCache.scala:269:27, :282:26, :1007:122, generators/rocket-chip/src/main/scala/rocket/HellaCache.scala:234:14]
    .io_y_u        (/* unused */),
    .io_y_ae_ptw   (/* unused */),
    .io_y_ae_final (/* unused */),
    .io_y_pf       (/* unused */),
    .io_y_gf       (/* unused */),
    .io_y_sw       (/* unused */),
    .io_y_sx       (/* unused */),
    .io_y_sr       (/* unused */),
    .io_y_pw       (/* unused */),
    .io_y_px       (/* unused */),
    .io_y_pr       (/* unused */),
    .io_y_ppp      (/* unused */),
    .io_y_pal      (/* unused */),
    .io_y_paa      (/* unused */),
    .io_y_eff      (/* unused */),
    .io_y_c        (/* unused */)
  );
  OptimizationBarrier pma_checker_entries_barrier_1 (	// @[generators/rocket-chip/src/main/scala/util/package.scala:259:25]
    .io_x_u        (1'h0),	// @[generators/rocket-chip/src/main/scala/rocket/DCache.scala:269:27, :282:26, :1007:122, generators/rocket-chip/src/main/scala/rocket/HellaCache.scala:234:14]
    .io_x_ae_ptw   (1'h0),	// @[generators/rocket-chip/src/main/scala/rocket/DCache.scala:269:27, :282:26, :1007:122, generators/rocket-chip/src/main/scala/rocket/HellaCache.scala:234:14]
    .io_x_ae_final (1'h0),	// @[generators/rocket-chip/src/main/scala/rocket/DCache.scala:269:27, :282:26, :1007:122, generators/rocket-chip/src/main/scala/rocket/HellaCache.scala:234:14]
    .io_x_pf       (1'h0),	// @[generators/rocket-chip/src/main/scala/rocket/DCache.scala:269:27, :282:26, :1007:122, generators/rocket-chip/src/main/scala/rocket/HellaCache.scala:234:14]
    .io_x_gf       (1'h0),	// @[generators/rocket-chip/src/main/scala/rocket/DCache.scala:269:27, :282:26, :1007:122, generators/rocket-chip/src/main/scala/rocket/HellaCache.scala:234:14]
    .io_x_sw       (1'h0),	// @[generators/rocket-chip/src/main/scala/rocket/DCache.scala:269:27, :282:26, :1007:122, generators/rocket-chip/src/main/scala/rocket/HellaCache.scala:234:14]
    .io_x_sx       (1'h0),	// @[generators/rocket-chip/src/main/scala/rocket/DCache.scala:269:27, :282:26, :1007:122, generators/rocket-chip/src/main/scala/rocket/HellaCache.scala:234:14]
    .io_x_sr       (1'h0),	// @[generators/rocket-chip/src/main/scala/rocket/DCache.scala:269:27, :282:26, :1007:122, generators/rocket-chip/src/main/scala/rocket/HellaCache.scala:234:14]
    .io_x_pw       (1'h0),	// @[generators/rocket-chip/src/main/scala/rocket/DCache.scala:269:27, :282:26, :1007:122, generators/rocket-chip/src/main/scala/rocket/HellaCache.scala:234:14]
    .io_x_px       (1'h0),	// @[generators/rocket-chip/src/main/scala/rocket/DCache.scala:269:27, :282:26, :1007:122, generators/rocket-chip/src/main/scala/rocket/HellaCache.scala:234:14]
    .io_x_pr       (1'h0),	// @[generators/rocket-chip/src/main/scala/rocket/DCache.scala:269:27, :282:26, :1007:122, generators/rocket-chip/src/main/scala/rocket/HellaCache.scala:234:14]
    .io_x_ppp      (1'h0),	// @[generators/rocket-chip/src/main/scala/rocket/DCache.scala:269:27, :282:26, :1007:122, generators/rocket-chip/src/main/scala/rocket/HellaCache.scala:234:14]
    .io_x_pal      (1'h0),	// @[generators/rocket-chip/src/main/scala/rocket/DCache.scala:269:27, :282:26, :1007:122, generators/rocket-chip/src/main/scala/rocket/HellaCache.scala:234:14]
    .io_x_paa      (1'h0),	// @[generators/rocket-chip/src/main/scala/rocket/DCache.scala:269:27, :282:26, :1007:122, generators/rocket-chip/src/main/scala/rocket/HellaCache.scala:234:14]
    .io_x_eff      (1'h0),	// @[generators/rocket-chip/src/main/scala/rocket/DCache.scala:269:27, :282:26, :1007:122, generators/rocket-chip/src/main/scala/rocket/HellaCache.scala:234:14]
    .io_x_c        (1'h0),	// @[generators/rocket-chip/src/main/scala/rocket/DCache.scala:269:27, :282:26, :1007:122, generators/rocket-chip/src/main/scala/rocket/HellaCache.scala:234:14]
    .io_y_u        (/* unused */),
    .io_y_ae_ptw   (/* unused */),
    .io_y_ae_final (/* unused */),
    .io_y_pf       (/* unused */),
    .io_y_gf       (/* unused */),
    .io_y_sw       (/* unused */),
    .io_y_sx       (/* unused */),
    .io_y_sr       (/* unused */),
    .io_y_pw       (/* unused */),
    .io_y_px       (/* unused */),
    .io_y_pr       (/* unused */),
    .io_y_ppp      (/* unused */),
    .io_y_pal      (/* unused */),
    .io_y_paa      (/* unused */),
    .io_y_eff      (/* unused */),
    .io_y_c        (/* unused */)
  );
  OptimizationBarrier pma_checker_entries_barrier_2 (	// @[generators/rocket-chip/src/main/scala/util/package.scala:259:25]
    .io_x_u        (1'h0),	// @[generators/rocket-chip/src/main/scala/rocket/DCache.scala:269:27, :282:26, :1007:122, generators/rocket-chip/src/main/scala/rocket/HellaCache.scala:234:14]
    .io_x_ae_ptw   (1'h0),	// @[generators/rocket-chip/src/main/scala/rocket/DCache.scala:269:27, :282:26, :1007:122, generators/rocket-chip/src/main/scala/rocket/HellaCache.scala:234:14]
    .io_x_ae_final (1'h0),	// @[generators/rocket-chip/src/main/scala/rocket/DCache.scala:269:27, :282:26, :1007:122, generators/rocket-chip/src/main/scala/rocket/HellaCache.scala:234:14]
    .io_x_pf       (1'h0),	// @[generators/rocket-chip/src/main/scala/rocket/DCache.scala:269:27, :282:26, :1007:122, generators/rocket-chip/src/main/scala/rocket/HellaCache.scala:234:14]
    .io_x_gf       (1'h0),	// @[generators/rocket-chip/src/main/scala/rocket/DCache.scala:269:27, :282:26, :1007:122, generators/rocket-chip/src/main/scala/rocket/HellaCache.scala:234:14]
    .io_x_sw       (1'h0),	// @[generators/rocket-chip/src/main/scala/rocket/DCache.scala:269:27, :282:26, :1007:122, generators/rocket-chip/src/main/scala/rocket/HellaCache.scala:234:14]
    .io_x_sx       (1'h0),	// @[generators/rocket-chip/src/main/scala/rocket/DCache.scala:269:27, :282:26, :1007:122, generators/rocket-chip/src/main/scala/rocket/HellaCache.scala:234:14]
    .io_x_sr       (1'h0),	// @[generators/rocket-chip/src/main/scala/rocket/DCache.scala:269:27, :282:26, :1007:122, generators/rocket-chip/src/main/scala/rocket/HellaCache.scala:234:14]
    .io_x_pw       (1'h0),	// @[generators/rocket-chip/src/main/scala/rocket/DCache.scala:269:27, :282:26, :1007:122, generators/rocket-chip/src/main/scala/rocket/HellaCache.scala:234:14]
    .io_x_px       (1'h0),	// @[generators/rocket-chip/src/main/scala/rocket/DCache.scala:269:27, :282:26, :1007:122, generators/rocket-chip/src/main/scala/rocket/HellaCache.scala:234:14]
    .io_x_pr       (1'h0),	// @[generators/rocket-chip/src/main/scala/rocket/DCache.scala:269:27, :282:26, :1007:122, generators/rocket-chip/src/main/scala/rocket/HellaCache.scala:234:14]
    .io_x_ppp      (1'h0),	// @[generators/rocket-chip/src/main/scala/rocket/DCache.scala:269:27, :282:26, :1007:122, generators/rocket-chip/src/main/scala/rocket/HellaCache.scala:234:14]
    .io_x_pal      (1'h0),	// @[generators/rocket-chip/src/main/scala/rocket/DCache.scala:269:27, :282:26, :1007:122, generators/rocket-chip/src/main/scala/rocket/HellaCache.scala:234:14]
    .io_x_paa      (1'h0),	// @[generators/rocket-chip/src/main/scala/rocket/DCache.scala:269:27, :282:26, :1007:122, generators/rocket-chip/src/main/scala/rocket/HellaCache.scala:234:14]
    .io_x_eff      (1'h0),	// @[generators/rocket-chip/src/main/scala/rocket/DCache.scala:269:27, :282:26, :1007:122, generators/rocket-chip/src/main/scala/rocket/HellaCache.scala:234:14]
    .io_x_c        (1'h0),	// @[generators/rocket-chip/src/main/scala/rocket/DCache.scala:269:27, :282:26, :1007:122, generators/rocket-chip/src/main/scala/rocket/HellaCache.scala:234:14]
    .io_y_u        (/* unused */),
    .io_y_ae_ptw   (/* unused */),
    .io_y_ae_final (/* unused */),
    .io_y_pf       (/* unused */),
    .io_y_gf       (/* unused */),
    .io_y_sw       (/* unused */),
    .io_y_sx       (/* unused */),
    .io_y_sr       (/* unused */),
    .io_y_pw       (/* unused */),
    .io_y_px       (/* unused */),
    .io_y_pr       (/* unused */),
    .io_y_ppp      (/* unused */),
    .io_y_pal      (/* unused */),
    .io_y_paa      (/* unused */),
    .io_y_eff      (/* unused */),
    .io_y_c        (/* unused */)
  );
  OptimizationBarrier pma_checker_entries_barrier_3 (	// @[generators/rocket-chip/src/main/scala/util/package.scala:259:25]
    .io_x_u        (1'h0),	// @[generators/rocket-chip/src/main/scala/rocket/DCache.scala:269:27, :282:26, :1007:122, generators/rocket-chip/src/main/scala/rocket/HellaCache.scala:234:14]
    .io_x_ae_ptw   (1'h0),	// @[generators/rocket-chip/src/main/scala/rocket/DCache.scala:269:27, :282:26, :1007:122, generators/rocket-chip/src/main/scala/rocket/HellaCache.scala:234:14]
    .io_x_ae_final (1'h0),	// @[generators/rocket-chip/src/main/scala/rocket/DCache.scala:269:27, :282:26, :1007:122, generators/rocket-chip/src/main/scala/rocket/HellaCache.scala:234:14]
    .io_x_pf       (1'h0),	// @[generators/rocket-chip/src/main/scala/rocket/DCache.scala:269:27, :282:26, :1007:122, generators/rocket-chip/src/main/scala/rocket/HellaCache.scala:234:14]
    .io_x_gf       (1'h0),	// @[generators/rocket-chip/src/main/scala/rocket/DCache.scala:269:27, :282:26, :1007:122, generators/rocket-chip/src/main/scala/rocket/HellaCache.scala:234:14]
    .io_x_sw       (1'h0),	// @[generators/rocket-chip/src/main/scala/rocket/DCache.scala:269:27, :282:26, :1007:122, generators/rocket-chip/src/main/scala/rocket/HellaCache.scala:234:14]
    .io_x_sx       (1'h0),	// @[generators/rocket-chip/src/main/scala/rocket/DCache.scala:269:27, :282:26, :1007:122, generators/rocket-chip/src/main/scala/rocket/HellaCache.scala:234:14]
    .io_x_sr       (1'h0),	// @[generators/rocket-chip/src/main/scala/rocket/DCache.scala:269:27, :282:26, :1007:122, generators/rocket-chip/src/main/scala/rocket/HellaCache.scala:234:14]
    .io_x_pw       (1'h0),	// @[generators/rocket-chip/src/main/scala/rocket/DCache.scala:269:27, :282:26, :1007:122, generators/rocket-chip/src/main/scala/rocket/HellaCache.scala:234:14]
    .io_x_px       (1'h0),	// @[generators/rocket-chip/src/main/scala/rocket/DCache.scala:269:27, :282:26, :1007:122, generators/rocket-chip/src/main/scala/rocket/HellaCache.scala:234:14]
    .io_x_pr       (1'h0),	// @[generators/rocket-chip/src/main/scala/rocket/DCache.scala:269:27, :282:26, :1007:122, generators/rocket-chip/src/main/scala/rocket/HellaCache.scala:234:14]
    .io_x_ppp      (1'h0),	// @[generators/rocket-chip/src/main/scala/rocket/DCache.scala:269:27, :282:26, :1007:122, generators/rocket-chip/src/main/scala/rocket/HellaCache.scala:234:14]
    .io_x_pal      (1'h0),	// @[generators/rocket-chip/src/main/scala/rocket/DCache.scala:269:27, :282:26, :1007:122, generators/rocket-chip/src/main/scala/rocket/HellaCache.scala:234:14]
    .io_x_paa      (1'h0),	// @[generators/rocket-chip/src/main/scala/rocket/DCache.scala:269:27, :282:26, :1007:122, generators/rocket-chip/src/main/scala/rocket/HellaCache.scala:234:14]
    .io_x_eff      (1'h0),	// @[generators/rocket-chip/src/main/scala/rocket/DCache.scala:269:27, :282:26, :1007:122, generators/rocket-chip/src/main/scala/rocket/HellaCache.scala:234:14]
    .io_x_c        (1'h0),	// @[generators/rocket-chip/src/main/scala/rocket/DCache.scala:269:27, :282:26, :1007:122, generators/rocket-chip/src/main/scala/rocket/HellaCache.scala:234:14]
    .io_y_u        (/* unused */),
    .io_y_ae_ptw   (/* unused */),
    .io_y_ae_final (/* unused */),
    .io_y_pf       (/* unused */),
    .io_y_gf       (/* unused */),
    .io_y_sw       (/* unused */),
    .io_y_sx       (/* unused */),
    .io_y_sr       (/* unused */),
    .io_y_pw       (/* unused */),
    .io_y_px       (/* unused */),
    .io_y_pr       (/* unused */),
    .io_y_ppp      (/* unused */),
    .io_y_pal      (/* unused */),
    .io_y_paa      (/* unused */),
    .io_y_eff      (/* unused */),
    .io_y_c        (/* unused */)
  );
  OptimizationBarrier pma_checker_entries_barrier_4 (	// @[generators/rocket-chip/src/main/scala/util/package.scala:259:25]
    .io_x_u        (1'h0),	// @[generators/rocket-chip/src/main/scala/rocket/DCache.scala:269:27, :282:26, :1007:122, generators/rocket-chip/src/main/scala/rocket/HellaCache.scala:234:14]
    .io_x_ae_ptw   (1'h0),	// @[generators/rocket-chip/src/main/scala/rocket/DCache.scala:269:27, :282:26, :1007:122, generators/rocket-chip/src/main/scala/rocket/HellaCache.scala:234:14]
    .io_x_ae_final (1'h0),	// @[generators/rocket-chip/src/main/scala/rocket/DCache.scala:269:27, :282:26, :1007:122, generators/rocket-chip/src/main/scala/rocket/HellaCache.scala:234:14]
    .io_x_pf       (1'h0),	// @[generators/rocket-chip/src/main/scala/rocket/DCache.scala:269:27, :282:26, :1007:122, generators/rocket-chip/src/main/scala/rocket/HellaCache.scala:234:14]
    .io_x_gf       (1'h0),	// @[generators/rocket-chip/src/main/scala/rocket/DCache.scala:269:27, :282:26, :1007:122, generators/rocket-chip/src/main/scala/rocket/HellaCache.scala:234:14]
    .io_x_sw       (1'h0),	// @[generators/rocket-chip/src/main/scala/rocket/DCache.scala:269:27, :282:26, :1007:122, generators/rocket-chip/src/main/scala/rocket/HellaCache.scala:234:14]
    .io_x_sx       (1'h0),	// @[generators/rocket-chip/src/main/scala/rocket/DCache.scala:269:27, :282:26, :1007:122, generators/rocket-chip/src/main/scala/rocket/HellaCache.scala:234:14]
    .io_x_sr       (1'h0),	// @[generators/rocket-chip/src/main/scala/rocket/DCache.scala:269:27, :282:26, :1007:122, generators/rocket-chip/src/main/scala/rocket/HellaCache.scala:234:14]
    .io_x_pw       (1'h0),	// @[generators/rocket-chip/src/main/scala/rocket/DCache.scala:269:27, :282:26, :1007:122, generators/rocket-chip/src/main/scala/rocket/HellaCache.scala:234:14]
    .io_x_px       (1'h0),	// @[generators/rocket-chip/src/main/scala/rocket/DCache.scala:269:27, :282:26, :1007:122, generators/rocket-chip/src/main/scala/rocket/HellaCache.scala:234:14]
    .io_x_pr       (1'h0),	// @[generators/rocket-chip/src/main/scala/rocket/DCache.scala:269:27, :282:26, :1007:122, generators/rocket-chip/src/main/scala/rocket/HellaCache.scala:234:14]
    .io_x_ppp      (1'h0),	// @[generators/rocket-chip/src/main/scala/rocket/DCache.scala:269:27, :282:26, :1007:122, generators/rocket-chip/src/main/scala/rocket/HellaCache.scala:234:14]
    .io_x_pal      (1'h0),	// @[generators/rocket-chip/src/main/scala/rocket/DCache.scala:269:27, :282:26, :1007:122, generators/rocket-chip/src/main/scala/rocket/HellaCache.scala:234:14]
    .io_x_paa      (1'h0),	// @[generators/rocket-chip/src/main/scala/rocket/DCache.scala:269:27, :282:26, :1007:122, generators/rocket-chip/src/main/scala/rocket/HellaCache.scala:234:14]
    .io_x_eff      (1'h0),	// @[generators/rocket-chip/src/main/scala/rocket/DCache.scala:269:27, :282:26, :1007:122, generators/rocket-chip/src/main/scala/rocket/HellaCache.scala:234:14]
    .io_x_c        (1'h0),	// @[generators/rocket-chip/src/main/scala/rocket/DCache.scala:269:27, :282:26, :1007:122, generators/rocket-chip/src/main/scala/rocket/HellaCache.scala:234:14]
    .io_y_u        (/* unused */),
    .io_y_ae_ptw   (/* unused */),
    .io_y_ae_final (/* unused */),
    .io_y_pf       (/* unused */),
    .io_y_gf       (/* unused */),
    .io_y_sw       (/* unused */),
    .io_y_sx       (/* unused */),
    .io_y_sr       (/* unused */),
    .io_y_pw       (/* unused */),
    .io_y_px       (/* unused */),
    .io_y_pr       (/* unused */),
    .io_y_ppp      (/* unused */),
    .io_y_pal      (/* unused */),
    .io_y_paa      (/* unused */),
    .io_y_eff      (/* unused */),
    .io_y_c        (/* unused */)
  );
  MaxPeriodFibonacciLFSR lfsr_prng (	// @[src/main/scala/chisel3/util/random/PRNG.scala:91:22]
    .clock        (clock),
    .reset        (reset),
    .io_increment (_GEN_18 & d_last),	// @[generators/rocket-chip/src/main/scala/rocket/DCache.scala:668:24, :669:26, :672:20, generators/rocket-chip/src/main/scala/tilelink/Edges.scala:232:33, generators/rocket-chip/src/main/scala/util/Replacement.scala:38:11]
    .io_out_0     (_lfsr_prng_io_out_0),
    .io_out_1     (/* unused */),
    .io_out_2     (/* unused */),
    .io_out_3     (/* unused */),
    .io_out_4     (/* unused */),
    .io_out_5     (/* unused */),
    .io_out_6     (/* unused */),
    .io_out_7     (/* unused */),
    .io_out_8     (/* unused */),
    .io_out_9     (/* unused */),
    .io_out_10    (/* unused */),
    .io_out_11    (/* unused */),
    .io_out_12    (/* unused */),
    .io_out_13    (/* unused */),
    .io_out_14    (/* unused */),
    .io_out_15    (/* unused */)
  );
  tag_array tag_array (	// @[generators/rocket-chip/src/main/scala/util/DescribedSRAM.scala:17:26]
    .RW0_addr  (resetting ? metaArb_io_in_0_bits_idx : _GEN ? metaArb_io_in_3_bits_idx : metaArb_io_in_4_valid ? metaArb_io_in_4_bits_idx : metaArb_io_in_6_valid ? metaArb_io_in_6_bits_idx : metaArb_io_in_7_bits_idx),	// @[generators/rocket-chip/src/main/scala/rocket/DCache.scala:218:26, :257:58, :447:76, :763:26, :766:29, :835:44, :836:30, :837:33, :1010:44, :1193:47, generators/rocket-chip/src/main/scala/util/package.scala:73:59, src/main/scala/chisel3/util/Arbiter.scala:137:15, :139:26, :141:19]
    .RW0_en    (tag_array_s1_meta_en | tag_array_MPORT_en),	// @[generators/rocket-chip/src/main/scala/rocket/DCache.scala:304:27, :308:59, generators/rocket-chip/src/main/scala/util/DescribedSRAM.scala:17:26]
    .RW0_clk   (clock),
    .RW0_wmode (metaArb_io_out_bits_write),	// @[src/main/scala/chisel3/util/Arbiter.scala:139:26, :141:19]
    .RW0_wdata ({2{resetting ? 22'h0 : metaArb_io_in_2_valid ? metaArb_io_in_2_bits_data : metaArb_io_in_3_valid ? metaArb_io_in_3_bits_data : metaArb_io_in_7_bits_data}}),	// @[generators/rocket-chip/src/main/scala/rocket/DCache.scala:218:26, :284:18, :440:62, :461:97, :735:53, :740:134, :907:97, generators/rocket-chip/src/main/scala/util/DescribedSRAM.scala:17:26, src/main/scala/chisel3/util/Arbiter.scala:139:26, :141:19]
    .RW0_rdata (_tag_array_RW0_rdata),
    .RW0_wmask (resetting ? 2'h3 : metaArb_io_in_2_valid ? metaArb_io_in_2_bits_way_en : metaArb_io_in_3_valid ? refill_way : releaseWay)	// @[generators/rocket-chip/src/main/scala/rocket/DCache.scala:218:26, :223:23, :426:33, :440:62, :735:53, :807:14, :857:102, :871:18, generators/rocket-chip/src/main/scala/rocket/HellaCache.scala:234:14, src/main/scala/chisel3/util/Arbiter.scala:139:26, :141:19]
  );
  DCacheDataArray data (	// @[generators/rocket-chip/src/main/scala/rocket/DCache.scala:139:20]
    .clock               (clock),
    .io_req_valid        (dataArb_io_out_valid),	// @[src/main/scala/chisel3/util/Arbiter.scala:148:31]
    .io_req_bits_addr    (dataArb_io_in_0_valid ? _dataArb_io_in_0_bits_wordMask_wordMask_T : dataArb_io_in_1_valid ? dataArb_io_in_1_bits_addr : dataArb_io_in_2_valid ? dataArb_io_in_2_bits_addr : dataArb_io_in_3_bits_addr),	// @[generators/rocket-chip/src/main/scala/rocket/DCache.scala:239:30, :511:44, :543:36, :715:26, :722:32, :746:68, :749:29, :751:32, :894:41, :897:72, src/main/scala/chisel3/util/Arbiter.scala:137:15, :139:26, :141:19]
    .io_req_bits_write   (dataArb_io_in_0_valid ? dataArb_io_in_0_bits_write : dataArb_io_in_1_valid & dataArb_io_in_1_bits_write),	// @[generators/rocket-chip/src/main/scala/rocket/DCache.scala:511:44, :715:26, :721:33, :746:68, :749:29, :751:32, src/main/scala/chisel3/util/Arbiter.scala:139:26, :141:19]
    .io_req_bits_wdata   (dataArb_io_in_0_valid ? dataArb_io_in_0_bits_wdata : auto_out_d_bits_data),	// @[generators/rocket-chip/src/main/scala/rocket/DCache.scala:511:44, :545:63, src/main/scala/chisel3/util/Arbiter.scala:139:26, :141:19]
    .io_req_bits_eccMask (dataArb_io_in_0_valid ? dataArb_io_in_0_bits_eccMask : 4'hF),	// @[generators/rocket-chip/src/main/scala/rocket/DCache.scala:511:44, :551:47, generators/rocket-chip/src/main/scala/util/package.scala:16:47, src/main/scala/chisel3/util/Arbiter.scala:139:26, :141:19]
    .io_req_bits_way_en  (dataArb_io_in_0_valid ? dataArb_io_in_0_bits_way_en : dataArb_io_in_1_valid ? refill_way : 2'h3),	// @[generators/rocket-chip/src/main/scala/rocket/DCache.scala:223:23, :511:44, :544:38, :715:26, :746:68, :749:29, :751:32, generators/rocket-chip/src/main/scala/rocket/HellaCache.scala:234:14, src/main/scala/chisel3/util/Arbiter.scala:139:26, :141:19]
    .io_resp_0           (_data_io_resp_0),
    .io_resp_1           (_data_io_resp_1)
  );
  AMOALU amoalus_0 (	// @[generators/rocket-chip/src/main/scala/rocket/DCache.scala:975:26]
    .io_mask (pstore1_mask),	// @[generators/rocket-chip/src/main/scala/rocket/DCache.scala:490:31]
    .io_cmd  (pstore1_cmd),	// @[generators/rocket-chip/src/main/scala/rocket/DCache.scala:486:30]
    .io_lhs  (s2_data),	// @[generators/rocket-chip/src/main/scala/rocket/DCache.scala:373:18]
    .io_rhs  (pstore1_data),	// @[generators/rocket-chip/src/main/scala/rocket/DCache.scala:488:31]
    .io_out  (_amoalus_0_io_out)
  );
  assign auto_out_a_valid = nodeOut_a_deq_valid;	// @[generators/rocket-chip/src/main/scala/rocket/DCache.scala:598:32]
  assign auto_out_a_bits_opcode = s2_pma_cacheable ? 3'h6 : s2_write ? (_metaArb_io_in_3_bits_data_c_cat_T_24 ? 3'h1 : io_cpu_resp_bits_has_data_0 ? (_atomics_T_16 | _atomics_T_14 | _atomics_T_12 | _atomics_T_10 | _atomics_T_8 ? 3'h2 : _atomics_T_6 | _atomics_T_4 | _atomics_T_2 | _atomics_T ? 3'h3 : 3'h0) : 3'h0) : 3'h4;	// @[generators/rocket-chip/src/main/scala/rocket/Consts.scala:85:68, :86:{49,76}, generators/rocket-chip/src/main/scala/rocket/DCache.scala:337:19, :581:81, :602:23, :603:8, :604:8, :605:8, generators/rocket-chip/src/main/scala/util/Misc.scala:38:36, generators/rocket-chip/src/main/scala/util/Replacement.scala:168:70, generators/rocket-chip/src/main/scala/util/package.scala:16:47]
  assign auto_out_a_bits_param = s2_pma_cacheable ? {1'h0, _GEN_3[_GEN_1]} : ~s2_write | _metaArb_io_in_3_bits_data_c_cat_T_24 | ~io_cpu_resp_bits_has_data_0 ? 3'h0 : _atomics_T_16 ? 3'h3 : _atomics_T_14 ? 3'h2 : _atomics_T_12 ? 3'h1 : _atomics_T_10 ? 3'h0 : _atomics_T_8 ? 3'h4 : _atomics_T_6 ? 3'h2 : _atomics_T_4 ? 3'h1 : _atomics_T_2 | ~_atomics_T ? 3'h0 : 3'h3;	// @[generators/rocket-chip/src/main/scala/rocket/Consts.scala:85:68, :86:{49,76}, generators/rocket-chip/src/main/scala/rocket/DCache.scala:269:27, :282:26, :337:19, :581:81, :602:23, :603:{8,9}, :604:8, :605:{8,9}, :1007:122, generators/rocket-chip/src/main/scala/rocket/HellaCache.scala:234:14, generators/rocket-chip/src/main/scala/tilelink/Edges.scala:348:15, generators/rocket-chip/src/main/scala/tilelink/Metadata.scala:58:19, generators/rocket-chip/src/main/scala/util/Misc.scala:35:36, :38:36, :49:20, generators/rocket-chip/src/main/scala/util/Replacement.scala:168:70, generators/rocket-chip/src/main/scala/util/package.scala:16:47]
  assign auto_out_a_bits_size = s2_pma_cacheable ? 3'h6 : _GEN_17 ? {1'h0, s2_req_size} : 3'h0;	// @[generators/rocket-chip/src/main/scala/rocket/DCache.scala:269:27, :282:26, :333:19, :337:19, :602:23, :603:8, :1007:122, generators/rocket-chip/src/main/scala/rocket/HellaCache.scala:234:14, generators/rocket-chip/src/main/scala/tilelink/Edges.scala:463:15, generators/rocket-chip/src/main/scala/util/Replacement.scala:168:70, generators/rocket-chip/src/main/scala/util/package.scala:16:47]
  assign auto_out_a_bits_source = ~s2_pma_cacheable & (~s2_write | _metaArb_io_in_3_bits_data_c_cat_T_24 | ~io_cpu_resp_bits_has_data_0 | _atomics_T_16 | _atomics_T_14 | _atomics_T_12 | _atomics_T_10 | _atomics_T_8 | _atomics_T_6 | _atomics_T_4 | _atomics_T_2 | _atomics_T);	// @[generators/rocket-chip/src/main/scala/rocket/Consts.scala:85:68, :86:{49,76}, generators/rocket-chip/src/main/scala/rocket/DCache.scala:337:19, :581:81, :602:23, :603:{8,9}, :605:9]
  assign auto_out_a_bits_address = s2_pma_cacheable ? {s2_req_addr[31:6], 6'h0} : _GEN_17 ? s2_req_addr : 32'h0;	// @[generators/rocket-chip/src/main/scala/rocket/DCache.scala:94:20, :333:19, :337:19, :470:49, :602:23, :603:8, :1203:60, generators/rocket-chip/src/main/scala/rocket/HellaCache.scala:234:14, generators/rocket-chip/src/main/scala/rocket/TLB.scala:516:74]
  assign auto_out_a_bits_mask =
    s2_pma_cacheable
      ? 4'hF
      : s2_write
          ? (_metaArb_io_in_3_bits_data_c_cat_T_24
               ? pstore1_mask
               : io_cpu_resp_bits_has_data_0
                   ? (_atomics_T_16
                        ? {atomics_a_mask_acc_49 | s2_req_addr[1] & s2_req_addr[0], atomics_a_mask_acc_49 | s2_req_addr[1] & ~(s2_req_addr[0]), atomics_a_mask_acc_48 | ~(s2_req_addr[1]) & s2_req_addr[0], atomics_a_mask_acc_48 | ~(s2_req_addr[1]) & ~(s2_req_addr[0])}
                        : _atomics_T_14
                            ? {atomics_a_mask_acc_43 | s2_req_addr[1] & s2_req_addr[0], atomics_a_mask_acc_43 | s2_req_addr[1] & ~(s2_req_addr[0]), atomics_a_mask_acc_42 | ~(s2_req_addr[1]) & s2_req_addr[0], atomics_a_mask_acc_42 | ~(s2_req_addr[1]) & ~(s2_req_addr[0])}
                            : _atomics_T_12 ? {atomics_a_mask_acc_37 | s2_req_addr[1] & s2_req_addr[0], atomics_a_mask_acc_37 | s2_req_addr[1] & ~(s2_req_addr[0]), atomics_a_mask_acc_36 | ~(s2_req_addr[1]) & s2_req_addr[0], atomics_a_mask_acc_36 | ~(s2_req_addr[1]) & ~(s2_req_addr[0])} : _atomics_T_10 ? {atomics_a_mask_acc_31 | s2_req_addr[1] & s2_req_addr[0], atomics_a_mask_acc_31 | s2_req_addr[1] & ~(s2_req_addr[0]), atomics_a_mask_acc_30 | ~(s2_req_addr[1]) & s2_req_addr[0], atomics_a_mask_acc_30 | ~(s2_req_addr[1]) & ~(s2_req_addr[0])} : _atomics_T_8 ? {atomics_a_mask_acc_25 | s2_req_addr[1] & s2_req_addr[0], atomics_a_mask_acc_25 | s2_req_addr[1] & ~(s2_req_addr[0]), atomics_a_mask_acc_24 | ~(s2_req_addr[1]) & s2_req_addr[0], atomics_a_mask_acc_24 | ~(s2_req_addr[1]) & ~(s2_req_addr[0])} : _atomics_T_6 ? {atomics_a_mask_acc_19 | s2_req_addr[1] & s2_req_addr[0], atomics_a_mask_acc_19 | s2_req_addr[1] & ~(s2_req_addr[0]), atomics_a_mask_acc_18 | ~(s2_req_addr[1]) & s2_req_addr[0], atomics_a_mask_acc_18 | ~(s2_req_addr[1]) & ~(s2_req_addr[0])} : _atomics_T_4 ? {atomics_a_mask_acc_13 | s2_req_addr[1] & s2_req_addr[0], atomics_a_mask_acc_13 | s2_req_addr[1] & ~(s2_req_addr[0]), atomics_a_mask_acc_12 | ~(s2_req_addr[1]) & s2_req_addr[0], atomics_a_mask_acc_12 | ~(s2_req_addr[1]) & ~(s2_req_addr[0])} : _atomics_T_2 ? {atomics_a_mask_acc_7 | s2_req_addr[1] & s2_req_addr[0], atomics_a_mask_acc_7 | s2_req_addr[1] & ~(s2_req_addr[0]), atomics_a_mask_acc_6 | ~(s2_req_addr[1]) & s2_req_addr[0], atomics_a_mask_acc_6 | ~(s2_req_addr[1]) & ~(s2_req_addr[0])} : _atomics_T ? {atomics_a_mask_acc_1 | s2_req_addr[1] & s2_req_addr[0], atomics_a_mask_acc_1 | s2_req_addr[1] & ~(s2_req_addr[0]), atomics_a_mask_acc | ~(s2_req_addr[1]) & s2_req_addr[0], atomics_a_mask_acc | ~(s2_req_addr[1]) & ~(s2_req_addr[0])} : 4'h0)
                   : {put_a_mask_acc_1 | s2_req_addr[1] & s2_req_addr[0], put_a_mask_acc_1 | s2_req_addr[1] & ~(s2_req_addr[0]), put_a_mask_acc | ~(s2_req_addr[1]) & s2_req_addr[0], put_a_mask_acc | ~(s2_req_addr[1]) & ~(s2_req_addr[0])})
          : {get_a_mask_acc_1 | s2_req_addr[1] & s2_req_addr[0], get_a_mask_acc_1 | s2_req_addr[1] & ~(s2_req_addr[0]), get_a_mask_acc | ~(s2_req_addr[1]) & s2_req_addr[0], get_a_mask_acc | ~(s2_req_addr[1]) & ~(s2_req_addr[0])};	// @[generators/rocket-chip/src/main/scala/rocket/Consts.scala:85:68, :86:{49,76}, generators/rocket-chip/src/main/scala/rocket/DCache.scala:333:19, :337:19, :490:31, :581:81, :602:23, :603:8, :604:8, :605:8, generators/rocket-chip/src/main/scala/rocket/HellaCache.scala:234:14, generators/rocket-chip/src/main/scala/util/Misc.scala:210:26, :211:20, :214:27, :215:29, :222:10, generators/rocket-chip/src/main/scala/util/package.scala:16:47]
  assign auto_out_a_bits_data = s2_pma_cacheable | ~s2_write | ~(_metaArb_io_in_3_bits_data_c_cat_T_24 | ~io_cpu_resp_bits_has_data_0 | _atomics_T_16 | _atomics_T_14 | _atomics_T_12 | _atomics_T_10 | _atomics_T_8 | _atomics_T_6 | _atomics_T_4 | _atomics_T_2 | _atomics_T) ? 32'h0 : pstore1_data;	// @[generators/rocket-chip/src/main/scala/rocket/Consts.scala:85:68, :86:{49,76}, generators/rocket-chip/src/main/scala/rocket/DCache.scala:94:20, :337:19, :488:31, :581:81, :602:23, :603:{8,9}, :604:8, :605:8, generators/rocket-chip/src/main/scala/rocket/HellaCache.scala:234:14]
  assign auto_out_b_ready = nodeOut_b_ready;	// @[generators/rocket-chip/src/main/scala/rocket/DCache.scala:764:44]
  assign auto_out_c_valid = nodeOut_c_valid;	// @[generators/rocket-chip/src/main/scala/rocket/DCache.scala:818:21, :844:47, :845:22, :848:48, :849:22]
  assign auto_out_c_bits_opcode = nodeOut_c_bits_opcode;	// @[generators/rocket-chip/src/main/scala/rocket/DCache.scala:853:48, :857:102, :858:52]
  assign auto_out_c_bits_param = _GEN_27 ? ((&s2_victim_state_state) | s2_victim_state_state == 2'h2 ? 3'h1 : s2_victim_state_state == 2'h1 ? 3'h2 : s2_victim_state_state == 2'h0 ? 3'h5 : 3'h0) : _inWriteback_T_1 | _GEN_26 | ~(~s2_probe | s2_prb_ack_data | ~(|s2_probe_state_state)) ? (_GEN_14 ? 3'h3 : _GEN_11 ? 3'h4 : _GEN_10 ? 3'h5 : _GEN_9 | _GEN_8 ? 3'h0 : _GEN_7 ? 3'h4 : _GEN_6 ? 3'h5 : _GEN_5 | _GEN_4 == 4'hA ? 3'h1 : _GEN_4 == 4'h9 ? 3'h2 : _GEN_4 == 4'h8 ? 3'h5 : 3'h0) : 3'h5;	// @[generators/rocket-chip/src/main/scala/rocket/DCache.scala:94:20, :327:25, :378:33, :428:28, :805:17, :818:21, :820:28, :822:36, :824:45, :848:{25,48}, :850:21, :853:48, :854:21, :857:102, :858:52, generators/rocket-chip/src/main/scala/rocket/HellaCache.scala:234:14, generators/rocket-chip/src/main/scala/rocket/TLB.scala:474:82, generators/rocket-chip/src/main/scala/tilelink/Metadata.scala:50:45, :120:19, generators/rocket-chip/src/main/scala/util/Misc.scala:38:{9,36}, :56:20, generators/rocket-chip/src/main/scala/util/Replacement.scala:168:70, generators/rocket-chip/src/main/scala/util/package.scala:16:47, :73:59]
  assign auto_out_c_bits_size = nodeOut_c_bits_size;	// @[generators/rocket-chip/src/main/scala/rocket/DCache.scala:853:48, :857:102, :858:52]
  assign auto_out_c_bits_source = probe_bits_source;	// @[generators/rocket-chip/src/main/scala/rocket/DCache.scala:178:29]
  assign auto_out_c_bits_address = probe_bits_address;	// @[generators/rocket-chip/src/main/scala/rocket/DCache.scala:178:29]
  assign auto_out_c_bits_data = s2_data;	// @[generators/rocket-chip/src/main/scala/rocket/DCache.scala:373:18]
  assign auto_out_d_ready = nodeOut_d_ready;	// @[generators/rocket-chip/src/main/scala/rocket/DCache.scala:665:18, :716:51, :718:20, :746:68, :747:22]
  assign auto_out_e_valid = nodeOut_e_valid;	// @[generators/rocket-chip/src/main/scala/rocket/DCache.scala:708:18, :716:51, :717:20]
  assign auto_out_e_bits_sink = auto_out_d_bits_sink;
  assign io_cpu_req_ready = io_cpu_req_ready_0;	// @[generators/rocket-chip/src/main/scala/rocket/DCache.scala:269:79, :746:68, :749:29]
  assign io_cpu_s2_nack = io_cpu_s2_nack_0;	// @[generators/rocket-chip/src/main/scala/rocket/DCache.scala:439:86]
  assign io_cpu_resp_valid = s2_valid_hit_pre_data_ecc_and_waw | doUncachedResp;	// @[generators/rocket-chip/src/main/scala/rocket/DCache.scala:412:89, :941:31, :942:51]
  assign io_cpu_resp_bits_addr = doUncachedResp ? s2_uncached_resp_addr : s2_req_addr;	// @[generators/rocket-chip/src/main/scala/rocket/DCache.scala:333:19, :338:34, :911:37, :941:31, :944:25, :947:27]
  assign io_cpu_resp_bits_tag = s2_req_tag;	// @[generators/rocket-chip/src/main/scala/rocket/DCache.scala:333:19]
  assign io_cpu_resp_bits_cmd = s2_req_cmd;	// @[generators/rocket-chip/src/main/scala/rocket/DCache.scala:333:19]
  assign io_cpu_resp_bits_size = s2_req_size;	// @[generators/rocket-chip/src/main/scala/rocket/DCache.scala:333:19]
  assign io_cpu_resp_bits_signed = s2_req_signed;	// @[generators/rocket-chip/src/main/scala/rocket/DCache.scala:333:19]
  assign io_cpu_resp_bits_dprv = s2_req_dprv;	// @[generators/rocket-chip/src/main/scala/rocket/DCache.scala:333:19]
  assign io_cpu_resp_bits_dv = s2_req_dv;	// @[generators/rocket-chip/src/main/scala/rocket/DCache.scala:333:19]
  assign io_cpu_resp_bits_data = {s2_req_size == 2'h0 | s2_sc ? {24{s2_req_signed & io_cpu_resp_bits_data_zeroed_1[7]}} : {s2_req_size == 2'h1 ? {16{s2_req_signed & io_cpu_resp_bits_data_zeroed[15]}} : s2_data[31:16], io_cpu_resp_bits_data_zeroed[15:8]}, io_cpu_resp_bits_data_zeroed_1[7:1], io_cpu_resp_bits_data_zeroed_1[0] | s2_sc_fail};	// @[generators/rocket-chip/src/main/scala/rocket/AMOALU.scala:42:{24,37}, :44:23, :45:{20,26,34,49,72,81,94}, generators/rocket-chip/src/main/scala/rocket/DCache.scala:94:20, :333:19, :373:18, :471:26, :967:41, generators/rocket-chip/src/main/scala/rocket/HellaCache.scala:234:14, generators/rocket-chip/src/main/scala/util/package.scala:16:47]
  assign io_cpu_resp_bits_mask = 4'h0;	// @[generators/rocket-chip/src/main/scala/rocket/HellaCache.scala:234:14]
  assign io_cpu_resp_bits_replay = doUncachedResp;	// @[generators/rocket-chip/src/main/scala/rocket/DCache.scala:941:31]
  assign io_cpu_resp_bits_has_data = io_cpu_resp_bits_has_data_0;	// @[generators/rocket-chip/src/main/scala/rocket/Consts.scala:85:68]
  assign io_cpu_resp_bits_data_word_bypass = s2_data;	// @[generators/rocket-chip/src/main/scala/rocket/DCache.scala:373:18]
  assign io_cpu_resp_bits_data_raw = s2_data;	// @[generators/rocket-chip/src/main/scala/rocket/DCache.scala:373:18]
  assign io_cpu_resp_bits_store_data = pstore1_data;	// @[generators/rocket-chip/src/main/scala/rocket/DCache.scala:488:31]
  assign io_cpu_replay_next = io_cpu_replay_next_0;	// @[generators/rocket-chip/src/main/scala/rocket/DCache.scala:943:39]
  assign io_cpu_s2_xcpt_ma_ld = io_cpu_s2_xcpt_ma_ld_0;	// @[generators/rocket-chip/src/main/scala/rocket/DCache.scala:926:24]
  assign io_cpu_s2_xcpt_ma_st = io_cpu_s2_xcpt_ma_st_0;	// @[generators/rocket-chip/src/main/scala/rocket/DCache.scala:926:24]
  assign io_cpu_s2_xcpt_pf_ld = io_cpu_s2_xcpt_pf_ld_0;	// @[generators/rocket-chip/src/main/scala/rocket/DCache.scala:926:24]
  assign io_cpu_s2_xcpt_pf_st = io_cpu_s2_xcpt_pf_st_0;	// @[generators/rocket-chip/src/main/scala/rocket/DCache.scala:926:24]
  assign io_cpu_s2_xcpt_ae_ld = io_cpu_s2_xcpt_ae_ld_0;	// @[generators/rocket-chip/src/main/scala/rocket/DCache.scala:926:24]
  assign io_cpu_s2_xcpt_ae_st = io_cpu_s2_xcpt_ae_st_0;	// @[generators/rocket-chip/src/main/scala/rocket/DCache.scala:926:24]
  assign io_cpu_ordered = ~(s1_valid | s2_valid | cached_grant_wait | uncachedInFlight_0);	// @[generators/rocket-chip/src/main/scala/rocket/DCache.scala:176:25, :217:34, :230:33, :325:25, :923:{21,115}]
  assign io_cpu_perf_release = (io_cpu_perf_release_counter == 4'h1 | io_cpu_perf_release_beats1 == 4'h0) & _io_cpu_perf_release_T;	// @[generators/rocket-chip/src/main/scala/rocket/HellaCache.scala:234:14, generators/rocket-chip/src/main/scala/tilelink/Edges.scala:221:14, :229:27, :232:{25,33,43}, :233:22, generators/rocket-chip/src/main/scala/util/package.scala:16:47, src/main/scala/chisel3/util/Decoupled.scala:52:35]
  assign io_cpu_perf_grant = auto_out_d_valid & d_last;	// @[generators/rocket-chip/src/main/scala/rocket/DCache.scala:1071:39, generators/rocket-chip/src/main/scala/tilelink/Edges.scala:232:33]
  assign io_ptw_req_bits_bits_need_gpa = 1'h0;	// @[generators/rocket-chip/src/main/scala/rocket/DCache.scala:269:27, :282:26, :1007:122, generators/rocket-chip/src/main/scala/rocket/HellaCache.scala:234:14]
  assign io_ptw_req_bits_bits_stage2 = 1'h0;	// @[generators/rocket-chip/src/main/scala/rocket/DCache.scala:269:27, :282:26, :1007:122, generators/rocket-chip/src/main/scala/rocket/HellaCache.scala:234:14]
endmodule

