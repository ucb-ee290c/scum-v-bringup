// Generated by CIRCT unknown git version
// Standard header to adapt well known macros for register randomization.
`ifndef RANDOMIZE
  `ifdef RANDOMIZE_MEM_INIT
    `define RANDOMIZE
  `endif // RANDOMIZE_MEM_INIT
`endif // not def RANDOMIZE
`ifndef RANDOMIZE
  `ifdef RANDOMIZE_REG_INIT
    `define RANDOMIZE
  `endif // RANDOMIZE_REG_INIT
`endif // not def RANDOMIZE

// RANDOM may be set to an expression that produces a 32-bit random unsigned value.
`ifndef RANDOM
  `define RANDOM $random
`endif // not def RANDOM

// Users can define INIT_RANDOM as general code that gets injected into the
// initializer block for modules with registers.
`ifndef INIT_RANDOM
  `define INIT_RANDOM
`endif // not def INIT_RANDOM

// If using random initialization, you can also define RANDOMIZE_DELAY to
// customize the delay used, otherwise 0.002 is used.
`ifndef RANDOMIZE_DELAY
  `define RANDOMIZE_DELAY 0.002
`endif // not def RANDOMIZE_DELAY

// Define INIT_RANDOM_PROLOG_ for use in our modules below.
`ifndef INIT_RANDOM_PROLOG_
  `ifdef RANDOMIZE
    `ifdef VERILATOR
      `define INIT_RANDOM_PROLOG_ `INIT_RANDOM
    `else  // VERILATOR
      `define INIT_RANDOM_PROLOG_ `INIT_RANDOM #`RANDOMIZE_DELAY begin end
    `endif // VERILATOR
  `else  // RANDOMIZE
    `define INIT_RANDOM_PROLOG_
  `endif // RANDOMIZE
`endif // not def INIT_RANDOM_PROLOG_

// Include register initializers in init blocks unless synthesis is set
`ifndef SYNTHESIS
  `ifndef ENABLE_INITIAL_REG_
    `define ENABLE_INITIAL_REG_
  `endif // not def ENABLE_INITIAL_REG_
`endif // not def SYNTHESIS

// Include rmemory initializers in init blocks unless synthesis is set
`ifndef SYNTHESIS
  `ifndef ENABLE_INITIAL_MEM_
    `define ENABLE_INITIAL_MEM_
  `endif // not def ENABLE_INITIAL_MEM_
`endif // not def SYNTHESIS

// Standard header to adapt well known macros for prints and assertions.

// Users can define 'PRINTF_COND' to add an extra gate to prints.
`ifndef PRINTF_COND_
  `ifdef PRINTF_COND
    `define PRINTF_COND_ (`PRINTF_COND)
  `else  // PRINTF_COND
    `define PRINTF_COND_ 1
  `endif // PRINTF_COND
`endif // not def PRINTF_COND_

// Users can define 'ASSERT_VERBOSE_COND' to add an extra gate to assert error printing.
`ifndef ASSERT_VERBOSE_COND_
  `ifdef ASSERT_VERBOSE_COND
    `define ASSERT_VERBOSE_COND_ (`ASSERT_VERBOSE_COND)
  `else  // ASSERT_VERBOSE_COND
    `define ASSERT_VERBOSE_COND_ 1
  `endif // ASSERT_VERBOSE_COND
`endif // not def ASSERT_VERBOSE_COND_

// Users can define 'STOP_COND' to add an extra gate to stop conditions.
`ifndef STOP_COND_
  `ifdef STOP_COND
    `define STOP_COND_ (`STOP_COND)
  `else  // STOP_COND
    `define STOP_COND_ 1
  `endif // STOP_COND
`endif // not def STOP_COND_

module SensorOutFSM(
  input         clock,
                reset,
                io_adc_data_out_valid,	// @[generators/scumv-sensor-adc/src/main/scala/sensoradc/SensorOutFSM.scala:8:14]
  input  [23:0] io_adc_data_out_bits,	// @[generators/scumv-sensor-adc/src/main/scala/sensoradc/SensorOutFSM.scala:8:14]
  output        io_adc_sensor_out	// @[generators/scumv-sensor-adc/src/main/scala/sensoradc/SensorOutFSM.scala:8:14]
);

  reg  [23:0] adc_data_out_buffer;	// @[generators/scumv-sensor-adc/src/main/scala/sensoradc/SensorOutFSM.scala:19:36]
  reg  [7:0]  adc_out_counter;	// @[generators/scumv-sensor-adc/src/main/scala/sensoradc/SensorOutFSM.scala:30:32]
  reg         sync_marker;	// @[generators/scumv-sensor-adc/src/main/scala/sensoradc/SensorOutFSM.scala:31:28]
  wire [7:0]  _io_adc_sensor_out_T = adc_out_counter % 8'h2;	// @[generators/scumv-sensor-adc/src/main/scala/sensoradc/SensorOutFSM.scala:30:32, :47:21]
  wire [23:0] _io_adc_sensor_out_T_2 = adc_data_out_buffer >> adc_out_counter;	// @[generators/scumv-sensor-adc/src/main/scala/sensoradc/SensorOutFSM.scala:19:36, :30:32, :48:24]
  wire        _GEN = adc_out_counter == 8'h2F;	// @[generators/scumv-sensor-adc/src/main/scala/sensoradc/SensorOutFSM.scala:30:32, :32:24]
  wire        _GEN_0 = adc_out_counter == 8'h17;	// @[generators/scumv-sensor-adc/src/main/scala/sensoradc/SensorOutFSM.scala:30:32, :36:29]
  always @(posedge clock) begin
    if (reset) begin
      adc_data_out_buffer <= 24'h0;	// @[generators/scumv-sensor-adc/src/main/scala/sensoradc/SensorOutFSM.scala:19:36]
      adc_out_counter <= 8'h0;	// @[generators/scumv-sensor-adc/src/main/scala/sensoradc/SensorOutFSM.scala:30:32]
      sync_marker <= 1'h0;	// @[generators/scumv-sensor-adc/src/main/scala/sensoradc/SensorOutFSM.scala:31:28]
    end
    else begin
      if (io_adc_data_out_valid)	// @[generators/scumv-sensor-adc/src/main/scala/sensoradc/SensorOutFSM.scala:8:14]
        adc_data_out_buffer <= io_adc_data_out_bits;	// @[generators/scumv-sensor-adc/src/main/scala/sensoradc/SensorOutFSM.scala:19:36]
      if (_GEN)	// @[generators/scumv-sensor-adc/src/main/scala/sensoradc/SensorOutFSM.scala:32:24]
        adc_out_counter <= 8'h0;	// @[generators/scumv-sensor-adc/src/main/scala/sensoradc/SensorOutFSM.scala:30:32]
      else if (_GEN_0)	// @[generators/scumv-sensor-adc/src/main/scala/sensoradc/SensorOutFSM.scala:36:29]
        adc_out_counter <= adc_out_counter + 8'h1;	// @[generators/scumv-sensor-adc/src/main/scala/sensoradc/SensorOutFSM.scala:30:32, :38:40]
      else	// @[generators/scumv-sensor-adc/src/main/scala/sensoradc/SensorOutFSM.scala:36:29]
        adc_out_counter <= adc_out_counter + 8'h1;	// @[generators/scumv-sensor-adc/src/main/scala/sensoradc/SensorOutFSM.scala:30:32, :38:40, :41:40]
      sync_marker <= ~_GEN & (_GEN_0 | sync_marker);	// @[generators/scumv-sensor-adc/src/main/scala/sensoradc/SensorOutFSM.scala:31:28, :32:{24,69}, :34:17, :36:{29,57}, :37:17]
    end
  end // always @(posedge)
  `ifdef ENABLE_INITIAL_REG_
    `ifdef FIRRTL_BEFORE_INITIAL
      `FIRRTL_BEFORE_INITIAL
    `endif // FIRRTL_BEFORE_INITIAL
    logic [31:0] _RANDOM[0:1];
    initial begin
      `ifdef INIT_RANDOM_PROLOG_
        `INIT_RANDOM_PROLOG_
      `endif // INIT_RANDOM_PROLOG_
      `ifdef RANDOMIZE_REG_INIT
        for (logic [1:0] i = 2'h0; i < 2'h2; i += 2'h1) begin
          _RANDOM[i[0]] = `RANDOM;
        end
        adc_data_out_buffer = _RANDOM[1'h0][26:3];	// @[generators/scumv-sensor-adc/src/main/scala/sensoradc/SensorOutFSM.scala:19:36]
        adc_out_counter = {_RANDOM[1'h0][31:27], _RANDOM[1'h1][2:0]};	// @[generators/scumv-sensor-adc/src/main/scala/sensoradc/SensorOutFSM.scala:19:36, :30:32]
        sync_marker = _RANDOM[1'h1][3];	// @[generators/scumv-sensor-adc/src/main/scala/sensoradc/SensorOutFSM.scala:30:32, :31:28]
      `endif // RANDOMIZE_REG_INIT
    end // initial
    `ifdef FIRRTL_AFTER_INITIAL
      `FIRRTL_AFTER_INITIAL
    `endif // FIRRTL_AFTER_INITIAL
  `endif // ENABLE_INITIAL_REG_
  assign io_adc_sensor_out = sync_marker ? _io_adc_sensor_out_T[1:0] == 2'h0 : _io_adc_sensor_out_T_2[0];	// @[generators/scumv-sensor-adc/src/main/scala/sensoradc/SensorOutFSM.scala:31:28, :45:27, :47:{21,27}, :48:24]
endmodule

