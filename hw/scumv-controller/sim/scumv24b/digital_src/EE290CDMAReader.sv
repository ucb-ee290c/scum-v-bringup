// Generated by CIRCT unknown git version
// Standard header to adapt well known macros for register randomization.
`ifndef RANDOMIZE
  `ifdef RANDOMIZE_MEM_INIT
    `define RANDOMIZE
  `endif // RANDOMIZE_MEM_INIT
`endif // not def RANDOMIZE
`ifndef RANDOMIZE
  `ifdef RANDOMIZE_REG_INIT
    `define RANDOMIZE
  `endif // RANDOMIZE_REG_INIT
`endif // not def RANDOMIZE

// RANDOM may be set to an expression that produces a 32-bit random unsigned value.
`ifndef RANDOM
  `define RANDOM $random
`endif // not def RANDOM

// Users can define INIT_RANDOM as general code that gets injected into the
// initializer block for modules with registers.
`ifndef INIT_RANDOM
  `define INIT_RANDOM
`endif // not def INIT_RANDOM

// If using random initialization, you can also define RANDOMIZE_DELAY to
// customize the delay used, otherwise 0.002 is used.
`ifndef RANDOMIZE_DELAY
  `define RANDOMIZE_DELAY 0.002
`endif // not def RANDOMIZE_DELAY

// Define INIT_RANDOM_PROLOG_ for use in our modules below.
`ifndef INIT_RANDOM_PROLOG_
  `ifdef RANDOMIZE
    `ifdef VERILATOR
      `define INIT_RANDOM_PROLOG_ `INIT_RANDOM
    `else  // VERILATOR
      `define INIT_RANDOM_PROLOG_ `INIT_RANDOM #`RANDOMIZE_DELAY begin end
    `endif // VERILATOR
  `else  // RANDOMIZE
    `define INIT_RANDOM_PROLOG_
  `endif // RANDOMIZE
`endif // not def INIT_RANDOM_PROLOG_

// Include register initializers in init blocks unless synthesis is set
`ifndef SYNTHESIS
  `ifndef ENABLE_INITIAL_REG_
    `define ENABLE_INITIAL_REG_
  `endif // not def ENABLE_INITIAL_REG_
`endif // not def SYNTHESIS

// Include rmemory initializers in init blocks unless synthesis is set
`ifndef SYNTHESIS
  `ifndef ENABLE_INITIAL_MEM_
    `define ENABLE_INITIAL_MEM_
  `endif // not def ENABLE_INITIAL_MEM_
`endif // not def SYNTHESIS

// Standard header to adapt well known macros for prints and assertions.

// Users can define 'PRINTF_COND' to add an extra gate to prints.
`ifndef PRINTF_COND_
  `ifdef PRINTF_COND
    `define PRINTF_COND_ (`PRINTF_COND)
  `else  // PRINTF_COND
    `define PRINTF_COND_ 1
  `endif // PRINTF_COND
`endif // not def PRINTF_COND_

// Users can define 'ASSERT_VERBOSE_COND' to add an extra gate to assert error printing.
`ifndef ASSERT_VERBOSE_COND_
  `ifdef ASSERT_VERBOSE_COND
    `define ASSERT_VERBOSE_COND_ (`ASSERT_VERBOSE_COND)
  `else  // ASSERT_VERBOSE_COND
    `define ASSERT_VERBOSE_COND_ 1
  `endif // ASSERT_VERBOSE_COND
`endif // not def ASSERT_VERBOSE_COND_

// Users can define 'STOP_COND' to add an extra gate to stop conditions.
`ifndef STOP_COND_
  `ifdef STOP_COND
    `define STOP_COND_ (`STOP_COND)
  `else  // STOP_COND
    `define STOP_COND_ 1
  `endif // STOP_COND
`endif // not def STOP_COND_

module EE290CDMAReader(
  input         clock,
                reset,
                auto_out_a_ready,	// @[generators/rocket-chip/src/main/scala/diplomacy/LazyModule.scala:366:18]
  output        auto_out_a_valid,	// @[generators/rocket-chip/src/main/scala/diplomacy/LazyModule.scala:366:18]
  output [31:0] auto_out_a_bits_address,	// @[generators/rocket-chip/src/main/scala/diplomacy/LazyModule.scala:366:18]
  input         auto_out_d_valid,	// @[generators/rocket-chip/src/main/scala/diplomacy/LazyModule.scala:366:18]
  input  [31:0] auto_out_d_bits_data,	// @[generators/rocket-chip/src/main/scala/diplomacy/LazyModule.scala:366:18]
  output        io_req_ready,	// @[generators/dma/src/main/scala/dma/DMA.scala:233:16]
  input         io_req_valid,	// @[generators/dma/src/main/scala/dma/DMA.scala:233:16]
  input  [31:0] io_req_bits_addr,	// @[generators/dma/src/main/scala/dma/DMA.scala:233:16]
  input  [8:0]  io_req_bits_totalBytes,	// @[generators/dma/src/main/scala/dma/DMA.scala:233:16]
  output        io_resp_valid,	// @[generators/dma/src/main/scala/dma/DMA.scala:233:16]
  output [8:0]  io_resp_bits_bytesRead,	// @[generators/dma/src/main/scala/dma/DMA.scala:233:16]
  input         io_queue_ready,	// @[generators/dma/src/main/scala/dma/DMA.scala:233:16]
  output        io_queue_valid,	// @[generators/dma/src/main/scala/dma/DMA.scala:233:16]
  output [31:0] io_queue_bits	// @[generators/dma/src/main/scala/dma/DMA.scala:233:16]
);

  reg  [31:0] req_addr;	// @[generators/dma/src/main/scala/dma/DMA.scala:240:18]
  reg  [8:0]  req_totalBytes;	// @[generators/dma/src/main/scala/dma/DMA.scala:240:18]
  reg  [2:0]  state;	// @[generators/dma/src/main/scala/dma/DMA.scala:243:24]
  reg  [8:0]  bytesRead;	// @[generators/dma/src/main/scala/dma/DMA.scala:245:24]
  reg  [31:0] dataBytes;	// @[generators/dma/src/main/scala/dma/DMA.scala:248:24]
  wire        nodeOut_a_valid = state == 3'h1;	// @[generators/dma/src/main/scala/dma/DMA.scala:243:24, :250:26]
  wire        io_queue_valid_0 = state == 3'h3;	// @[generators/dma/src/main/scala/dma/DMA.scala:243:24, :268:13, :271:36]
  wire        io_resp_valid_0 = state == 3'h4;	// @[generators/dma/src/main/scala/dma/DMA.scala:243:24, :275:46, generators/rocket-chip/src/main/scala/tilelink/Edges.scala:461:15]
  wire        io_req_ready_0 = state == 3'h0 | io_resp_valid_0;	// @[generators/dma/src/main/scala/dma/DMA.scala:243:24, :275:{27,38,46}]
  wire [8:0]  _bytesLeft_T = req_totalBytes - bytesRead;	// @[generators/dma/src/main/scala/dma/DMA.scala:240:18, :245:24, :246:36]
  wire        done = auto_out_a_ready & nodeOut_a_valid;	// @[generators/dma/src/main/scala/dma/DMA.scala:250:26, src/main/scala/chisel3/util/Decoupled.scala:52:35]
  wire        _GEN = io_req_ready_0 & io_req_valid;	// @[generators/dma/src/main/scala/dma/DMA.scala:275:38, src/main/scala/chisel3/util/Decoupled.scala:52:35]
  always @(posedge clock) begin
    if (_GEN) begin	// @[src/main/scala/chisel3/util/Decoupled.scala:52:35]
      req_addr <= io_req_bits_addr;	// @[generators/dma/src/main/scala/dma/DMA.scala:240:18]
      req_totalBytes <= io_req_bits_totalBytes;	// @[generators/dma/src/main/scala/dma/DMA.scala:240:18]
      bytesRead <= 9'h0;	// @[generators/dma/src/main/scala/dma/DMA.scala:245:24, :284:17]
    end
    else if (done) begin	// @[src/main/scala/chisel3/util/Decoupled.scala:52:35]
      req_addr <= req_addr + 32'h4;	// @[generators/dma/src/main/scala/dma/DMA.scala:240:18, :257:28]
      bytesRead <= bytesRead + (_bytesLeft_T < 9'h4 ? _bytesLeft_T : 9'h4);	// @[generators/dma/src/main/scala/dma/DMA.scala:245:24, :246:36, :258:{30,35,46}]
    end
    if (auto_out_d_valid)	// @[generators/rocket-chip/src/main/scala/diplomacy/LazyModule.scala:366:18]
      dataBytes <= auto_out_d_bits_data;	// @[generators/dma/src/main/scala/dma/DMA.scala:248:24]
    if (reset)
      state <= 3'h0;	// @[generators/dma/src/main/scala/dma/DMA.scala:243:24]
    else if (_GEN)	// @[src/main/scala/chisel3/util/Decoupled.scala:52:35]
      state <= 3'h1;	// @[generators/dma/src/main/scala/dma/DMA.scala:243:24, :250:26]
    else if (io_queue_ready & io_queue_valid_0)	// @[generators/dma/src/main/scala/dma/DMA.scala:271:{27,36}]
      state <= _bytesLeft_T == 9'h0 ? 3'h4 : 3'h1;	// @[generators/dma/src/main/scala/dma/DMA.scala:243:24, :246:36, :250:26, :272:{19,30}, :284:17, generators/rocket-chip/src/main/scala/tilelink/Edges.scala:461:15]
    else if (auto_out_d_valid)	// @[generators/rocket-chip/src/main/scala/diplomacy/LazyModule.scala:366:18]
      state <= 3'h3;	// @[generators/dma/src/main/scala/dma/DMA.scala:243:24, :268:13]
    else if (done)	// @[src/main/scala/chisel3/util/Decoupled.scala:52:35]
      state <= 3'h2;	// @[generators/dma/src/main/scala/dma/DMA.scala:243:24, :259:13]
  end // always @(posedge)
  `ifdef ENABLE_INITIAL_REG_
    `ifdef FIRRTL_BEFORE_INITIAL
      `FIRRTL_BEFORE_INITIAL
    `endif // FIRRTL_BEFORE_INITIAL
    logic [31:0] _RANDOM[0:2];
    initial begin
      `ifdef INIT_RANDOM_PROLOG_
        `INIT_RANDOM_PROLOG_
      `endif // INIT_RANDOM_PROLOG_
      `ifdef RANDOMIZE_REG_INIT
        for (logic [1:0] i = 2'h0; i < 2'h3; i += 2'h1) begin
          _RANDOM[i] = `RANDOM;
        end
        req_addr = _RANDOM[2'h0];	// @[generators/dma/src/main/scala/dma/DMA.scala:240:18]
        req_totalBytes = _RANDOM[2'h1][8:0];	// @[generators/dma/src/main/scala/dma/DMA.scala:240:18]
        state = _RANDOM[2'h1][11:9];	// @[generators/dma/src/main/scala/dma/DMA.scala:240:18, :243:24]
        bytesRead = _RANDOM[2'h1][20:12];	// @[generators/dma/src/main/scala/dma/DMA.scala:240:18, :245:24]
        dataBytes = {_RANDOM[2'h1][31:21], _RANDOM[2'h2][20:0]};	// @[generators/dma/src/main/scala/dma/DMA.scala:240:18, :248:24]
      `endif // RANDOMIZE_REG_INIT
    end // initial
    `ifdef FIRRTL_AFTER_INITIAL
      `FIRRTL_AFTER_INITIAL
    `endif // FIRRTL_AFTER_INITIAL
  `endif // ENABLE_INITIAL_REG_
  assign auto_out_a_valid = nodeOut_a_valid;	// @[generators/dma/src/main/scala/dma/DMA.scala:250:26]
  assign auto_out_a_bits_address = req_addr;	// @[generators/dma/src/main/scala/dma/DMA.scala:240:18]
  assign io_req_ready = io_req_ready_0;	// @[generators/dma/src/main/scala/dma/DMA.scala:275:38]
  assign io_resp_valid = io_resp_valid_0;	// @[generators/dma/src/main/scala/dma/DMA.scala:275:46]
  assign io_resp_bits_bytesRead = bytesRead;	// @[generators/dma/src/main/scala/dma/DMA.scala:245:24]
  assign io_queue_valid = io_queue_valid_0;	// @[generators/dma/src/main/scala/dma/DMA.scala:271:36]
  assign io_queue_bits = dataBytes;	// @[generators/dma/src/main/scala/dma/DMA.scala:248:24]
endmodule

