// Generated by CIRCT unknown git version
// Standard header to adapt well known macros for register randomization.
`ifndef RANDOMIZE
  `ifdef RANDOMIZE_MEM_INIT
    `define RANDOMIZE
  `endif // RANDOMIZE_MEM_INIT
`endif // not def RANDOMIZE
`ifndef RANDOMIZE
  `ifdef RANDOMIZE_REG_INIT
    `define RANDOMIZE
  `endif // RANDOMIZE_REG_INIT
`endif // not def RANDOMIZE

// RANDOM may be set to an expression that produces a 32-bit random unsigned value.
`ifndef RANDOM
  `define RANDOM $random
`endif // not def RANDOM

// Users can define INIT_RANDOM as general code that gets injected into the
// initializer block for modules with registers.
`ifndef INIT_RANDOM
  `define INIT_RANDOM
`endif // not def INIT_RANDOM

// If using random initialization, you can also define RANDOMIZE_DELAY to
// customize the delay used, otherwise 0.002 is used.
`ifndef RANDOMIZE_DELAY
  `define RANDOMIZE_DELAY 0.002
`endif // not def RANDOMIZE_DELAY

// Define INIT_RANDOM_PROLOG_ for use in our modules below.
`ifndef INIT_RANDOM_PROLOG_
  `ifdef RANDOMIZE
    `ifdef VERILATOR
      `define INIT_RANDOM_PROLOG_ `INIT_RANDOM
    `else  // VERILATOR
      `define INIT_RANDOM_PROLOG_ `INIT_RANDOM #`RANDOMIZE_DELAY begin end
    `endif // VERILATOR
  `else  // RANDOMIZE
    `define INIT_RANDOM_PROLOG_
  `endif // RANDOMIZE
`endif // not def INIT_RANDOM_PROLOG_

// Include register initializers in init blocks unless synthesis is set
`ifndef SYNTHESIS
  `ifndef ENABLE_INITIAL_REG_
    `define ENABLE_INITIAL_REG_
  `endif // not def ENABLE_INITIAL_REG_
`endif // not def SYNTHESIS

// Include rmemory initializers in init blocks unless synthesis is set
`ifndef SYNTHESIS
  `ifndef ENABLE_INITIAL_MEM_
    `define ENABLE_INITIAL_MEM_
  `endif // not def ENABLE_INITIAL_MEM_
`endif // not def SYNTHESIS

// Standard header to adapt well known macros for prints and assertions.

// Users can define 'PRINTF_COND' to add an extra gate to prints.
`ifndef PRINTF_COND_
  `ifdef PRINTF_COND
    `define PRINTF_COND_ (`PRINTF_COND)
  `else  // PRINTF_COND
    `define PRINTF_COND_ 1
  `endif // PRINTF_COND
`endif // not def PRINTF_COND_

// Users can define 'ASSERT_VERBOSE_COND' to add an extra gate to assert error printing.
`ifndef ASSERT_VERBOSE_COND_
  `ifdef ASSERT_VERBOSE_COND
    `define ASSERT_VERBOSE_COND_ (`ASSERT_VERBOSE_COND)
  `else  // ASSERT_VERBOSE_COND
    `define ASSERT_VERBOSE_COND_ 1
  `endif // ASSERT_VERBOSE_COND
`endif // not def ASSERT_VERBOSE_COND_

// Users can define 'STOP_COND' to add an extra gate to stop conditions.
`ifndef STOP_COND_
  `ifdef STOP_COND
    `define STOP_COND_ (`STOP_COND)
  `else  // STOP_COND
    `define STOP_COND_ 1
  `endif // STOP_COND
`endif // not def STOP_COND_

module AFETL(
  input         clock,
                reset,
  output        auto_control_xing_in_a_ready,	// @[generators/rocket-chip/src/main/scala/diplomacy/LazyModule.scala:366:18]
  input         auto_control_xing_in_a_valid,	// @[generators/rocket-chip/src/main/scala/diplomacy/LazyModule.scala:366:18]
  input  [2:0]  auto_control_xing_in_a_bits_opcode,	// @[generators/rocket-chip/src/main/scala/diplomacy/LazyModule.scala:366:18]
                auto_control_xing_in_a_bits_param,	// @[generators/rocket-chip/src/main/scala/diplomacy/LazyModule.scala:366:18]
  input  [1:0]  auto_control_xing_in_a_bits_size,	// @[generators/rocket-chip/src/main/scala/diplomacy/LazyModule.scala:366:18]
  input  [15:0] auto_control_xing_in_a_bits_source,	// @[generators/rocket-chip/src/main/scala/diplomacy/LazyModule.scala:366:18]
  input  [14:0] auto_control_xing_in_a_bits_address,	// @[generators/rocket-chip/src/main/scala/diplomacy/LazyModule.scala:366:18]
  input  [3:0]  auto_control_xing_in_a_bits_mask,	// @[generators/rocket-chip/src/main/scala/diplomacy/LazyModule.scala:366:18]
  input  [31:0] auto_control_xing_in_a_bits_data,	// @[generators/rocket-chip/src/main/scala/diplomacy/LazyModule.scala:366:18]
  input         auto_control_xing_in_a_bits_corrupt,	// @[generators/rocket-chip/src/main/scala/diplomacy/LazyModule.scala:366:18]
                auto_control_xing_in_d_ready,	// @[generators/rocket-chip/src/main/scala/diplomacy/LazyModule.scala:366:18]
  output        auto_control_xing_in_d_valid,	// @[generators/rocket-chip/src/main/scala/diplomacy/LazyModule.scala:366:18]
  output [2:0]  auto_control_xing_in_d_bits_opcode,	// @[generators/rocket-chip/src/main/scala/diplomacy/LazyModule.scala:366:18]
  output [1:0]  auto_control_xing_in_d_bits_size,	// @[generators/rocket-chip/src/main/scala/diplomacy/LazyModule.scala:366:18]
  output [15:0] auto_control_xing_in_d_bits_source,	// @[generators/rocket-chip/src/main/scala/diplomacy/LazyModule.scala:366:18]
  output [31:0] auto_control_xing_in_d_bits_data,	// @[generators/rocket-chip/src/main/scala/diplomacy/LazyModule.scala:366:18]
  input         io_adc_clock,	// @[generators/afe/src/main/scala/afe.scala:69:14]
                io_adc_output_valid,	// @[generators/afe/src/main/scala/afe.scala:69:14]
  input  [9:0]  io_adc_output_bits,	// @[generators/afe/src/main/scala/afe.scala:69:14]
  input         io_general_trim_afe_out_valid,	// @[generators/afe/src/main/scala/afe.scala:69:14]
  input  [7:0]  io_general_trim_afe_out_bits,	// @[generators/afe/src/main/scala/afe.scala:69:14]
  output [6:0]  io_i_sel,	// @[generators/afe/src/main/scala/afe.scala:69:14]
  output        io_reset_afe_adc,	// @[generators/afe/src/main/scala/afe.scala:69:14]
  output [9:0]  io_r2r_dac_input,	// @[generators/afe/src/main/scala/afe.scala:69:14]
  output [2:0]  io_sensor_sel,	// @[generators/afe/src/main/scala/afe.scala:69:14]
  output        io_sensor_net_config,	// @[generators/afe/src/main/scala/afe.scala:69:14]
  output [4:0]  io_feedback_config,	// @[generators/afe/src/main/scala/afe.scala:69:14]
  output [1:0]  io_adc_input_sel,	// @[generators/afe/src/main/scala/afe.scala:69:14]
  output        io_select_digital_power,	// @[generators/afe/src/main/scala/afe.scala:69:14]
                io_select_analog_power,	// @[generators/afe/src/main/scala/afe.scala:69:14]
                io_select_dac_vdd,	// @[generators/afe/src/main/scala/afe.scala:69:14]
  output [7:0]  io_general_trim_afe_in,	// @[generators/afe/src/main/scala/afe.scala:69:14]
  output        io_adc_divided_clock	// @[generators/afe/src/main/scala/afe.scala:69:14]
);

  wire              _out_wofireMux_T_2;	// @[generators/rocket-chip/src/main/scala/tilelink/RegisterRouter.scala:82:24]
  wire              out_backSel_2;	// @[generators/rocket-chip/src/main/scala/tilelink/RegisterRouter.scala:82:24]
  wire              _divider_config_queue_io_deq_valid;	// @[generators/afe/src/main/scala/afe.scala:129:36]
  wire [24:0]       _divider_config_queue_io_deq_bits;	// @[generators/afe/src/main/scala/afe.scala:129:36]
  wire              _reset_sync_io_out;	// @[generators/afe/src/main/scala/afe.scala:121:26]
  reg  [7:0]        i_sel;	// @[generators/afe/src/main/scala/afe.scala:72:22]
  reg               reset_afe_adc;	// @[generators/afe/src/main/scala/afe.scala:73:30]
  reg  [9:0]        r2r_dac_input;	// @[generators/afe/src/main/scala/afe.scala:74:30]
  reg  [2:0]        sensor_sel;	// @[generators/afe/src/main/scala/afe.scala:75:27]
  reg               sensor_net_config;	// @[generators/afe/src/main/scala/afe.scala:76:34]
  reg  [4:0]        feedback_config;	// @[generators/afe/src/main/scala/afe.scala:77:32]
  reg  [1:0]        adc_input_sel;	// @[generators/afe/src/main/scala/afe.scala:78:30]
  reg               select_digital_power;	// @[generators/afe/src/main/scala/afe.scala:79:37]
  reg               select_analog_power;	// @[generators/afe/src/main/scala/afe.scala:80:36]
  reg               select_dac_vdd;	// @[generators/afe/src/main/scala/afe.scala:81:31]
  reg  [7:0]        general_trim_afe_in;	// @[generators/afe/src/main/scala/afe.scala:82:36]
  reg  [9:0]        adc_output_reg;	// @[generators/afe/src/main/scala/afe.scala:104:31]
  reg  [7:0]        general_trim_reg_out;	// @[generators/afe/src/main/scala/afe.scala:110:37]
  wire              out_front_bits_read = auto_control_xing_in_a_bits_opcode == 3'h4;	// @[generators/rocket-chip/src/main/scala/tilelink/RegisterRouter.scala:69:36]
  wire              _out_out_bits_data_WIRE_13 = auto_control_xing_in_a_bits_address[11:6] == 6'h0;	// @[generators/afe/src/main/scala/afe.scala:74:30, generators/rocket-chip/src/main/scala/tilelink/Edges.scala:192:34, generators/rocket-chip/src/main/scala/tilelink/RegisterRouter.scala:70:19, :82:24]
  wire [7:0]        _out_backMask_T_5 = {8{auto_control_xing_in_a_bits_mask[0]}};	// @[generators/rocket-chip/src/main/scala/tilelink/RegisterRouter.scala:82:24]
  assign out_backSel_2 = auto_control_xing_in_a_bits_address[5:2] == 4'h2;	// @[generators/rocket-chip/src/main/scala/tilelink/RegisterRouter.scala:82:24, src/main/scala/chisel3/util/OneHot.scala:58:35]
  assign _out_wofireMux_T_2 = auto_control_xing_in_a_valid & auto_control_xing_in_d_ready & ~out_front_bits_read;	// @[generators/rocket-chip/src/main/scala/tilelink/RegisterRouter.scala:69:36, :82:24]
  wire [15:0]       _GEN = {{1'h1}, {1'h1}, {_out_out_bits_data_WIRE_13}, {_out_out_bits_data_WIRE_13}, {_out_out_bits_data_WIRE_13}, {_out_out_bits_data_WIRE_13}, {_out_out_bits_data_WIRE_13}, {_out_out_bits_data_WIRE_13}, {_out_out_bits_data_WIRE_13}, {_out_out_bits_data_WIRE_13}, {_out_out_bits_data_WIRE_13}, {_out_out_bits_data_WIRE_13}, {_out_out_bits_data_WIRE_13}, {_out_out_bits_data_WIRE_13}, {_out_out_bits_data_WIRE_13}, {_out_out_bits_data_WIRE_13}};	// @[generators/rocket-chip/src/main/scala/tilelink/RegisterRouter.scala:82:24, generators/rocket-chip/src/main/scala/util/MuxLiteral.scala:49:10]
  wire [15:0][31:0] _GEN_0 = {{32'h0}, {32'h0}, {32'h0}, {32'h0}, {32'h0}, {32'h0}, {32'h0}, {32'h0}, {32'h0}, {32'h0}, {32'h0}, {32'h0}, {32'h0}, {32'h0}, {{24'h0, general_trim_reg_out}}, {{22'h0, adc_output_reg}}};	// @[generators/afe/src/main/scala/afe.scala:104:31, :110:37, generators/rocket-chip/src/main/scala/tilelink/Bundles.scala:259:74, generators/rocket-chip/src/main/scala/util/MuxLiteral.scala:49:{10,48}]
  wire [2:0]        controlXingIn_d_bits_opcode = {2'h0, out_front_bits_read};	// @[generators/rocket-chip/src/main/scala/tilelink/RegisterRouter.scala:69:36, :100:19]
  always @(posedge clock) begin
    if (reset) begin
      i_sel <= 8'h0;	// @[generators/afe/src/main/scala/afe.scala:72:22]
      reset_afe_adc <= 1'h0;	// @[generators/afe/src/main/scala/afe.scala:73:30]
      r2r_dac_input <= 10'h0;	// @[generators/afe/src/main/scala/afe.scala:74:30]
      sensor_sel <= 3'h0;	// @[generators/afe/src/main/scala/afe.scala:75:27, generators/rocket-chip/src/main/scala/tilelink/Bundles.scala:259:74]
      sensor_net_config <= 1'h0;	// @[generators/afe/src/main/scala/afe.scala:76:34]
      feedback_config <= 5'h0;	// @[generators/afe/src/main/scala/afe.scala:77:32]
      adc_input_sel <= 2'h0;	// @[generators/afe/src/main/scala/afe.scala:78:30]
      select_digital_power <= 1'h0;	// @[generators/afe/src/main/scala/afe.scala:79:37]
      select_analog_power <= 1'h0;	// @[generators/afe/src/main/scala/afe.scala:80:36]
      select_dac_vdd <= 1'h0;	// @[generators/afe/src/main/scala/afe.scala:81:31]
      general_trim_afe_in <= 8'h0;	// @[generators/afe/src/main/scala/afe.scala:72:22, :82:36]
      adc_output_reg <= 10'h0;	// @[generators/afe/src/main/scala/afe.scala:74:30, :104:31]
      general_trim_reg_out <= 8'h0;	// @[generators/afe/src/main/scala/afe.scala:72:22, :110:37]
    end
    else begin
      if (_out_wofireMux_T_2 & auto_control_xing_in_a_bits_address[5:2] == 4'h3 & _out_out_bits_data_WIRE_13 & auto_control_xing_in_a_bits_mask[0])	// @[generators/rocket-chip/src/main/scala/tilelink/RegisterRouter.scala:82:24, src/main/scala/chisel3/util/OneHot.scala:58:35]
        i_sel <= {1'h0, auto_control_xing_in_a_bits_data[6:0]};	// @[generators/afe/src/main/scala/afe.scala:72:22, generators/rocket-chip/src/main/scala/regmapper/RegField.scala:74:92, generators/rocket-chip/src/main/scala/tilelink/RegisterRouter.scala:82:24]
      reset_afe_adc <= _out_wofireMux_T_2 & auto_control_xing_in_a_bits_address[5:2] == 4'h4 & _out_out_bits_data_WIRE_13 & auto_control_xing_in_a_bits_mask[0] & auto_control_xing_in_a_bits_data[0];	// @[generators/afe/src/main/scala/afe.scala:73:30, :85:24, generators/rocket-chip/src/main/scala/regmapper/RegField.scala:74:{88,92}, generators/rocket-chip/src/main/scala/tilelink/RegisterRouter.scala:82:24, src/main/scala/chisel3/util/OneHot.scala:58:35]
      if (_out_wofireMux_T_2 & auto_control_xing_in_a_bits_address[5:2] == 4'h5 & _out_out_bits_data_WIRE_13 & (&{{2{auto_control_xing_in_a_bits_mask[1]}}, _out_backMask_T_5}))	// @[generators/rocket-chip/src/main/scala/tilelink/RegisterRouter.scala:82:24, src/main/scala/chisel3/util/OneHot.scala:58:35]
        r2r_dac_input <= auto_control_xing_in_a_bits_data[9:0];	// @[generators/afe/src/main/scala/afe.scala:74:30, generators/rocket-chip/src/main/scala/tilelink/RegisterRouter.scala:82:24]
      if (_out_wofireMux_T_2 & auto_control_xing_in_a_bits_address[5:2] == 4'h6 & _out_out_bits_data_WIRE_13 & auto_control_xing_in_a_bits_mask[0])	// @[generators/rocket-chip/src/main/scala/tilelink/RegisterRouter.scala:82:24, src/main/scala/chisel3/util/OneHot.scala:58:35]
        sensor_sel <= auto_control_xing_in_a_bits_data[2:0];	// @[generators/afe/src/main/scala/afe.scala:75:27, generators/rocket-chip/src/main/scala/tilelink/RegisterRouter.scala:82:24]
      if (_out_wofireMux_T_2 & auto_control_xing_in_a_bits_address[5:2] == 4'h7 & _out_out_bits_data_WIRE_13 & auto_control_xing_in_a_bits_mask[0])	// @[generators/rocket-chip/src/main/scala/tilelink/RegisterRouter.scala:82:24, src/main/scala/chisel3/util/OneHot.scala:58:35]
        sensor_net_config <= auto_control_xing_in_a_bits_data[0];	// @[generators/afe/src/main/scala/afe.scala:76:34, generators/rocket-chip/src/main/scala/tilelink/RegisterRouter.scala:82:24]
      if (_out_wofireMux_T_2 & auto_control_xing_in_a_bits_address[5:2] == 4'h8 & _out_out_bits_data_WIRE_13 & auto_control_xing_in_a_bits_mask[0])	// @[generators/rocket-chip/src/main/scala/tilelink/RegisterRouter.scala:82:24, src/main/scala/chisel3/util/OneHot.scala:58:35]
        feedback_config <= auto_control_xing_in_a_bits_data[4:0];	// @[generators/afe/src/main/scala/afe.scala:77:32, generators/rocket-chip/src/main/scala/tilelink/RegisterRouter.scala:82:24]
      if (_out_wofireMux_T_2 & auto_control_xing_in_a_bits_address[5:2] == 4'h9 & _out_out_bits_data_WIRE_13 & auto_control_xing_in_a_bits_mask[0])	// @[generators/rocket-chip/src/main/scala/tilelink/RegisterRouter.scala:82:24, src/main/scala/chisel3/util/OneHot.scala:58:35]
        adc_input_sel <= auto_control_xing_in_a_bits_data[1:0];	// @[generators/afe/src/main/scala/afe.scala:78:30, generators/rocket-chip/src/main/scala/tilelink/RegisterRouter.scala:82:24]
      if (_out_wofireMux_T_2 & auto_control_xing_in_a_bits_address[5:2] == 4'hA & _out_out_bits_data_WIRE_13 & auto_control_xing_in_a_bits_mask[0])	// @[generators/rocket-chip/src/main/scala/tilelink/RegisterRouter.scala:82:24, src/main/scala/chisel3/util/OneHot.scala:58:35]
        select_digital_power <= auto_control_xing_in_a_bits_data[0];	// @[generators/afe/src/main/scala/afe.scala:79:37, generators/rocket-chip/src/main/scala/tilelink/RegisterRouter.scala:82:24]
      if (_out_wofireMux_T_2 & auto_control_xing_in_a_bits_address[5:2] == 4'hB & _out_out_bits_data_WIRE_13 & auto_control_xing_in_a_bits_mask[0])	// @[generators/rocket-chip/src/main/scala/tilelink/RegisterRouter.scala:82:24, src/main/scala/chisel3/util/OneHot.scala:58:35]
        select_analog_power <= auto_control_xing_in_a_bits_data[0];	// @[generators/afe/src/main/scala/afe.scala:80:36, generators/rocket-chip/src/main/scala/tilelink/RegisterRouter.scala:82:24]
      if (_out_wofireMux_T_2 & auto_control_xing_in_a_bits_address[5:2] == 4'hC & _out_out_bits_data_WIRE_13 & auto_control_xing_in_a_bits_mask[0])	// @[generators/rocket-chip/src/main/scala/tilelink/RegisterRouter.scala:82:24, src/main/scala/chisel3/util/OneHot.scala:58:35]
        select_dac_vdd <= auto_control_xing_in_a_bits_data[0];	// @[generators/afe/src/main/scala/afe.scala:81:31, generators/rocket-chip/src/main/scala/tilelink/RegisterRouter.scala:82:24]
      if (_out_wofireMux_T_2 & auto_control_xing_in_a_bits_address[5:2] == 4'hD & _out_out_bits_data_WIRE_13 & auto_control_xing_in_a_bits_mask[0])	// @[generators/rocket-chip/src/main/scala/tilelink/RegisterRouter.scala:82:24, src/main/scala/chisel3/util/OneHot.scala:58:35]
        general_trim_afe_in <= auto_control_xing_in_a_bits_data[7:0];	// @[generators/afe/src/main/scala/afe.scala:82:36, generators/rocket-chip/src/main/scala/tilelink/RegisterRouter.scala:82:24]
      if (io_adc_output_valid)	// @[generators/afe/src/main/scala/afe.scala:69:14]
        adc_output_reg <= io_adc_output_bits;	// @[generators/afe/src/main/scala/afe.scala:104:31]
      if (io_general_trim_afe_out_valid)	// @[generators/afe/src/main/scala/afe.scala:69:14]
        general_trim_reg_out <= io_general_trim_afe_out_bits;	// @[generators/afe/src/main/scala/afe.scala:110:37]
    end
  end // always @(posedge)
  `ifdef ENABLE_INITIAL_REG_
    `ifdef FIRRTL_BEFORE_INITIAL
      `FIRRTL_BEFORE_INITIAL
    `endif // FIRRTL_BEFORE_INITIAL
    logic [31:0] _RANDOM[0:1];
    initial begin
      `ifdef INIT_RANDOM_PROLOG_
        `INIT_RANDOM_PROLOG_
      `endif // INIT_RANDOM_PROLOG_
      `ifdef RANDOMIZE_REG_INIT
        for (logic [1:0] i = 2'h0; i < 2'h2; i += 2'h1) begin
          _RANDOM[i[0]] = `RANDOM;
        end
        i_sel = _RANDOM[1'h0][7:0];	// @[generators/afe/src/main/scala/afe.scala:72:22]
        reset_afe_adc = _RANDOM[1'h0][8];	// @[generators/afe/src/main/scala/afe.scala:72:22, :73:30]
        r2r_dac_input = _RANDOM[1'h0][18:9];	// @[generators/afe/src/main/scala/afe.scala:72:22, :74:30]
        sensor_sel = _RANDOM[1'h0][21:19];	// @[generators/afe/src/main/scala/afe.scala:72:22, :75:27]
        sensor_net_config = _RANDOM[1'h0][22];	// @[generators/afe/src/main/scala/afe.scala:72:22, :76:34]
        feedback_config = _RANDOM[1'h0][27:23];	// @[generators/afe/src/main/scala/afe.scala:72:22, :77:32]
        adc_input_sel = _RANDOM[1'h0][29:28];	// @[generators/afe/src/main/scala/afe.scala:72:22, :78:30]
        select_digital_power = _RANDOM[1'h0][30];	// @[generators/afe/src/main/scala/afe.scala:72:22, :79:37]
        select_analog_power = _RANDOM[1'h0][31];	// @[generators/afe/src/main/scala/afe.scala:72:22, :80:36]
        select_dac_vdd = _RANDOM[1'h1][0];	// @[generators/afe/src/main/scala/afe.scala:81:31]
        general_trim_afe_in = _RANDOM[1'h1][8:1];	// @[generators/afe/src/main/scala/afe.scala:81:31, :82:36]
        adc_output_reg = _RANDOM[1'h1][18:9];	// @[generators/afe/src/main/scala/afe.scala:81:31, :104:31]
        general_trim_reg_out = _RANDOM[1'h1][26:19];	// @[generators/afe/src/main/scala/afe.scala:81:31, :110:37]
      `endif // RANDOMIZE_REG_INIT
    end // initial
    `ifdef FIRRTL_AFTER_INITIAL
      `FIRRTL_AFTER_INITIAL
    `endif // FIRRTL_AFTER_INITIAL
  `endif // ENABLE_INITIAL_REG_
  TLMonitor_69 monitor (	// @[generators/rocket-chip/src/main/scala/tilelink/Nodes.scala:24:25]
    .clock                (clock),
    .reset                (reset),
    .io_in_a_ready        (auto_control_xing_in_d_ready),
    .io_in_a_valid        (auto_control_xing_in_a_valid),
    .io_in_a_bits_opcode  (auto_control_xing_in_a_bits_opcode),
    .io_in_a_bits_param   (auto_control_xing_in_a_bits_param),
    .io_in_a_bits_size    (auto_control_xing_in_a_bits_size),
    .io_in_a_bits_source  (auto_control_xing_in_a_bits_source),
    .io_in_a_bits_address (auto_control_xing_in_a_bits_address),
    .io_in_a_bits_mask    (auto_control_xing_in_a_bits_mask),
    .io_in_a_bits_corrupt (auto_control_xing_in_a_bits_corrupt),
    .io_in_d_ready        (auto_control_xing_in_d_ready),
    .io_in_d_valid        (auto_control_xing_in_a_valid),
    .io_in_d_bits_opcode  (controlXingIn_d_bits_opcode),	// @[generators/rocket-chip/src/main/scala/tilelink/RegisterRouter.scala:100:19]
    .io_in_d_bits_size    (auto_control_xing_in_a_bits_size),
    .io_in_d_bits_source  (auto_control_xing_in_a_bits_source)
  );
  DividedClockImpl divided_clock_mod (	// @[generators/afe/src/main/scala/afe.scala:116:33]
    .clock                   (io_adc_clock),
    .reset                   (_reset_sync_io_out),	// @[generators/afe/src/main/scala/afe.scala:121:26]
    .io_divider_config_valid (_divider_config_queue_io_deq_valid),	// @[generators/afe/src/main/scala/afe.scala:129:36]
    .io_divider_config_bits  (_divider_config_queue_io_deq_bits),	// @[generators/afe/src/main/scala/afe.scala:129:36]
    .io_clock_gen            (io_adc_divided_clock)
  );
  Synchronizer reset_sync (	// @[generators/afe/src/main/scala/afe.scala:121:26]
    .reset         (reset),
    .io_in         (reset),
    .io_out        (_reset_sync_io_out),
    .io_dest_clock (io_adc_clock)
  );
  AsyncQueue_30 divider_config_queue (	// @[generators/afe/src/main/scala/afe.scala:129:36]
    .io_enq_clock (clock),
    .io_enq_reset (reset),
    .io_enq_valid (_out_wofireMux_T_2 & out_backSel_2 & _out_out_bits_data_WIRE_13 & (&{{8{auto_control_xing_in_a_bits_mask[3]}}, {8{auto_control_xing_in_a_bits_mask[2]}}, {8{auto_control_xing_in_a_bits_mask[1]}}, _out_backMask_T_5})),	// @[generators/rocket-chip/src/main/scala/tilelink/RegisterRouter.scala:82:24]
    .io_enq_bits  (auto_control_xing_in_a_bits_data[24:0]),	// @[generators/afe/src/main/scala/afe.scala:138:58]
    .io_deq_clock (io_adc_clock),
    .io_deq_reset (reset),
    .io_deq_valid (_divider_config_queue_io_deq_valid),
    .io_deq_bits  (_divider_config_queue_io_deq_bits)
  );
  assign auto_control_xing_in_a_ready = auto_control_xing_in_d_ready;
  assign auto_control_xing_in_d_valid = auto_control_xing_in_a_valid;
  assign auto_control_xing_in_d_bits_opcode = controlXingIn_d_bits_opcode;	// @[generators/rocket-chip/src/main/scala/tilelink/RegisterRouter.scala:100:19]
  assign auto_control_xing_in_d_bits_size = auto_control_xing_in_a_bits_size;
  assign auto_control_xing_in_d_bits_source = auto_control_xing_in_a_bits_source;
  assign auto_control_xing_in_d_bits_data = _GEN[auto_control_xing_in_a_bits_address[5:2]] ? _GEN_0[auto_control_xing_in_a_bits_address[5:2]] : 32'h0;	// @[generators/rocket-chip/src/main/scala/tilelink/Bundles.scala:259:74, generators/rocket-chip/src/main/scala/tilelink/RegisterRouter.scala:82:24, generators/rocket-chip/src/main/scala/util/MuxLiteral.scala:49:10]
  assign io_i_sel = i_sel[6:0];	// @[generators/afe/src/main/scala/afe.scala:72:22, :91:12]
  assign io_reset_afe_adc = reset_afe_adc;	// @[generators/afe/src/main/scala/afe.scala:73:30]
  assign io_r2r_dac_input = r2r_dac_input;	// @[generators/afe/src/main/scala/afe.scala:74:30]
  assign io_sensor_sel = sensor_sel;	// @[generators/afe/src/main/scala/afe.scala:75:27]
  assign io_sensor_net_config = sensor_net_config;	// @[generators/afe/src/main/scala/afe.scala:76:34]
  assign io_feedback_config = feedback_config;	// @[generators/afe/src/main/scala/afe.scala:77:32]
  assign io_adc_input_sel = adc_input_sel;	// @[generators/afe/src/main/scala/afe.scala:78:30]
  assign io_select_digital_power = select_digital_power;	// @[generators/afe/src/main/scala/afe.scala:79:37]
  assign io_select_analog_power = select_analog_power;	// @[generators/afe/src/main/scala/afe.scala:80:36]
  assign io_select_dac_vdd = select_dac_vdd;	// @[generators/afe/src/main/scala/afe.scala:81:31]
  assign io_general_trim_afe_in = general_trim_afe_in;	// @[generators/afe/src/main/scala/afe.scala:82:36]
endmodule

