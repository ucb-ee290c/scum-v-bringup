// Generated by CIRCT unknown git version
// Standard header to adapt well known macros for register randomization.
`ifndef RANDOMIZE
  `ifdef RANDOMIZE_MEM_INIT
    `define RANDOMIZE
  `endif // RANDOMIZE_MEM_INIT
`endif // not def RANDOMIZE
`ifndef RANDOMIZE
  `ifdef RANDOMIZE_REG_INIT
    `define RANDOMIZE
  `endif // RANDOMIZE_REG_INIT
`endif // not def RANDOMIZE

// RANDOM may be set to an expression that produces a 32-bit random unsigned value.
`ifndef RANDOM
  `define RANDOM $random
`endif // not def RANDOM

// Users can define INIT_RANDOM as general code that gets injected into the
// initializer block for modules with registers.
`ifndef INIT_RANDOM
  `define INIT_RANDOM
`endif // not def INIT_RANDOM

// If using random initialization, you can also define RANDOMIZE_DELAY to
// customize the delay used, otherwise 0.002 is used.
`ifndef RANDOMIZE_DELAY
  `define RANDOMIZE_DELAY 0.002
`endif // not def RANDOMIZE_DELAY

// Define INIT_RANDOM_PROLOG_ for use in our modules below.
`ifndef INIT_RANDOM_PROLOG_
  `ifdef RANDOMIZE
    `ifdef VERILATOR
      `define INIT_RANDOM_PROLOG_ `INIT_RANDOM
    `else  // VERILATOR
      `define INIT_RANDOM_PROLOG_ `INIT_RANDOM #`RANDOMIZE_DELAY begin end
    `endif // VERILATOR
  `else  // RANDOMIZE
    `define INIT_RANDOM_PROLOG_
  `endif // RANDOMIZE
`endif // not def INIT_RANDOM_PROLOG_

// Include register initializers in init blocks unless synthesis is set
`ifndef SYNTHESIS
  `ifndef ENABLE_INITIAL_REG_
    `define ENABLE_INITIAL_REG_
  `endif // not def ENABLE_INITIAL_REG_
`endif // not def SYNTHESIS

// Include rmemory initializers in init blocks unless synthesis is set
`ifndef SYNTHESIS
  `ifndef ENABLE_INITIAL_MEM_
    `define ENABLE_INITIAL_MEM_
  `endif // not def ENABLE_INITIAL_MEM_
`endif // not def SYNTHESIS

// Standard header to adapt well known macros for prints and assertions.

// Users can define 'PRINTF_COND' to add an extra gate to prints.
`ifndef PRINTF_COND_
  `ifdef PRINTF_COND
    `define PRINTF_COND_ (`PRINTF_COND)
  `else  // PRINTF_COND
    `define PRINTF_COND_ 1
  `endif // PRINTF_COND
`endif // not def PRINTF_COND_

// Users can define 'ASSERT_VERBOSE_COND' to add an extra gate to assert error printing.
`ifndef ASSERT_VERBOSE_COND_
  `ifdef ASSERT_VERBOSE_COND
    `define ASSERT_VERBOSE_COND_ (`ASSERT_VERBOSE_COND)
  `else  // ASSERT_VERBOSE_COND
    `define ASSERT_VERBOSE_COND_ 1
  `endif // ASSERT_VERBOSE_COND
`endif // not def ASSERT_VERBOSE_COND_

// Users can define 'STOP_COND' to add an extra gate to stop conditions.
`ifndef STOP_COND_
  `ifdef STOP_COND
    `define STOP_COND_ (`STOP_COND)
  `else  // STOP_COND
    `define STOP_COND_ 1
  `endif // STOP_COND
`endif // not def STOP_COND_

module TLXbar(
  input         clock,
                reset,
  output        auto_in_1_a_ready,	// @[generators/rocket-chip/src/main/scala/diplomacy/LazyModule.scala:366:18]
  input         auto_in_1_a_valid,	// @[generators/rocket-chip/src/main/scala/diplomacy/LazyModule.scala:366:18]
  input  [2:0]  auto_in_1_a_bits_opcode,	// @[generators/rocket-chip/src/main/scala/diplomacy/LazyModule.scala:366:18]
                auto_in_1_a_bits_param,	// @[generators/rocket-chip/src/main/scala/diplomacy/LazyModule.scala:366:18]
                auto_in_1_a_bits_size,	// @[generators/rocket-chip/src/main/scala/diplomacy/LazyModule.scala:366:18]
  input  [1:0]  auto_in_1_a_bits_source,	// @[generators/rocket-chip/src/main/scala/diplomacy/LazyModule.scala:366:18]
  input  [31:0] auto_in_1_a_bits_address,	// @[generators/rocket-chip/src/main/scala/diplomacy/LazyModule.scala:366:18]
  input  [3:0]  auto_in_1_a_bits_mask,	// @[generators/rocket-chip/src/main/scala/diplomacy/LazyModule.scala:366:18]
  input  [31:0] auto_in_1_a_bits_data,	// @[generators/rocket-chip/src/main/scala/diplomacy/LazyModule.scala:366:18]
  input         auto_in_1_a_bits_corrupt,	// @[generators/rocket-chip/src/main/scala/diplomacy/LazyModule.scala:366:18]
                auto_in_1_b_ready,	// @[generators/rocket-chip/src/main/scala/diplomacy/LazyModule.scala:366:18]
  output        auto_in_1_b_valid,	// @[generators/rocket-chip/src/main/scala/diplomacy/LazyModule.scala:366:18]
  output [1:0]  auto_in_1_b_bits_param,	// @[generators/rocket-chip/src/main/scala/diplomacy/LazyModule.scala:366:18]
  output [31:0] auto_in_1_b_bits_address,	// @[generators/rocket-chip/src/main/scala/diplomacy/LazyModule.scala:366:18]
  output        auto_in_1_c_ready,	// @[generators/rocket-chip/src/main/scala/diplomacy/LazyModule.scala:366:18]
  input         auto_in_1_c_valid,	// @[generators/rocket-chip/src/main/scala/diplomacy/LazyModule.scala:366:18]
  input  [2:0]  auto_in_1_c_bits_opcode,	// @[generators/rocket-chip/src/main/scala/diplomacy/LazyModule.scala:366:18]
                auto_in_1_c_bits_param,	// @[generators/rocket-chip/src/main/scala/diplomacy/LazyModule.scala:366:18]
                auto_in_1_c_bits_size,	// @[generators/rocket-chip/src/main/scala/diplomacy/LazyModule.scala:366:18]
  input  [1:0]  auto_in_1_c_bits_source,	// @[generators/rocket-chip/src/main/scala/diplomacy/LazyModule.scala:366:18]
  input  [31:0] auto_in_1_c_bits_address,	// @[generators/rocket-chip/src/main/scala/diplomacy/LazyModule.scala:366:18]
                auto_in_1_c_bits_data,	// @[generators/rocket-chip/src/main/scala/diplomacy/LazyModule.scala:366:18]
  input         auto_in_1_c_bits_corrupt,	// @[generators/rocket-chip/src/main/scala/diplomacy/LazyModule.scala:366:18]
                auto_in_1_d_ready,	// @[generators/rocket-chip/src/main/scala/diplomacy/LazyModule.scala:366:18]
  output        auto_in_1_d_valid,	// @[generators/rocket-chip/src/main/scala/diplomacy/LazyModule.scala:366:18]
  output [2:0]  auto_in_1_d_bits_opcode,	// @[generators/rocket-chip/src/main/scala/diplomacy/LazyModule.scala:366:18]
  output [1:0]  auto_in_1_d_bits_param,	// @[generators/rocket-chip/src/main/scala/diplomacy/LazyModule.scala:366:18]
  output [2:0]  auto_in_1_d_bits_size,	// @[generators/rocket-chip/src/main/scala/diplomacy/LazyModule.scala:366:18]
  output [1:0]  auto_in_1_d_bits_source,	// @[generators/rocket-chip/src/main/scala/diplomacy/LazyModule.scala:366:18]
                auto_in_1_d_bits_sink,	// @[generators/rocket-chip/src/main/scala/diplomacy/LazyModule.scala:366:18]
  output        auto_in_1_d_bits_denied,	// @[generators/rocket-chip/src/main/scala/diplomacy/LazyModule.scala:366:18]
  output [31:0] auto_in_1_d_bits_data,	// @[generators/rocket-chip/src/main/scala/diplomacy/LazyModule.scala:366:18]
  output        auto_in_1_d_bits_corrupt,	// @[generators/rocket-chip/src/main/scala/diplomacy/LazyModule.scala:366:18]
  input         auto_in_1_e_valid,	// @[generators/rocket-chip/src/main/scala/diplomacy/LazyModule.scala:366:18]
  input  [1:0]  auto_in_1_e_bits_sink,	// @[generators/rocket-chip/src/main/scala/diplomacy/LazyModule.scala:366:18]
  output        auto_in_0_a_ready,	// @[generators/rocket-chip/src/main/scala/diplomacy/LazyModule.scala:366:18]
  input         auto_in_0_a_valid,	// @[generators/rocket-chip/src/main/scala/diplomacy/LazyModule.scala:366:18]
  input  [2:0]  auto_in_0_a_bits_opcode,	// @[generators/rocket-chip/src/main/scala/diplomacy/LazyModule.scala:366:18]
                auto_in_0_a_bits_param,	// @[generators/rocket-chip/src/main/scala/diplomacy/LazyModule.scala:366:18]
                auto_in_0_a_bits_size,	// @[generators/rocket-chip/src/main/scala/diplomacy/LazyModule.scala:366:18]
  input  [8:0]  auto_in_0_a_bits_source,	// @[generators/rocket-chip/src/main/scala/diplomacy/LazyModule.scala:366:18]
  input  [31:0] auto_in_0_a_bits_address,	// @[generators/rocket-chip/src/main/scala/diplomacy/LazyModule.scala:366:18]
  input  [3:0]  auto_in_0_a_bits_mask,	// @[generators/rocket-chip/src/main/scala/diplomacy/LazyModule.scala:366:18]
  input  [31:0] auto_in_0_a_bits_data,	// @[generators/rocket-chip/src/main/scala/diplomacy/LazyModule.scala:366:18]
  input         auto_in_0_a_bits_corrupt,	// @[generators/rocket-chip/src/main/scala/diplomacy/LazyModule.scala:366:18]
                auto_in_0_d_ready,	// @[generators/rocket-chip/src/main/scala/diplomacy/LazyModule.scala:366:18]
  output        auto_in_0_d_valid,	// @[generators/rocket-chip/src/main/scala/diplomacy/LazyModule.scala:366:18]
  output [2:0]  auto_in_0_d_bits_opcode,	// @[generators/rocket-chip/src/main/scala/diplomacy/LazyModule.scala:366:18]
  output [1:0]  auto_in_0_d_bits_param,	// @[generators/rocket-chip/src/main/scala/diplomacy/LazyModule.scala:366:18]
  output [2:0]  auto_in_0_d_bits_size,	// @[generators/rocket-chip/src/main/scala/diplomacy/LazyModule.scala:366:18]
  output [8:0]  auto_in_0_d_bits_source,	// @[generators/rocket-chip/src/main/scala/diplomacy/LazyModule.scala:366:18]
  output [1:0]  auto_in_0_d_bits_sink,	// @[generators/rocket-chip/src/main/scala/diplomacy/LazyModule.scala:366:18]
  output        auto_in_0_d_bits_denied,	// @[generators/rocket-chip/src/main/scala/diplomacy/LazyModule.scala:366:18]
  output [31:0] auto_in_0_d_bits_data,	// @[generators/rocket-chip/src/main/scala/diplomacy/LazyModule.scala:366:18]
  output        auto_in_0_d_bits_corrupt,	// @[generators/rocket-chip/src/main/scala/diplomacy/LazyModule.scala:366:18]
  input         auto_out_1_a_ready,	// @[generators/rocket-chip/src/main/scala/diplomacy/LazyModule.scala:366:18]
  output        auto_out_1_a_valid,	// @[generators/rocket-chip/src/main/scala/diplomacy/LazyModule.scala:366:18]
  output [2:0]  auto_out_1_a_bits_opcode,	// @[generators/rocket-chip/src/main/scala/diplomacy/LazyModule.scala:366:18]
                auto_out_1_a_bits_param,	// @[generators/rocket-chip/src/main/scala/diplomacy/LazyModule.scala:366:18]
                auto_out_1_a_bits_size,	// @[generators/rocket-chip/src/main/scala/diplomacy/LazyModule.scala:366:18]
  output [9:0]  auto_out_1_a_bits_source,	// @[generators/rocket-chip/src/main/scala/diplomacy/LazyModule.scala:366:18]
  output [31:0] auto_out_1_a_bits_address,	// @[generators/rocket-chip/src/main/scala/diplomacy/LazyModule.scala:366:18]
  output [3:0]  auto_out_1_a_bits_mask,	// @[generators/rocket-chip/src/main/scala/diplomacy/LazyModule.scala:366:18]
  output [31:0] auto_out_1_a_bits_data,	// @[generators/rocket-chip/src/main/scala/diplomacy/LazyModule.scala:366:18]
  output        auto_out_1_a_bits_corrupt,	// @[generators/rocket-chip/src/main/scala/diplomacy/LazyModule.scala:366:18]
                auto_out_1_b_ready,	// @[generators/rocket-chip/src/main/scala/diplomacy/LazyModule.scala:366:18]
  input         auto_out_1_b_valid,	// @[generators/rocket-chip/src/main/scala/diplomacy/LazyModule.scala:366:18]
  input  [1:0]  auto_out_1_b_bits_param,	// @[generators/rocket-chip/src/main/scala/diplomacy/LazyModule.scala:366:18]
  input  [31:0] auto_out_1_b_bits_address,	// @[generators/rocket-chip/src/main/scala/diplomacy/LazyModule.scala:366:18]
  input         auto_out_1_c_ready,	// @[generators/rocket-chip/src/main/scala/diplomacy/LazyModule.scala:366:18]
  output        auto_out_1_c_valid,	// @[generators/rocket-chip/src/main/scala/diplomacy/LazyModule.scala:366:18]
  output [2:0]  auto_out_1_c_bits_opcode,	// @[generators/rocket-chip/src/main/scala/diplomacy/LazyModule.scala:366:18]
                auto_out_1_c_bits_param,	// @[generators/rocket-chip/src/main/scala/diplomacy/LazyModule.scala:366:18]
                auto_out_1_c_bits_size,	// @[generators/rocket-chip/src/main/scala/diplomacy/LazyModule.scala:366:18]
  output [9:0]  auto_out_1_c_bits_source,	// @[generators/rocket-chip/src/main/scala/diplomacy/LazyModule.scala:366:18]
  output [31:0] auto_out_1_c_bits_address,	// @[generators/rocket-chip/src/main/scala/diplomacy/LazyModule.scala:366:18]
                auto_out_1_c_bits_data,	// @[generators/rocket-chip/src/main/scala/diplomacy/LazyModule.scala:366:18]
  output        auto_out_1_c_bits_corrupt,	// @[generators/rocket-chip/src/main/scala/diplomacy/LazyModule.scala:366:18]
                auto_out_1_d_ready,	// @[generators/rocket-chip/src/main/scala/diplomacy/LazyModule.scala:366:18]
  input         auto_out_1_d_valid,	// @[generators/rocket-chip/src/main/scala/diplomacy/LazyModule.scala:366:18]
  input  [2:0]  auto_out_1_d_bits_opcode,	// @[generators/rocket-chip/src/main/scala/diplomacy/LazyModule.scala:366:18]
  input  [1:0]  auto_out_1_d_bits_param,	// @[generators/rocket-chip/src/main/scala/diplomacy/LazyModule.scala:366:18]
  input  [2:0]  auto_out_1_d_bits_size,	// @[generators/rocket-chip/src/main/scala/diplomacy/LazyModule.scala:366:18]
  input  [9:0]  auto_out_1_d_bits_source,	// @[generators/rocket-chip/src/main/scala/diplomacy/LazyModule.scala:366:18]
  input  [1:0]  auto_out_1_d_bits_sink,	// @[generators/rocket-chip/src/main/scala/diplomacy/LazyModule.scala:366:18]
  input  [31:0] auto_out_1_d_bits_data,	// @[generators/rocket-chip/src/main/scala/diplomacy/LazyModule.scala:366:18]
  output        auto_out_1_e_valid,	// @[generators/rocket-chip/src/main/scala/diplomacy/LazyModule.scala:366:18]
  output [1:0]  auto_out_1_e_bits_sink,	// @[generators/rocket-chip/src/main/scala/diplomacy/LazyModule.scala:366:18]
  input         auto_out_0_a_ready,	// @[generators/rocket-chip/src/main/scala/diplomacy/LazyModule.scala:366:18]
  output        auto_out_0_a_valid,	// @[generators/rocket-chip/src/main/scala/diplomacy/LazyModule.scala:366:18]
  output [2:0]  auto_out_0_a_bits_opcode,	// @[generators/rocket-chip/src/main/scala/diplomacy/LazyModule.scala:366:18]
                auto_out_0_a_bits_param,	// @[generators/rocket-chip/src/main/scala/diplomacy/LazyModule.scala:366:18]
                auto_out_0_a_bits_size,	// @[generators/rocket-chip/src/main/scala/diplomacy/LazyModule.scala:366:18]
  output [9:0]  auto_out_0_a_bits_source,	// @[generators/rocket-chip/src/main/scala/diplomacy/LazyModule.scala:366:18]
  output [29:0] auto_out_0_a_bits_address,	// @[generators/rocket-chip/src/main/scala/diplomacy/LazyModule.scala:366:18]
  output [3:0]  auto_out_0_a_bits_mask,	// @[generators/rocket-chip/src/main/scala/diplomacy/LazyModule.scala:366:18]
  output [31:0] auto_out_0_a_bits_data,	// @[generators/rocket-chip/src/main/scala/diplomacy/LazyModule.scala:366:18]
  output        auto_out_0_a_bits_corrupt,	// @[generators/rocket-chip/src/main/scala/diplomacy/LazyModule.scala:366:18]
                auto_out_0_d_ready,	// @[generators/rocket-chip/src/main/scala/diplomacy/LazyModule.scala:366:18]
  input         auto_out_0_d_valid,	// @[generators/rocket-chip/src/main/scala/diplomacy/LazyModule.scala:366:18]
  input  [2:0]  auto_out_0_d_bits_opcode,	// @[generators/rocket-chip/src/main/scala/diplomacy/LazyModule.scala:366:18]
  input  [1:0]  auto_out_0_d_bits_param,	// @[generators/rocket-chip/src/main/scala/diplomacy/LazyModule.scala:366:18]
  input  [2:0]  auto_out_0_d_bits_size,	// @[generators/rocket-chip/src/main/scala/diplomacy/LazyModule.scala:366:18]
  input  [9:0]  auto_out_0_d_bits_source,	// @[generators/rocket-chip/src/main/scala/diplomacy/LazyModule.scala:366:18]
  input         auto_out_0_d_bits_sink,	// @[generators/rocket-chip/src/main/scala/diplomacy/LazyModule.scala:366:18]
                auto_out_0_d_bits_denied,	// @[generators/rocket-chip/src/main/scala/diplomacy/LazyModule.scala:366:18]
  input  [31:0] auto_out_0_d_bits_data,	// @[generators/rocket-chip/src/main/scala/diplomacy/LazyModule.scala:366:18]
  input         auto_out_0_d_bits_corrupt	// @[generators/rocket-chip/src/main/scala/diplomacy/LazyModule.scala:366:18]
);

  wire        allowed_3_1;	// @[generators/rocket-chip/src/main/scala/tilelink/Arbiter.scala:92:24]
  wire        allowed_3_0;	// @[generators/rocket-chip/src/main/scala/tilelink/Arbiter.scala:92:24]
  wire        allowed_2_1;	// @[generators/rocket-chip/src/main/scala/tilelink/Arbiter.scala:92:24]
  wire        allowed_2_0;	// @[generators/rocket-chip/src/main/scala/tilelink/Arbiter.scala:92:24]
  wire        allowed_1_1;	// @[generators/rocket-chip/src/main/scala/tilelink/Arbiter.scala:92:24]
  wire        allowed_1_0;	// @[generators/rocket-chip/src/main/scala/tilelink/Arbiter.scala:92:24]
  wire        allowed_1;	// @[generators/rocket-chip/src/main/scala/tilelink/Arbiter.scala:92:24]
  wire        allowed_0;	// @[generators/rocket-chip/src/main/scala/tilelink/Arbiter.scala:92:24]
  wire [9:0]  portsAOI_filtered_1_bits_source = {1'h0, auto_in_0_a_bits_source};	// @[generators/rocket-chip/src/main/scala/tilelink/Xbar.scala:162:29]
  wire [9:0]  portsAOI_filtered_1_1_bits_source = {8'h80, auto_in_1_a_bits_source};	// @[generators/rocket-chip/src/main/scala/diplomacy/Parameters.scala:54:32, generators/rocket-chip/src/main/scala/tilelink/Xbar.scala:162:55]
  wire [1:0]  portsDIO_filtered_1_bits_sink = {1'h0, auto_out_0_d_bits_sink};	// @[generators/rocket-chip/src/main/scala/tilelink/Xbar.scala:247:28]
  wire        requestDOI_0_1 = auto_out_0_d_bits_source[9:2] == 8'h80;	// @[generators/rocket-chip/src/main/scala/diplomacy/Parameters.scala:54:{10,32}]
  wire        requestDOI_1_1 = auto_out_1_d_bits_source[9:2] == 8'h80;	// @[generators/rocket-chip/src/main/scala/diplomacy/Parameters.scala:54:{10,32}]
  wire        portsAOI_filtered_0_valid = auto_in_0_a_valid & ~(auto_in_0_a_bits_address[31]);	// @[generators/rocket-chip/src/main/scala/diplomacy/Parameters.scala:137:{41,46,59}, generators/rocket-chip/src/main/scala/tilelink/Xbar.scala:351:40]
  wire        portsAOI_filtered_1_valid = auto_in_0_a_valid & auto_in_0_a_bits_address[31];	// @[generators/rocket-chip/src/main/scala/diplomacy/Parameters.scala:137:{41,46}, generators/rocket-chip/src/main/scala/tilelink/Xbar.scala:351:40]
  wire        _portsAOI_in_0_a_ready_WIRE = ~(auto_in_0_a_bits_address[31]) & auto_out_0_a_ready & allowed_0 | auto_in_0_a_bits_address[31] & auto_out_1_a_ready & allowed_1_0;	// @[generators/rocket-chip/src/main/scala/diplomacy/Parameters.scala:137:{41,46,59}, generators/rocket-chip/src/main/scala/tilelink/Arbiter.scala:92:24, src/main/scala/chisel3/util/Mux.scala:30:73]
  wire        portsAOI_filtered_1_0_valid = auto_in_1_a_valid & ~(auto_in_1_a_bits_address[31]);	// @[generators/rocket-chip/src/main/scala/diplomacy/Parameters.scala:137:{41,46,59}, generators/rocket-chip/src/main/scala/tilelink/Xbar.scala:351:40]
  wire        portsAOI_filtered_1_1_valid = auto_in_1_a_valid & auto_in_1_a_bits_address[31];	// @[generators/rocket-chip/src/main/scala/diplomacy/Parameters.scala:137:{41,46}, generators/rocket-chip/src/main/scala/tilelink/Xbar.scala:351:40]
  wire        _portsAOI_in_1_a_ready_WIRE = ~(auto_in_1_a_bits_address[31]) & auto_out_0_a_ready & allowed_1 | auto_in_1_a_bits_address[31] & auto_out_1_a_ready & allowed_1_1;	// @[generators/rocket-chip/src/main/scala/diplomacy/Parameters.scala:137:{41,46,59}, generators/rocket-chip/src/main/scala/tilelink/Arbiter.scala:92:24, src/main/scala/chisel3/util/Mux.scala:30:73]
  wire        portsDIO_filtered_0_valid = auto_out_0_d_valid & ~(auto_out_0_d_bits_source[9]);	// @[generators/rocket-chip/src/main/scala/diplomacy/Parameters.scala:54:{10,32}, generators/rocket-chip/src/main/scala/tilelink/Xbar.scala:351:40]
  wire        portsDIO_filtered_1_valid = auto_out_0_d_valid & requestDOI_0_1;	// @[generators/rocket-chip/src/main/scala/diplomacy/Parameters.scala:54:32, generators/rocket-chip/src/main/scala/tilelink/Xbar.scala:351:40]
  wire        portsDIO_filtered_1_0_valid = auto_out_1_d_valid & ~(auto_out_1_d_bits_source[9]);	// @[generators/rocket-chip/src/main/scala/diplomacy/Parameters.scala:54:{10,32}, generators/rocket-chip/src/main/scala/tilelink/Xbar.scala:351:40]
  wire        portsDIO_filtered_1_1_valid = auto_out_1_d_valid & requestDOI_1_1;	// @[generators/rocket-chip/src/main/scala/diplomacy/Parameters.scala:54:32, generators/rocket-chip/src/main/scala/tilelink/Xbar.scala:351:40]
  reg  [3:0]  beatsLeft;	// @[generators/rocket-chip/src/main/scala/tilelink/Arbiter.scala:60:30]
  wire        idle = beatsLeft == 4'h0;	// @[generators/rocket-chip/src/main/scala/tilelink/Arbiter.scala:60:30, :61:28, generators/rocket-chip/src/main/scala/tilelink/Bundles.scala:259:74]
  wire [1:0]  readys_valid = {portsAOI_filtered_1_0_valid, portsAOI_filtered_0_valid};	// @[generators/rocket-chip/src/main/scala/tilelink/Arbiter.scala:68:51, generators/rocket-chip/src/main/scala/tilelink/Xbar.scala:351:40]
  reg  [1:0]  readys_mask;	// @[generators/rocket-chip/src/main/scala/tilelink/Arbiter.scala:23:23]
  wire [1:0]  _readys_filter_T_1 = readys_valid & ~readys_mask;	// @[generators/rocket-chip/src/main/scala/tilelink/Arbiter.scala:23:23, :24:{28,30}, :68:51]
  wire [1:0]  readys_readys = ~({readys_mask[1], _readys_filter_T_1[1] | readys_mask[0]} & ({_readys_filter_T_1[0], portsAOI_filtered_1_0_valid} | _readys_filter_T_1));	// @[generators/rocket-chip/src/main/scala/tilelink/Arbiter.scala:23:23, :24:28, :25:58, :26:{18,29,39}, generators/rocket-chip/src/main/scala/tilelink/Xbar.scala:351:40, generators/rocket-chip/src/main/scala/util/package.scala:254:43]
  wire        winner_0 = readys_readys[0] & portsAOI_filtered_0_valid;	// @[generators/rocket-chip/src/main/scala/tilelink/Arbiter.scala:26:18, :68:76, :71:69, generators/rocket-chip/src/main/scala/tilelink/Xbar.scala:351:40]
  wire        winner_1 = readys_readys[1] & portsAOI_filtered_1_0_valid;	// @[generators/rocket-chip/src/main/scala/tilelink/Arbiter.scala:26:18, :68:76, :71:69, generators/rocket-chip/src/main/scala/tilelink/Xbar.scala:351:40]
  wire        _out_0_a_valid_T = portsAOI_filtered_0_valid | portsAOI_filtered_1_0_valid;	// @[generators/rocket-chip/src/main/scala/tilelink/Arbiter.scala:79:31, generators/rocket-chip/src/main/scala/tilelink/Xbar.scala:351:40]
  reg         state_0;	// @[generators/rocket-chip/src/main/scala/tilelink/Arbiter.scala:88:26]
  reg         state_1;	// @[generators/rocket-chip/src/main/scala/tilelink/Arbiter.scala:88:26]
  wire        muxState_0 = idle ? winner_0 : state_0;	// @[generators/rocket-chip/src/main/scala/tilelink/Arbiter.scala:61:28, :71:69, :88:26, :89:25]
  wire        muxState_1 = idle ? winner_1 : state_1;	// @[generators/rocket-chip/src/main/scala/tilelink/Arbiter.scala:61:28, :71:69, :88:26, :89:25]
  assign allowed_0 = idle ? readys_readys[0] : state_0;	// @[generators/rocket-chip/src/main/scala/tilelink/Arbiter.scala:26:18, :61:28, :68:76, :88:26, :92:24]
  assign allowed_1 = idle ? readys_readys[1] : state_1;	// @[generators/rocket-chip/src/main/scala/tilelink/Arbiter.scala:26:18, :61:28, :68:76, :88:26, :92:24]
  wire        out_0_a_valid = idle ? _out_0_a_valid_T : state_0 & portsAOI_filtered_0_valid | state_1 & portsAOI_filtered_1_0_valid;	// @[generators/rocket-chip/src/main/scala/tilelink/Arbiter.scala:61:28, :79:31, :88:26, :96:24, generators/rocket-chip/src/main/scala/tilelink/Xbar.scala:351:40, src/main/scala/chisel3/util/Mux.scala:30:73]
  reg  [3:0]  beatsLeft_1;	// @[generators/rocket-chip/src/main/scala/tilelink/Arbiter.scala:60:30]
  wire        idle_1 = beatsLeft_1 == 4'h0;	// @[generators/rocket-chip/src/main/scala/tilelink/Arbiter.scala:60:30, :61:28, generators/rocket-chip/src/main/scala/tilelink/Bundles.scala:259:74]
  wire [1:0]  readys_valid_1 = {portsAOI_filtered_1_1_valid, portsAOI_filtered_1_valid};	// @[generators/rocket-chip/src/main/scala/tilelink/Arbiter.scala:68:51, generators/rocket-chip/src/main/scala/tilelink/Xbar.scala:351:40]
  reg  [1:0]  readys_mask_1;	// @[generators/rocket-chip/src/main/scala/tilelink/Arbiter.scala:23:23]
  wire [1:0]  _readys_filter_T_3 = readys_valid_1 & ~readys_mask_1;	// @[generators/rocket-chip/src/main/scala/tilelink/Arbiter.scala:23:23, :24:{28,30}, :68:51]
  wire [1:0]  readys_readys_1 = ~({readys_mask_1[1], _readys_filter_T_3[1] | readys_mask_1[0]} & ({_readys_filter_T_3[0], portsAOI_filtered_1_1_valid} | _readys_filter_T_3));	// @[generators/rocket-chip/src/main/scala/tilelink/Arbiter.scala:23:23, :24:28, :25:58, :26:{18,29,39}, generators/rocket-chip/src/main/scala/tilelink/Xbar.scala:351:40, generators/rocket-chip/src/main/scala/util/package.scala:254:43]
  wire        winner_1_0 = readys_readys_1[0] & portsAOI_filtered_1_valid;	// @[generators/rocket-chip/src/main/scala/tilelink/Arbiter.scala:26:18, :68:76, :71:69, generators/rocket-chip/src/main/scala/tilelink/Xbar.scala:351:40]
  wire        winner_1_1 = readys_readys_1[1] & portsAOI_filtered_1_1_valid;	// @[generators/rocket-chip/src/main/scala/tilelink/Arbiter.scala:26:18, :68:76, :71:69, generators/rocket-chip/src/main/scala/tilelink/Xbar.scala:351:40]
  wire        _out_1_a_valid_T = portsAOI_filtered_1_valid | portsAOI_filtered_1_1_valid;	// @[generators/rocket-chip/src/main/scala/tilelink/Arbiter.scala:79:31, generators/rocket-chip/src/main/scala/tilelink/Xbar.scala:351:40]
  reg         state_1_0;	// @[generators/rocket-chip/src/main/scala/tilelink/Arbiter.scala:88:26]
  reg         state_1_1;	// @[generators/rocket-chip/src/main/scala/tilelink/Arbiter.scala:88:26]
  wire        muxState_1_0 = idle_1 ? winner_1_0 : state_1_0;	// @[generators/rocket-chip/src/main/scala/tilelink/Arbiter.scala:61:28, :71:69, :88:26, :89:25]
  wire        muxState_1_1 = idle_1 ? winner_1_1 : state_1_1;	// @[generators/rocket-chip/src/main/scala/tilelink/Arbiter.scala:61:28, :71:69, :88:26, :89:25]
  assign allowed_1_0 = idle_1 ? readys_readys_1[0] : state_1_0;	// @[generators/rocket-chip/src/main/scala/tilelink/Arbiter.scala:26:18, :61:28, :68:76, :88:26, :92:24]
  assign allowed_1_1 = idle_1 ? readys_readys_1[1] : state_1_1;	// @[generators/rocket-chip/src/main/scala/tilelink/Arbiter.scala:26:18, :61:28, :68:76, :88:26, :92:24]
  wire        out_1_a_valid = idle_1 ? _out_1_a_valid_T : state_1_0 & portsAOI_filtered_1_valid | state_1_1 & portsAOI_filtered_1_1_valid;	// @[generators/rocket-chip/src/main/scala/tilelink/Arbiter.scala:61:28, :79:31, :88:26, :96:24, generators/rocket-chip/src/main/scala/tilelink/Xbar.scala:351:40, src/main/scala/chisel3/util/Mux.scala:30:73]
  reg  [3:0]  beatsLeft_2;	// @[generators/rocket-chip/src/main/scala/tilelink/Arbiter.scala:60:30]
  wire        idle_2 = beatsLeft_2 == 4'h0;	// @[generators/rocket-chip/src/main/scala/tilelink/Arbiter.scala:60:30, :61:28, generators/rocket-chip/src/main/scala/tilelink/Bundles.scala:259:74]
  wire [1:0]  readys_valid_2 = {portsDIO_filtered_1_0_valid, portsDIO_filtered_0_valid};	// @[generators/rocket-chip/src/main/scala/tilelink/Arbiter.scala:68:51, generators/rocket-chip/src/main/scala/tilelink/Xbar.scala:351:40]
  reg  [1:0]  readys_mask_2;	// @[generators/rocket-chip/src/main/scala/tilelink/Arbiter.scala:23:23]
  wire [1:0]  _readys_filter_T_5 = readys_valid_2 & ~readys_mask_2;	// @[generators/rocket-chip/src/main/scala/tilelink/Arbiter.scala:23:23, :24:{28,30}, :68:51]
  wire [1:0]  readys_readys_2 = ~({readys_mask_2[1], _readys_filter_T_5[1] | readys_mask_2[0]} & ({_readys_filter_T_5[0], portsDIO_filtered_1_0_valid} | _readys_filter_T_5));	// @[generators/rocket-chip/src/main/scala/tilelink/Arbiter.scala:23:23, :24:28, :25:58, :26:{18,29,39}, generators/rocket-chip/src/main/scala/tilelink/Xbar.scala:351:40, generators/rocket-chip/src/main/scala/util/package.scala:254:43]
  wire        winner_2_0 = readys_readys_2[0] & portsDIO_filtered_0_valid;	// @[generators/rocket-chip/src/main/scala/tilelink/Arbiter.scala:26:18, :68:76, :71:69, generators/rocket-chip/src/main/scala/tilelink/Xbar.scala:351:40]
  wire        winner_2_1 = readys_readys_2[1] & portsDIO_filtered_1_0_valid;	// @[generators/rocket-chip/src/main/scala/tilelink/Arbiter.scala:26:18, :68:76, :71:69, generators/rocket-chip/src/main/scala/tilelink/Xbar.scala:351:40]
  wire        _in_0_d_valid_T = portsDIO_filtered_0_valid | portsDIO_filtered_1_0_valid;	// @[generators/rocket-chip/src/main/scala/tilelink/Arbiter.scala:79:31, generators/rocket-chip/src/main/scala/tilelink/Xbar.scala:351:40]
  reg         state_2_0;	// @[generators/rocket-chip/src/main/scala/tilelink/Arbiter.scala:88:26]
  reg         state_2_1;	// @[generators/rocket-chip/src/main/scala/tilelink/Arbiter.scala:88:26]
  wire        muxState_2_0 = idle_2 ? winner_2_0 : state_2_0;	// @[generators/rocket-chip/src/main/scala/tilelink/Arbiter.scala:61:28, :71:69, :88:26, :89:25]
  wire        muxState_2_1 = idle_2 ? winner_2_1 : state_2_1;	// @[generators/rocket-chip/src/main/scala/tilelink/Arbiter.scala:61:28, :71:69, :88:26, :89:25]
  assign allowed_2_0 = idle_2 ? readys_readys_2[0] : state_2_0;	// @[generators/rocket-chip/src/main/scala/tilelink/Arbiter.scala:26:18, :61:28, :68:76, :88:26, :92:24]
  assign allowed_2_1 = idle_2 ? readys_readys_2[1] : state_2_1;	// @[generators/rocket-chip/src/main/scala/tilelink/Arbiter.scala:26:18, :61:28, :68:76, :88:26, :92:24]
  wire        in_0_d_valid = idle_2 ? _in_0_d_valid_T : state_2_0 & portsDIO_filtered_0_valid | state_2_1 & portsDIO_filtered_1_0_valid;	// @[generators/rocket-chip/src/main/scala/tilelink/Arbiter.scala:61:28, :79:31, :88:26, :96:24, generators/rocket-chip/src/main/scala/tilelink/Xbar.scala:351:40, src/main/scala/chisel3/util/Mux.scala:30:73]
  wire        _in_0_d_bits_WIRE_1 = muxState_2_0 & auto_out_0_d_bits_corrupt;	// @[generators/rocket-chip/src/main/scala/tilelink/Arbiter.scala:89:25, src/main/scala/chisel3/util/Mux.scala:30:73]
  wire        _in_0_d_bits_WIRE_5 = muxState_2_0 & auto_out_0_d_bits_denied;	// @[generators/rocket-chip/src/main/scala/tilelink/Arbiter.scala:89:25, src/main/scala/chisel3/util/Mux.scala:30:73]
  wire [1:0]  _in_0_d_bits_WIRE_6 = (muxState_2_0 ? portsDIO_filtered_1_bits_sink : 2'h0) | (muxState_2_1 ? auto_out_1_d_bits_sink : 2'h0);	// @[generators/rocket-chip/src/main/scala/tilelink/Arbiter.scala:89:25, generators/rocket-chip/src/main/scala/tilelink/Bundles.scala:259:74, generators/rocket-chip/src/main/scala/tilelink/Xbar.scala:247:28, src/main/scala/chisel3/util/Mux.scala:30:73]
  wire [8:0]  _in_0_d_bits_WIRE_7 = (muxState_2_0 ? auto_out_0_d_bits_source[8:0] : 9'h0) | (muxState_2_1 ? auto_out_1_d_bits_source[8:0] : 9'h0);	// @[generators/rocket-chip/src/main/scala/diplomacy/LazyModule.scala:366:18, generators/rocket-chip/src/main/scala/tilelink/Arbiter.scala:89:25, generators/rocket-chip/src/main/scala/tilelink/Xbar.scala:185:17, src/main/scala/chisel3/util/Mux.scala:30:73]
  wire [2:0]  _in_0_d_bits_WIRE_8 = (muxState_2_0 ? auto_out_0_d_bits_size : 3'h0) | (muxState_2_1 ? auto_out_1_d_bits_size : 3'h0);	// @[generators/rocket-chip/src/main/scala/tilelink/Arbiter.scala:89:25, generators/rocket-chip/src/main/scala/tilelink/Bundles.scala:259:74, src/main/scala/chisel3/util/Mux.scala:30:73]
  wire [1:0]  _in_0_d_bits_WIRE_9 = (muxState_2_0 ? auto_out_0_d_bits_param : 2'h0) | (muxState_2_1 ? auto_out_1_d_bits_param : 2'h0);	// @[generators/rocket-chip/src/main/scala/tilelink/Arbiter.scala:89:25, generators/rocket-chip/src/main/scala/tilelink/Bundles.scala:259:74, src/main/scala/chisel3/util/Mux.scala:30:73]
  wire [2:0]  _in_0_d_bits_WIRE_10 = (muxState_2_0 ? auto_out_0_d_bits_opcode : 3'h0) | (muxState_2_1 ? auto_out_1_d_bits_opcode : 3'h0);	// @[generators/rocket-chip/src/main/scala/tilelink/Arbiter.scala:89:25, generators/rocket-chip/src/main/scala/tilelink/Bundles.scala:259:74, src/main/scala/chisel3/util/Mux.scala:30:73]
  reg  [3:0]  beatsLeft_3;	// @[generators/rocket-chip/src/main/scala/tilelink/Arbiter.scala:60:30]
  wire        idle_3 = beatsLeft_3 == 4'h0;	// @[generators/rocket-chip/src/main/scala/tilelink/Arbiter.scala:60:30, :61:28, generators/rocket-chip/src/main/scala/tilelink/Bundles.scala:259:74]
  wire [1:0]  readys_valid_3 = {portsDIO_filtered_1_1_valid, portsDIO_filtered_1_valid};	// @[generators/rocket-chip/src/main/scala/tilelink/Arbiter.scala:68:51, generators/rocket-chip/src/main/scala/tilelink/Xbar.scala:351:40]
  reg  [1:0]  readys_mask_3;	// @[generators/rocket-chip/src/main/scala/tilelink/Arbiter.scala:23:23]
  wire [1:0]  _readys_filter_T_7 = readys_valid_3 & ~readys_mask_3;	// @[generators/rocket-chip/src/main/scala/tilelink/Arbiter.scala:23:23, :24:{28,30}, :68:51]
  wire [1:0]  readys_readys_3 = ~({readys_mask_3[1], _readys_filter_T_7[1] | readys_mask_3[0]} & ({_readys_filter_T_7[0], portsDIO_filtered_1_1_valid} | _readys_filter_T_7));	// @[generators/rocket-chip/src/main/scala/tilelink/Arbiter.scala:23:23, :24:28, :25:58, :26:{18,29,39}, generators/rocket-chip/src/main/scala/tilelink/Xbar.scala:351:40, generators/rocket-chip/src/main/scala/util/package.scala:254:43]
  wire        winner_3_0 = readys_readys_3[0] & portsDIO_filtered_1_valid;	// @[generators/rocket-chip/src/main/scala/tilelink/Arbiter.scala:26:18, :68:76, :71:69, generators/rocket-chip/src/main/scala/tilelink/Xbar.scala:351:40]
  wire        winner_3_1 = readys_readys_3[1] & portsDIO_filtered_1_1_valid;	// @[generators/rocket-chip/src/main/scala/tilelink/Arbiter.scala:26:18, :68:76, :71:69, generators/rocket-chip/src/main/scala/tilelink/Xbar.scala:351:40]
  wire        _in_1_d_valid_T = portsDIO_filtered_1_valid | portsDIO_filtered_1_1_valid;	// @[generators/rocket-chip/src/main/scala/tilelink/Arbiter.scala:79:31, generators/rocket-chip/src/main/scala/tilelink/Xbar.scala:351:40]
  `ifndef SYNTHESIS	// @[generators/rocket-chip/src/main/scala/tilelink/Arbiter.scala:77:13]
    always @(posedge clock) begin	// @[generators/rocket-chip/src/main/scala/tilelink/Arbiter.scala:77:13]
      if (~reset & ~(~winner_0 | ~winner_1)) begin	// @[generators/rocket-chip/src/main/scala/tilelink/Arbiter.scala:71:69, :77:{13,56,59,62}]
        if (`ASSERT_VERBOSE_COND_)	// @[generators/rocket-chip/src/main/scala/tilelink/Arbiter.scala:77:13]
          $error("Assertion failed\n    at Arbiter.scala:77 assert((prefixOR zip winner) map { case (p,w) => !p || !w } reduce {_ && _})\n");	// @[generators/rocket-chip/src/main/scala/tilelink/Arbiter.scala:77:13]
        if (`STOP_COND_)	// @[generators/rocket-chip/src/main/scala/tilelink/Arbiter.scala:77:13]
          $fatal;	// @[generators/rocket-chip/src/main/scala/tilelink/Arbiter.scala:77:13]
      end
      if (~reset & ~(~_out_0_a_valid_T | winner_0 | winner_1)) begin	// @[generators/rocket-chip/src/main/scala/tilelink/Arbiter.scala:71:69, :77:13, :79:{14,15,31,36}]
        if (`ASSERT_VERBOSE_COND_)	// @[generators/rocket-chip/src/main/scala/tilelink/Arbiter.scala:79:14]
          $error("Assertion failed\n    at Arbiter.scala:79 assert (!valids.reduce(_||_) || winner.reduce(_||_))\n");	// @[generators/rocket-chip/src/main/scala/tilelink/Arbiter.scala:79:14]
        if (`STOP_COND_)	// @[generators/rocket-chip/src/main/scala/tilelink/Arbiter.scala:79:14]
          $fatal;	// @[generators/rocket-chip/src/main/scala/tilelink/Arbiter.scala:79:14]
      end
      if (~reset & ~(~winner_1_0 | ~winner_1_1)) begin	// @[generators/rocket-chip/src/main/scala/tilelink/Arbiter.scala:71:69, :77:{13,56,59,62}]
        if (`ASSERT_VERBOSE_COND_)	// @[generators/rocket-chip/src/main/scala/tilelink/Arbiter.scala:77:13]
          $error("Assertion failed\n    at Arbiter.scala:77 assert((prefixOR zip winner) map { case (p,w) => !p || !w } reduce {_ && _})\n");	// @[generators/rocket-chip/src/main/scala/tilelink/Arbiter.scala:77:13]
        if (`STOP_COND_)	// @[generators/rocket-chip/src/main/scala/tilelink/Arbiter.scala:77:13]
          $fatal;	// @[generators/rocket-chip/src/main/scala/tilelink/Arbiter.scala:77:13]
      end
      if (~reset & ~(~_out_1_a_valid_T | winner_1_0 | winner_1_1)) begin	// @[generators/rocket-chip/src/main/scala/tilelink/Arbiter.scala:71:69, :77:13, :79:{14,15,31,36}]
        if (`ASSERT_VERBOSE_COND_)	// @[generators/rocket-chip/src/main/scala/tilelink/Arbiter.scala:79:14]
          $error("Assertion failed\n    at Arbiter.scala:79 assert (!valids.reduce(_||_) || winner.reduce(_||_))\n");	// @[generators/rocket-chip/src/main/scala/tilelink/Arbiter.scala:79:14]
        if (`STOP_COND_)	// @[generators/rocket-chip/src/main/scala/tilelink/Arbiter.scala:79:14]
          $fatal;	// @[generators/rocket-chip/src/main/scala/tilelink/Arbiter.scala:79:14]
      end
      if (~reset & ~(~winner_2_0 | ~winner_2_1)) begin	// @[generators/rocket-chip/src/main/scala/tilelink/Arbiter.scala:71:69, :77:{13,56,59,62}]
        if (`ASSERT_VERBOSE_COND_)	// @[generators/rocket-chip/src/main/scala/tilelink/Arbiter.scala:77:13]
          $error("Assertion failed\n    at Arbiter.scala:77 assert((prefixOR zip winner) map { case (p,w) => !p || !w } reduce {_ && _})\n");	// @[generators/rocket-chip/src/main/scala/tilelink/Arbiter.scala:77:13]
        if (`STOP_COND_)	// @[generators/rocket-chip/src/main/scala/tilelink/Arbiter.scala:77:13]
          $fatal;	// @[generators/rocket-chip/src/main/scala/tilelink/Arbiter.scala:77:13]
      end
      if (~reset & ~(~_in_0_d_valid_T | winner_2_0 | winner_2_1)) begin	// @[generators/rocket-chip/src/main/scala/tilelink/Arbiter.scala:71:69, :77:13, :79:{14,15,31,36}]
        if (`ASSERT_VERBOSE_COND_)	// @[generators/rocket-chip/src/main/scala/tilelink/Arbiter.scala:79:14]
          $error("Assertion failed\n    at Arbiter.scala:79 assert (!valids.reduce(_||_) || winner.reduce(_||_))\n");	// @[generators/rocket-chip/src/main/scala/tilelink/Arbiter.scala:79:14]
        if (`STOP_COND_)	// @[generators/rocket-chip/src/main/scala/tilelink/Arbiter.scala:79:14]
          $fatal;	// @[generators/rocket-chip/src/main/scala/tilelink/Arbiter.scala:79:14]
      end
      if (~reset & ~(~winner_3_0 | ~winner_3_1)) begin	// @[generators/rocket-chip/src/main/scala/tilelink/Arbiter.scala:71:69, :77:{13,56,59,62}]
        if (`ASSERT_VERBOSE_COND_)	// @[generators/rocket-chip/src/main/scala/tilelink/Arbiter.scala:77:13]
          $error("Assertion failed\n    at Arbiter.scala:77 assert((prefixOR zip winner) map { case (p,w) => !p || !w } reduce {_ && _})\n");	// @[generators/rocket-chip/src/main/scala/tilelink/Arbiter.scala:77:13]
        if (`STOP_COND_)	// @[generators/rocket-chip/src/main/scala/tilelink/Arbiter.scala:77:13]
          $fatal;	// @[generators/rocket-chip/src/main/scala/tilelink/Arbiter.scala:77:13]
      end
      if (~reset & ~(~_in_1_d_valid_T | winner_3_0 | winner_3_1)) begin	// @[generators/rocket-chip/src/main/scala/tilelink/Arbiter.scala:71:69, :77:13, :79:{14,15,31,36}]
        if (`ASSERT_VERBOSE_COND_)	// @[generators/rocket-chip/src/main/scala/tilelink/Arbiter.scala:79:14]
          $error("Assertion failed\n    at Arbiter.scala:79 assert (!valids.reduce(_||_) || winner.reduce(_||_))\n");	// @[generators/rocket-chip/src/main/scala/tilelink/Arbiter.scala:79:14]
        if (`STOP_COND_)	// @[generators/rocket-chip/src/main/scala/tilelink/Arbiter.scala:79:14]
          $fatal;	// @[generators/rocket-chip/src/main/scala/tilelink/Arbiter.scala:79:14]
      end
    end // always @(posedge)
  `endif // not def SYNTHESIS
  reg         state_3_0;	// @[generators/rocket-chip/src/main/scala/tilelink/Arbiter.scala:88:26]
  reg         state_3_1;	// @[generators/rocket-chip/src/main/scala/tilelink/Arbiter.scala:88:26]
  wire        muxState_3_0 = idle_3 ? winner_3_0 : state_3_0;	// @[generators/rocket-chip/src/main/scala/tilelink/Arbiter.scala:61:28, :71:69, :88:26, :89:25]
  wire        muxState_3_1 = idle_3 ? winner_3_1 : state_3_1;	// @[generators/rocket-chip/src/main/scala/tilelink/Arbiter.scala:61:28, :71:69, :88:26, :89:25]
  assign allowed_3_0 = idle_3 ? readys_readys_3[0] : state_3_0;	// @[generators/rocket-chip/src/main/scala/tilelink/Arbiter.scala:26:18, :61:28, :68:76, :88:26, :92:24]
  assign allowed_3_1 = idle_3 ? readys_readys_3[1] : state_3_1;	// @[generators/rocket-chip/src/main/scala/tilelink/Arbiter.scala:26:18, :61:28, :68:76, :88:26, :92:24]
  wire        in_1_d_valid = idle_3 ? _in_1_d_valid_T : state_3_0 & portsDIO_filtered_1_valid | state_3_1 & portsDIO_filtered_1_1_valid;	// @[generators/rocket-chip/src/main/scala/tilelink/Arbiter.scala:61:28, :79:31, :88:26, :96:24, generators/rocket-chip/src/main/scala/tilelink/Xbar.scala:351:40, src/main/scala/chisel3/util/Mux.scala:30:73]
  wire        _in_1_d_bits_WIRE_1 = muxState_3_0 & auto_out_0_d_bits_corrupt;	// @[generators/rocket-chip/src/main/scala/tilelink/Arbiter.scala:89:25, src/main/scala/chisel3/util/Mux.scala:30:73]
  wire        _in_1_d_bits_WIRE_5 = muxState_3_0 & auto_out_0_d_bits_denied;	// @[generators/rocket-chip/src/main/scala/tilelink/Arbiter.scala:89:25, src/main/scala/chisel3/util/Mux.scala:30:73]
  wire [1:0]  _in_1_d_bits_WIRE_6 = (muxState_3_0 ? portsDIO_filtered_1_bits_sink : 2'h0) | (muxState_3_1 ? auto_out_1_d_bits_sink : 2'h0);	// @[generators/rocket-chip/src/main/scala/tilelink/Arbiter.scala:89:25, generators/rocket-chip/src/main/scala/tilelink/Bundles.scala:259:74, generators/rocket-chip/src/main/scala/tilelink/Xbar.scala:247:28, src/main/scala/chisel3/util/Mux.scala:30:73]
  wire [1:0]  _in_1_d_bits_WIRE_7 = (muxState_3_0 ? auto_out_0_d_bits_source[1:0] : 2'h0) | (muxState_3_1 ? auto_out_1_d_bits_source[1:0] : 2'h0);	// @[generators/rocket-chip/src/main/scala/diplomacy/LazyModule.scala:366:18, generators/rocket-chip/src/main/scala/tilelink/Arbiter.scala:89:25, generators/rocket-chip/src/main/scala/tilelink/Bundles.scala:259:74, src/main/scala/chisel3/util/Mux.scala:30:73]
  wire [2:0]  _in_1_d_bits_WIRE_8 = (muxState_3_0 ? auto_out_0_d_bits_size : 3'h0) | (muxState_3_1 ? auto_out_1_d_bits_size : 3'h0);	// @[generators/rocket-chip/src/main/scala/tilelink/Arbiter.scala:89:25, generators/rocket-chip/src/main/scala/tilelink/Bundles.scala:259:74, src/main/scala/chisel3/util/Mux.scala:30:73]
  wire [1:0]  _in_1_d_bits_WIRE_9 = (muxState_3_0 ? auto_out_0_d_bits_param : 2'h0) | (muxState_3_1 ? auto_out_1_d_bits_param : 2'h0);	// @[generators/rocket-chip/src/main/scala/tilelink/Arbiter.scala:89:25, generators/rocket-chip/src/main/scala/tilelink/Bundles.scala:259:74, src/main/scala/chisel3/util/Mux.scala:30:73]
  wire [2:0]  _in_1_d_bits_WIRE_10 = (muxState_3_0 ? auto_out_0_d_bits_opcode : 3'h0) | (muxState_3_1 ? auto_out_1_d_bits_opcode : 3'h0);	// @[generators/rocket-chip/src/main/scala/tilelink/Arbiter.scala:89:25, generators/rocket-chip/src/main/scala/tilelink/Bundles.scala:259:74, src/main/scala/chisel3/util/Mux.scala:30:73]
  wire [1:0]  _readys_mask_T = readys_readys & readys_valid;	// @[generators/rocket-chip/src/main/scala/tilelink/Arbiter.scala:26:18, :28:29, :68:51]
  wire [1:0]  _readys_mask_T_5 = readys_readys_1 & readys_valid_1;	// @[generators/rocket-chip/src/main/scala/tilelink/Arbiter.scala:26:18, :28:29, :68:51]
  wire [1:0]  _readys_mask_T_10 = readys_readys_2 & readys_valid_2;	// @[generators/rocket-chip/src/main/scala/tilelink/Arbiter.scala:26:18, :28:29, :68:51]
  wire [1:0]  _readys_mask_T_15 = readys_readys_3 & readys_valid_3;	// @[generators/rocket-chip/src/main/scala/tilelink/Arbiter.scala:26:18, :28:29, :68:51]
  wire [12:0] _beatsAI_decode_T_1 = 13'h3F << auto_in_0_a_bits_size;	// @[generators/rocket-chip/src/main/scala/util/package.scala:235:71]
  wire [12:0] _beatsAI_decode_T_5 = 13'h3F << auto_in_1_a_bits_size;	// @[generators/rocket-chip/src/main/scala/util/package.scala:235:71]
  wire [12:0] _beatsDO_decode_T_1 = 13'h3F << auto_out_0_d_bits_size;	// @[generators/rocket-chip/src/main/scala/util/package.scala:235:71]
  wire [12:0] _beatsDO_decode_T_5 = 13'h3F << auto_out_1_d_bits_size;	// @[generators/rocket-chip/src/main/scala/util/package.scala:235:71]
  wire        latch = idle & auto_out_0_a_ready;	// @[generators/rocket-chip/src/main/scala/tilelink/Arbiter.scala:61:28, :62:24]
  wire        latch_1 = idle_1 & auto_out_1_a_ready;	// @[generators/rocket-chip/src/main/scala/tilelink/Arbiter.scala:61:28, :62:24]
  wire        latch_2 = idle_2 & auto_in_0_d_ready;	// @[generators/rocket-chip/src/main/scala/tilelink/Arbiter.scala:61:28, :62:24]
  wire        latch_3 = idle_3 & auto_in_1_d_ready;	// @[generators/rocket-chip/src/main/scala/tilelink/Arbiter.scala:61:28, :62:24]
  always @(posedge clock) begin
    if (reset) begin
      beatsLeft <= 4'h0;	// @[generators/rocket-chip/src/main/scala/tilelink/Arbiter.scala:60:30, generators/rocket-chip/src/main/scala/tilelink/Bundles.scala:259:74]
      readys_mask <= 2'h3;	// @[generators/rocket-chip/src/main/scala/diplomacy/Parameters.scala:57:20, generators/rocket-chip/src/main/scala/tilelink/Arbiter.scala:23:23]
      state_0 <= 1'h0;	// @[generators/rocket-chip/src/main/scala/tilelink/Arbiter.scala:88:26]
      state_1 <= 1'h0;	// @[generators/rocket-chip/src/main/scala/tilelink/Arbiter.scala:88:26]
      beatsLeft_1 <= 4'h0;	// @[generators/rocket-chip/src/main/scala/tilelink/Arbiter.scala:60:30, generators/rocket-chip/src/main/scala/tilelink/Bundles.scala:259:74]
      readys_mask_1 <= 2'h3;	// @[generators/rocket-chip/src/main/scala/diplomacy/Parameters.scala:57:20, generators/rocket-chip/src/main/scala/tilelink/Arbiter.scala:23:23]
      state_1_0 <= 1'h0;	// @[generators/rocket-chip/src/main/scala/tilelink/Arbiter.scala:88:26]
      state_1_1 <= 1'h0;	// @[generators/rocket-chip/src/main/scala/tilelink/Arbiter.scala:88:26]
      beatsLeft_2 <= 4'h0;	// @[generators/rocket-chip/src/main/scala/tilelink/Arbiter.scala:60:30, generators/rocket-chip/src/main/scala/tilelink/Bundles.scala:259:74]
      readys_mask_2 <= 2'h3;	// @[generators/rocket-chip/src/main/scala/diplomacy/Parameters.scala:57:20, generators/rocket-chip/src/main/scala/tilelink/Arbiter.scala:23:23]
      state_2_0 <= 1'h0;	// @[generators/rocket-chip/src/main/scala/tilelink/Arbiter.scala:88:26]
      state_2_1 <= 1'h0;	// @[generators/rocket-chip/src/main/scala/tilelink/Arbiter.scala:88:26]
      beatsLeft_3 <= 4'h0;	// @[generators/rocket-chip/src/main/scala/tilelink/Arbiter.scala:60:30, generators/rocket-chip/src/main/scala/tilelink/Bundles.scala:259:74]
      readys_mask_3 <= 2'h3;	// @[generators/rocket-chip/src/main/scala/diplomacy/Parameters.scala:57:20, generators/rocket-chip/src/main/scala/tilelink/Arbiter.scala:23:23]
      state_3_0 <= 1'h0;	// @[generators/rocket-chip/src/main/scala/tilelink/Arbiter.scala:88:26]
      state_3_1 <= 1'h0;	// @[generators/rocket-chip/src/main/scala/tilelink/Arbiter.scala:88:26]
    end
    else begin
      if (latch)	// @[generators/rocket-chip/src/main/scala/tilelink/Arbiter.scala:62:24]
        beatsLeft <= (winner_0 & ~(auto_in_0_a_bits_opcode[2]) ? ~(_beatsAI_decode_T_1[5:2]) : 4'h0) | (winner_1 & ~(auto_in_1_a_bits_opcode[2]) ? ~(_beatsAI_decode_T_5[5:2]) : 4'h0);	// @[generators/rocket-chip/src/main/scala/tilelink/Arbiter.scala:60:30, :71:69, :82:69, :84:44, generators/rocket-chip/src/main/scala/tilelink/Bundles.scala:259:74, generators/rocket-chip/src/main/scala/tilelink/Edges.scala:92:{28,37}, :221:14, generators/rocket-chip/src/main/scala/util/package.scala:235:{46,71,76}]
      else	// @[generators/rocket-chip/src/main/scala/tilelink/Arbiter.scala:62:24]
        beatsLeft <= beatsLeft - {3'h0, auto_out_0_a_ready & out_0_a_valid};	// @[generators/rocket-chip/src/main/scala/tilelink/Arbiter.scala:60:30, :85:52, :96:24, generators/rocket-chip/src/main/scala/tilelink/Bundles.scala:259:74, src/main/scala/chisel3/util/Decoupled.scala:52:35]
      if (latch & (|readys_valid))	// @[generators/rocket-chip/src/main/scala/tilelink/Arbiter.scala:27:{18,27}, :62:24, :68:51]
        readys_mask <= _readys_mask_T | {_readys_mask_T[0], 1'h0};	// @[generators/rocket-chip/src/main/scala/tilelink/Arbiter.scala:23:23, :28:29, generators/rocket-chip/src/main/scala/util/package.scala:245:{43,53}]
      if (idle) begin	// @[generators/rocket-chip/src/main/scala/tilelink/Arbiter.scala:61:28]
        state_0 <= winner_0;	// @[generators/rocket-chip/src/main/scala/tilelink/Arbiter.scala:71:69, :88:26]
        state_1 <= winner_1;	// @[generators/rocket-chip/src/main/scala/tilelink/Arbiter.scala:71:69, :88:26]
      end
      if (latch_1)	// @[generators/rocket-chip/src/main/scala/tilelink/Arbiter.scala:62:24]
        beatsLeft_1 <= (winner_1_0 & ~(auto_in_0_a_bits_opcode[2]) ? ~(_beatsAI_decode_T_1[5:2]) : 4'h0) | (winner_1_1 & ~(auto_in_1_a_bits_opcode[2]) ? ~(_beatsAI_decode_T_5[5:2]) : 4'h0);	// @[generators/rocket-chip/src/main/scala/tilelink/Arbiter.scala:60:30, :71:69, :82:69, :84:44, generators/rocket-chip/src/main/scala/tilelink/Bundles.scala:259:74, generators/rocket-chip/src/main/scala/tilelink/Edges.scala:92:{28,37}, :221:14, generators/rocket-chip/src/main/scala/util/package.scala:235:{46,71,76}]
      else	// @[generators/rocket-chip/src/main/scala/tilelink/Arbiter.scala:62:24]
        beatsLeft_1 <= beatsLeft_1 - {3'h0, auto_out_1_a_ready & out_1_a_valid};	// @[generators/rocket-chip/src/main/scala/tilelink/Arbiter.scala:60:30, :85:52, :96:24, generators/rocket-chip/src/main/scala/tilelink/Bundles.scala:259:74, src/main/scala/chisel3/util/Decoupled.scala:52:35]
      if (latch_1 & (|readys_valid_1))	// @[generators/rocket-chip/src/main/scala/tilelink/Arbiter.scala:27:{18,27}, :62:24, :68:51]
        readys_mask_1 <= _readys_mask_T_5 | {_readys_mask_T_5[0], 1'h0};	// @[generators/rocket-chip/src/main/scala/tilelink/Arbiter.scala:23:23, :28:29, generators/rocket-chip/src/main/scala/util/package.scala:245:{43,53}]
      if (idle_1) begin	// @[generators/rocket-chip/src/main/scala/tilelink/Arbiter.scala:61:28]
        state_1_0 <= winner_1_0;	// @[generators/rocket-chip/src/main/scala/tilelink/Arbiter.scala:71:69, :88:26]
        state_1_1 <= winner_1_1;	// @[generators/rocket-chip/src/main/scala/tilelink/Arbiter.scala:71:69, :88:26]
      end
      if (latch_2)	// @[generators/rocket-chip/src/main/scala/tilelink/Arbiter.scala:62:24]
        beatsLeft_2 <= (winner_2_0 & auto_out_0_d_bits_opcode[0] ? ~(_beatsDO_decode_T_1[5:2]) : 4'h0) | (winner_2_1 & auto_out_1_d_bits_opcode[0] ? ~(_beatsDO_decode_T_5[5:2]) : 4'h0);	// @[generators/rocket-chip/src/main/scala/tilelink/Arbiter.scala:60:30, :71:69, :82:69, :84:44, generators/rocket-chip/src/main/scala/tilelink/Bundles.scala:259:74, generators/rocket-chip/src/main/scala/tilelink/Edges.scala:106:36, :221:14, generators/rocket-chip/src/main/scala/util/package.scala:235:{46,71,76}]
      else	// @[generators/rocket-chip/src/main/scala/tilelink/Arbiter.scala:62:24]
        beatsLeft_2 <= beatsLeft_2 - {3'h0, auto_in_0_d_ready & in_0_d_valid};	// @[generators/rocket-chip/src/main/scala/tilelink/Arbiter.scala:60:30, :85:52, :96:24, generators/rocket-chip/src/main/scala/tilelink/Bundles.scala:259:74, src/main/scala/chisel3/util/Decoupled.scala:52:35]
      if (latch_2 & (|readys_valid_2))	// @[generators/rocket-chip/src/main/scala/tilelink/Arbiter.scala:27:{18,27}, :62:24, :68:51]
        readys_mask_2 <= _readys_mask_T_10 | {_readys_mask_T_10[0], 1'h0};	// @[generators/rocket-chip/src/main/scala/tilelink/Arbiter.scala:23:23, :28:29, generators/rocket-chip/src/main/scala/util/package.scala:245:{43,53}]
      if (idle_2) begin	// @[generators/rocket-chip/src/main/scala/tilelink/Arbiter.scala:61:28]
        state_2_0 <= winner_2_0;	// @[generators/rocket-chip/src/main/scala/tilelink/Arbiter.scala:71:69, :88:26]
        state_2_1 <= winner_2_1;	// @[generators/rocket-chip/src/main/scala/tilelink/Arbiter.scala:71:69, :88:26]
      end
      if (latch_3)	// @[generators/rocket-chip/src/main/scala/tilelink/Arbiter.scala:62:24]
        beatsLeft_3 <= (winner_3_0 & auto_out_0_d_bits_opcode[0] ? ~(_beatsDO_decode_T_1[5:2]) : 4'h0) | (winner_3_1 & auto_out_1_d_bits_opcode[0] ? ~(_beatsDO_decode_T_5[5:2]) : 4'h0);	// @[generators/rocket-chip/src/main/scala/tilelink/Arbiter.scala:60:30, :71:69, :82:69, :84:44, generators/rocket-chip/src/main/scala/tilelink/Bundles.scala:259:74, generators/rocket-chip/src/main/scala/tilelink/Edges.scala:106:36, :221:14, generators/rocket-chip/src/main/scala/util/package.scala:235:{46,71,76}]
      else	// @[generators/rocket-chip/src/main/scala/tilelink/Arbiter.scala:62:24]
        beatsLeft_3 <= beatsLeft_3 - {3'h0, auto_in_1_d_ready & in_1_d_valid};	// @[generators/rocket-chip/src/main/scala/tilelink/Arbiter.scala:60:30, :85:52, :96:24, generators/rocket-chip/src/main/scala/tilelink/Bundles.scala:259:74, src/main/scala/chisel3/util/Decoupled.scala:52:35]
      if (latch_3 & (|readys_valid_3))	// @[generators/rocket-chip/src/main/scala/tilelink/Arbiter.scala:27:{18,27}, :62:24, :68:51]
        readys_mask_3 <= _readys_mask_T_15 | {_readys_mask_T_15[0], 1'h0};	// @[generators/rocket-chip/src/main/scala/tilelink/Arbiter.scala:23:23, :28:29, generators/rocket-chip/src/main/scala/util/package.scala:245:{43,53}]
      if (idle_3) begin	// @[generators/rocket-chip/src/main/scala/tilelink/Arbiter.scala:61:28]
        state_3_0 <= winner_3_0;	// @[generators/rocket-chip/src/main/scala/tilelink/Arbiter.scala:71:69, :88:26]
        state_3_1 <= winner_3_1;	// @[generators/rocket-chip/src/main/scala/tilelink/Arbiter.scala:71:69, :88:26]
      end
    end
  end // always @(posedge)
  `ifdef ENABLE_INITIAL_REG_
    `ifdef FIRRTL_BEFORE_INITIAL
      `FIRRTL_BEFORE_INITIAL
    `endif // FIRRTL_BEFORE_INITIAL
    logic [31:0] _RANDOM[0:0];
    initial begin
      `ifdef INIT_RANDOM_PROLOG_
        `INIT_RANDOM_PROLOG_
      `endif // INIT_RANDOM_PROLOG_
      `ifdef RANDOMIZE_REG_INIT
        _RANDOM[/*Zero width*/ 1'b0] = `RANDOM;
        beatsLeft = _RANDOM[/*Zero width*/ 1'b0][3:0];	// @[generators/rocket-chip/src/main/scala/tilelink/Arbiter.scala:60:30]
        readys_mask = _RANDOM[/*Zero width*/ 1'b0][5:4];	// @[generators/rocket-chip/src/main/scala/tilelink/Arbiter.scala:23:23, :60:30]
        state_0 = _RANDOM[/*Zero width*/ 1'b0][6];	// @[generators/rocket-chip/src/main/scala/tilelink/Arbiter.scala:60:30, :88:26]
        state_1 = _RANDOM[/*Zero width*/ 1'b0][7];	// @[generators/rocket-chip/src/main/scala/tilelink/Arbiter.scala:60:30, :88:26]
        beatsLeft_1 = _RANDOM[/*Zero width*/ 1'b0][11:8];	// @[generators/rocket-chip/src/main/scala/tilelink/Arbiter.scala:60:30]
        readys_mask_1 = _RANDOM[/*Zero width*/ 1'b0][13:12];	// @[generators/rocket-chip/src/main/scala/tilelink/Arbiter.scala:23:23, :60:30]
        state_1_0 = _RANDOM[/*Zero width*/ 1'b0][14];	// @[generators/rocket-chip/src/main/scala/tilelink/Arbiter.scala:60:30, :88:26]
        state_1_1 = _RANDOM[/*Zero width*/ 1'b0][15];	// @[generators/rocket-chip/src/main/scala/tilelink/Arbiter.scala:60:30, :88:26]
        beatsLeft_2 = _RANDOM[/*Zero width*/ 1'b0][19:16];	// @[generators/rocket-chip/src/main/scala/tilelink/Arbiter.scala:60:30]
        readys_mask_2 = _RANDOM[/*Zero width*/ 1'b0][21:20];	// @[generators/rocket-chip/src/main/scala/tilelink/Arbiter.scala:23:23, :60:30]
        state_2_0 = _RANDOM[/*Zero width*/ 1'b0][22];	// @[generators/rocket-chip/src/main/scala/tilelink/Arbiter.scala:60:30, :88:26]
        state_2_1 = _RANDOM[/*Zero width*/ 1'b0][23];	// @[generators/rocket-chip/src/main/scala/tilelink/Arbiter.scala:60:30, :88:26]
        beatsLeft_3 = _RANDOM[/*Zero width*/ 1'b0][27:24];	// @[generators/rocket-chip/src/main/scala/tilelink/Arbiter.scala:60:30]
        readys_mask_3 = _RANDOM[/*Zero width*/ 1'b0][29:28];	// @[generators/rocket-chip/src/main/scala/tilelink/Arbiter.scala:23:23, :60:30]
        state_3_0 = _RANDOM[/*Zero width*/ 1'b0][30];	// @[generators/rocket-chip/src/main/scala/tilelink/Arbiter.scala:60:30, :88:26]
        state_3_1 = _RANDOM[/*Zero width*/ 1'b0][31];	// @[generators/rocket-chip/src/main/scala/tilelink/Arbiter.scala:60:30, :88:26]
      `endif // RANDOMIZE_REG_INIT
    end // initial
    `ifdef FIRRTL_AFTER_INITIAL
      `FIRRTL_AFTER_INITIAL
    `endif // FIRRTL_AFTER_INITIAL
  `endif // ENABLE_INITIAL_REG_
  TLMonitor monitor (	// @[generators/rocket-chip/src/main/scala/tilelink/Nodes.scala:24:25]
    .clock                (clock),
    .reset                (reset),
    .io_in_a_ready        (_portsAOI_in_0_a_ready_WIRE),	// @[src/main/scala/chisel3/util/Mux.scala:30:73]
    .io_in_a_valid        (auto_in_0_a_valid),
    .io_in_a_bits_opcode  (auto_in_0_a_bits_opcode),
    .io_in_a_bits_param   (auto_in_0_a_bits_param),
    .io_in_a_bits_size    (auto_in_0_a_bits_size),
    .io_in_a_bits_source  (auto_in_0_a_bits_source),
    .io_in_a_bits_address (auto_in_0_a_bits_address),
    .io_in_a_bits_mask    (auto_in_0_a_bits_mask),
    .io_in_a_bits_corrupt (auto_in_0_a_bits_corrupt),
    .io_in_d_ready        (auto_in_0_d_ready),
    .io_in_d_valid        (in_0_d_valid),	// @[generators/rocket-chip/src/main/scala/tilelink/Arbiter.scala:96:24]
    .io_in_d_bits_opcode  (_in_0_d_bits_WIRE_10),	// @[src/main/scala/chisel3/util/Mux.scala:30:73]
    .io_in_d_bits_param   (_in_0_d_bits_WIRE_9),	// @[src/main/scala/chisel3/util/Mux.scala:30:73]
    .io_in_d_bits_size    (_in_0_d_bits_WIRE_8),	// @[src/main/scala/chisel3/util/Mux.scala:30:73]
    .io_in_d_bits_source  (_in_0_d_bits_WIRE_7),	// @[src/main/scala/chisel3/util/Mux.scala:30:73]
    .io_in_d_bits_sink    (_in_0_d_bits_WIRE_6),	// @[src/main/scala/chisel3/util/Mux.scala:30:73]
    .io_in_d_bits_denied  (_in_0_d_bits_WIRE_5),	// @[src/main/scala/chisel3/util/Mux.scala:30:73]
    .io_in_d_bits_corrupt (_in_0_d_bits_WIRE_1)	// @[src/main/scala/chisel3/util/Mux.scala:30:73]
  );
  TLMonitor_1 monitor_1 (	// @[generators/rocket-chip/src/main/scala/tilelink/Nodes.scala:24:25]
    .clock                (clock),
    .reset                (reset),
    .io_in_a_ready        (_portsAOI_in_1_a_ready_WIRE),	// @[src/main/scala/chisel3/util/Mux.scala:30:73]
    .io_in_a_valid        (auto_in_1_a_valid),
    .io_in_a_bits_opcode  (auto_in_1_a_bits_opcode),
    .io_in_a_bits_param   (auto_in_1_a_bits_param),
    .io_in_a_bits_size    (auto_in_1_a_bits_size),
    .io_in_a_bits_source  (auto_in_1_a_bits_source),
    .io_in_a_bits_address (auto_in_1_a_bits_address),
    .io_in_a_bits_mask    (auto_in_1_a_bits_mask),
    .io_in_a_bits_corrupt (auto_in_1_a_bits_corrupt),
    .io_in_b_ready        (auto_in_1_b_ready),
    .io_in_b_valid        (auto_out_1_b_valid),
    .io_in_b_bits_param   (auto_out_1_b_bits_param),
    .io_in_b_bits_address (auto_out_1_b_bits_address),
    .io_in_c_ready        (auto_out_1_c_ready),
    .io_in_c_valid        (auto_in_1_c_valid),
    .io_in_c_bits_opcode  (auto_in_1_c_bits_opcode),
    .io_in_c_bits_param   (auto_in_1_c_bits_param),
    .io_in_c_bits_size    (auto_in_1_c_bits_size),
    .io_in_c_bits_source  (auto_in_1_c_bits_source),
    .io_in_c_bits_address (auto_in_1_c_bits_address),
    .io_in_c_bits_corrupt (auto_in_1_c_bits_corrupt),
    .io_in_d_ready        (auto_in_1_d_ready),
    .io_in_d_valid        (in_1_d_valid),	// @[generators/rocket-chip/src/main/scala/tilelink/Arbiter.scala:96:24]
    .io_in_d_bits_opcode  (_in_1_d_bits_WIRE_10),	// @[src/main/scala/chisel3/util/Mux.scala:30:73]
    .io_in_d_bits_param   (_in_1_d_bits_WIRE_9),	// @[src/main/scala/chisel3/util/Mux.scala:30:73]
    .io_in_d_bits_size    (_in_1_d_bits_WIRE_8),	// @[src/main/scala/chisel3/util/Mux.scala:30:73]
    .io_in_d_bits_source  (_in_1_d_bits_WIRE_7),	// @[src/main/scala/chisel3/util/Mux.scala:30:73]
    .io_in_d_bits_sink    (_in_1_d_bits_WIRE_6),	// @[src/main/scala/chisel3/util/Mux.scala:30:73]
    .io_in_d_bits_denied  (_in_1_d_bits_WIRE_5),	// @[src/main/scala/chisel3/util/Mux.scala:30:73]
    .io_in_d_bits_corrupt (_in_1_d_bits_WIRE_1),	// @[src/main/scala/chisel3/util/Mux.scala:30:73]
    .io_in_e_valid        (auto_in_1_e_valid),
    .io_in_e_bits_sink    (auto_in_1_e_bits_sink)
  );
  assign auto_in_1_a_ready = _portsAOI_in_1_a_ready_WIRE;	// @[src/main/scala/chisel3/util/Mux.scala:30:73]
  assign auto_in_1_b_valid = auto_out_1_b_valid;
  assign auto_in_1_b_bits_param = auto_out_1_b_bits_param;
  assign auto_in_1_b_bits_address = auto_out_1_b_bits_address;
  assign auto_in_1_c_ready = auto_out_1_c_ready;
  assign auto_in_1_d_valid = in_1_d_valid;	// @[generators/rocket-chip/src/main/scala/tilelink/Arbiter.scala:96:24]
  assign auto_in_1_d_bits_opcode = _in_1_d_bits_WIRE_10;	// @[src/main/scala/chisel3/util/Mux.scala:30:73]
  assign auto_in_1_d_bits_param = _in_1_d_bits_WIRE_9;	// @[src/main/scala/chisel3/util/Mux.scala:30:73]
  assign auto_in_1_d_bits_size = _in_1_d_bits_WIRE_8;	// @[src/main/scala/chisel3/util/Mux.scala:30:73]
  assign auto_in_1_d_bits_source = _in_1_d_bits_WIRE_7;	// @[src/main/scala/chisel3/util/Mux.scala:30:73]
  assign auto_in_1_d_bits_sink = _in_1_d_bits_WIRE_6;	// @[src/main/scala/chisel3/util/Mux.scala:30:73]
  assign auto_in_1_d_bits_denied = _in_1_d_bits_WIRE_5;	// @[src/main/scala/chisel3/util/Mux.scala:30:73]
  assign auto_in_1_d_bits_data = (muxState_3_0 ? auto_out_0_d_bits_data : 32'h0) | (muxState_3_1 ? auto_out_1_d_bits_data : 32'h0);	// @[generators/rocket-chip/src/main/scala/tilelink/Arbiter.scala:89:25, generators/rocket-chip/src/main/scala/tilelink/Bundles.scala:259:74, src/main/scala/chisel3/util/Mux.scala:30:73]
  assign auto_in_1_d_bits_corrupt = _in_1_d_bits_WIRE_1;	// @[src/main/scala/chisel3/util/Mux.scala:30:73]
  assign auto_in_0_a_ready = _portsAOI_in_0_a_ready_WIRE;	// @[src/main/scala/chisel3/util/Mux.scala:30:73]
  assign auto_in_0_d_valid = in_0_d_valid;	// @[generators/rocket-chip/src/main/scala/tilelink/Arbiter.scala:96:24]
  assign auto_in_0_d_bits_opcode = _in_0_d_bits_WIRE_10;	// @[src/main/scala/chisel3/util/Mux.scala:30:73]
  assign auto_in_0_d_bits_param = _in_0_d_bits_WIRE_9;	// @[src/main/scala/chisel3/util/Mux.scala:30:73]
  assign auto_in_0_d_bits_size = _in_0_d_bits_WIRE_8;	// @[src/main/scala/chisel3/util/Mux.scala:30:73]
  assign auto_in_0_d_bits_source = _in_0_d_bits_WIRE_7;	// @[src/main/scala/chisel3/util/Mux.scala:30:73]
  assign auto_in_0_d_bits_sink = _in_0_d_bits_WIRE_6;	// @[src/main/scala/chisel3/util/Mux.scala:30:73]
  assign auto_in_0_d_bits_denied = _in_0_d_bits_WIRE_5;	// @[src/main/scala/chisel3/util/Mux.scala:30:73]
  assign auto_in_0_d_bits_data = (muxState_2_0 ? auto_out_0_d_bits_data : 32'h0) | (muxState_2_1 ? auto_out_1_d_bits_data : 32'h0);	// @[generators/rocket-chip/src/main/scala/tilelink/Arbiter.scala:89:25, generators/rocket-chip/src/main/scala/tilelink/Bundles.scala:259:74, src/main/scala/chisel3/util/Mux.scala:30:73]
  assign auto_in_0_d_bits_corrupt = _in_0_d_bits_WIRE_1;	// @[src/main/scala/chisel3/util/Mux.scala:30:73]
  assign auto_out_1_a_valid = out_1_a_valid;	// @[generators/rocket-chip/src/main/scala/tilelink/Arbiter.scala:96:24]
  assign auto_out_1_a_bits_opcode = (muxState_1_0 ? auto_in_0_a_bits_opcode : 3'h0) | (muxState_1_1 ? auto_in_1_a_bits_opcode : 3'h0);	// @[generators/rocket-chip/src/main/scala/tilelink/Arbiter.scala:89:25, generators/rocket-chip/src/main/scala/tilelink/Bundles.scala:259:74, src/main/scala/chisel3/util/Mux.scala:30:73]
  assign auto_out_1_a_bits_param = (muxState_1_0 ? auto_in_0_a_bits_param : 3'h0) | (muxState_1_1 ? auto_in_1_a_bits_param : 3'h0);	// @[generators/rocket-chip/src/main/scala/tilelink/Arbiter.scala:89:25, generators/rocket-chip/src/main/scala/tilelink/Bundles.scala:259:74, src/main/scala/chisel3/util/Mux.scala:30:73]
  assign auto_out_1_a_bits_size = (muxState_1_0 ? auto_in_0_a_bits_size : 3'h0) | (muxState_1_1 ? auto_in_1_a_bits_size : 3'h0);	// @[generators/rocket-chip/src/main/scala/tilelink/Arbiter.scala:89:25, generators/rocket-chip/src/main/scala/tilelink/Bundles.scala:259:74, src/main/scala/chisel3/util/Mux.scala:30:73]
  assign auto_out_1_a_bits_source = (muxState_1_0 ? portsAOI_filtered_1_bits_source : 10'h0) | (muxState_1_1 ? portsAOI_filtered_1_1_bits_source : 10'h0);	// @[generators/rocket-chip/src/main/scala/tilelink/Arbiter.scala:89:25, generators/rocket-chip/src/main/scala/tilelink/Xbar.scala:162:{29,55}, :185:17, src/main/scala/chisel3/util/Mux.scala:30:73]
  assign auto_out_1_a_bits_address = (muxState_1_0 ? auto_in_0_a_bits_address : 32'h0) | (muxState_1_1 ? auto_in_1_a_bits_address : 32'h0);	// @[generators/rocket-chip/src/main/scala/tilelink/Arbiter.scala:89:25, generators/rocket-chip/src/main/scala/tilelink/Bundles.scala:259:74, src/main/scala/chisel3/util/Mux.scala:30:73]
  assign auto_out_1_a_bits_mask = (muxState_1_0 ? auto_in_0_a_bits_mask : 4'h0) | (muxState_1_1 ? auto_in_1_a_bits_mask : 4'h0);	// @[generators/rocket-chip/src/main/scala/tilelink/Arbiter.scala:89:25, generators/rocket-chip/src/main/scala/tilelink/Bundles.scala:259:74, src/main/scala/chisel3/util/Mux.scala:30:73]
  assign auto_out_1_a_bits_data = (muxState_1_0 ? auto_in_0_a_bits_data : 32'h0) | (muxState_1_1 ? auto_in_1_a_bits_data : 32'h0);	// @[generators/rocket-chip/src/main/scala/tilelink/Arbiter.scala:89:25, generators/rocket-chip/src/main/scala/tilelink/Bundles.scala:259:74, src/main/scala/chisel3/util/Mux.scala:30:73]
  assign auto_out_1_a_bits_corrupt = muxState_1_0 & auto_in_0_a_bits_corrupt | muxState_1_1 & auto_in_1_a_bits_corrupt;	// @[generators/rocket-chip/src/main/scala/tilelink/Arbiter.scala:89:25, src/main/scala/chisel3/util/Mux.scala:30:73]
  assign auto_out_1_b_ready = auto_in_1_b_ready;
  assign auto_out_1_c_valid = auto_in_1_c_valid;
  assign auto_out_1_c_bits_opcode = auto_in_1_c_bits_opcode;
  assign auto_out_1_c_bits_param = auto_in_1_c_bits_param;
  assign auto_out_1_c_bits_size = auto_in_1_c_bits_size;
  assign auto_out_1_c_bits_source = {8'h80, auto_in_1_c_bits_source};	// @[generators/rocket-chip/src/main/scala/diplomacy/Parameters.scala:54:32, generators/rocket-chip/src/main/scala/tilelink/Xbar.scala:183:55]
  assign auto_out_1_c_bits_address = auto_in_1_c_bits_address;
  assign auto_out_1_c_bits_data = auto_in_1_c_bits_data;
  assign auto_out_1_c_bits_corrupt = auto_in_1_c_bits_corrupt;
  assign auto_out_1_d_ready = ~(auto_out_1_d_bits_source[9]) & auto_in_0_d_ready & allowed_2_1 | requestDOI_1_1 & auto_in_1_d_ready & allowed_3_1;	// @[generators/rocket-chip/src/main/scala/diplomacy/Parameters.scala:54:{10,32}, generators/rocket-chip/src/main/scala/tilelink/Arbiter.scala:92:24, src/main/scala/chisel3/util/Mux.scala:30:73]
  assign auto_out_1_e_valid = auto_in_1_e_valid;
  assign auto_out_1_e_bits_sink = auto_in_1_e_bits_sink;
  assign auto_out_0_a_valid = out_0_a_valid;	// @[generators/rocket-chip/src/main/scala/tilelink/Arbiter.scala:96:24]
  assign auto_out_0_a_bits_opcode = (muxState_0 ? auto_in_0_a_bits_opcode : 3'h0) | (muxState_1 ? auto_in_1_a_bits_opcode : 3'h0);	// @[generators/rocket-chip/src/main/scala/tilelink/Arbiter.scala:89:25, generators/rocket-chip/src/main/scala/tilelink/Bundles.scala:259:74, src/main/scala/chisel3/util/Mux.scala:30:73]
  assign auto_out_0_a_bits_param = (muxState_0 ? auto_in_0_a_bits_param : 3'h0) | (muxState_1 ? auto_in_1_a_bits_param : 3'h0);	// @[generators/rocket-chip/src/main/scala/tilelink/Arbiter.scala:89:25, generators/rocket-chip/src/main/scala/tilelink/Bundles.scala:259:74, src/main/scala/chisel3/util/Mux.scala:30:73]
  assign auto_out_0_a_bits_size = (muxState_0 ? auto_in_0_a_bits_size : 3'h0) | (muxState_1 ? auto_in_1_a_bits_size : 3'h0);	// @[generators/rocket-chip/src/main/scala/tilelink/Arbiter.scala:89:25, generators/rocket-chip/src/main/scala/tilelink/Bundles.scala:259:74, src/main/scala/chisel3/util/Mux.scala:30:73]
  assign auto_out_0_a_bits_source = (muxState_0 ? portsAOI_filtered_1_bits_source : 10'h0) | (muxState_1 ? portsAOI_filtered_1_1_bits_source : 10'h0);	// @[generators/rocket-chip/src/main/scala/tilelink/Arbiter.scala:89:25, generators/rocket-chip/src/main/scala/tilelink/Xbar.scala:162:{29,55}, :185:17, src/main/scala/chisel3/util/Mux.scala:30:73]
  assign auto_out_0_a_bits_address = (muxState_0 ? auto_in_0_a_bits_address[29:0] : 30'h0) | (muxState_1 ? auto_in_1_a_bits_address[29:0] : 30'h0);	// @[generators/rocket-chip/src/main/scala/diplomacy/LazyModule.scala:366:18, generators/rocket-chip/src/main/scala/tilelink/Arbiter.scala:89:25, generators/rocket-chip/src/main/scala/tilelink/Bundles.scala:259:74, src/main/scala/chisel3/util/Mux.scala:30:73]
  assign auto_out_0_a_bits_mask = (muxState_0 ? auto_in_0_a_bits_mask : 4'h0) | (muxState_1 ? auto_in_1_a_bits_mask : 4'h0);	// @[generators/rocket-chip/src/main/scala/tilelink/Arbiter.scala:89:25, generators/rocket-chip/src/main/scala/tilelink/Bundles.scala:259:74, src/main/scala/chisel3/util/Mux.scala:30:73]
  assign auto_out_0_a_bits_data = (muxState_0 ? auto_in_0_a_bits_data : 32'h0) | (muxState_1 ? auto_in_1_a_bits_data : 32'h0);	// @[generators/rocket-chip/src/main/scala/tilelink/Arbiter.scala:89:25, generators/rocket-chip/src/main/scala/tilelink/Bundles.scala:259:74, src/main/scala/chisel3/util/Mux.scala:30:73]
  assign auto_out_0_a_bits_corrupt = muxState_0 & auto_in_0_a_bits_corrupt | muxState_1 & auto_in_1_a_bits_corrupt;	// @[generators/rocket-chip/src/main/scala/tilelink/Arbiter.scala:89:25, src/main/scala/chisel3/util/Mux.scala:30:73]
  assign auto_out_0_d_ready = ~(auto_out_0_d_bits_source[9]) & auto_in_0_d_ready & allowed_2_0 | requestDOI_0_1 & auto_in_1_d_ready & allowed_3_0;	// @[generators/rocket-chip/src/main/scala/diplomacy/Parameters.scala:54:{10,32}, generators/rocket-chip/src/main/scala/tilelink/Arbiter.scala:92:24, src/main/scala/chisel3/util/Mux.scala:30:73]
endmodule

