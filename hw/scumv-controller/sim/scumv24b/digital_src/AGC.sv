// Generated by CIRCT unknown git version
// Standard header to adapt well known macros for register randomization.
`ifndef RANDOMIZE
  `ifdef RANDOMIZE_MEM_INIT
    `define RANDOMIZE
  `endif // RANDOMIZE_MEM_INIT
`endif // not def RANDOMIZE
`ifndef RANDOMIZE
  `ifdef RANDOMIZE_REG_INIT
    `define RANDOMIZE
  `endif // RANDOMIZE_REG_INIT
`endif // not def RANDOMIZE

// RANDOM may be set to an expression that produces a 32-bit random unsigned value.
`ifndef RANDOM
  `define RANDOM $random
`endif // not def RANDOM

// Users can define INIT_RANDOM as general code that gets injected into the
// initializer block for modules with registers.
`ifndef INIT_RANDOM
  `define INIT_RANDOM
`endif // not def INIT_RANDOM

// If using random initialization, you can also define RANDOMIZE_DELAY to
// customize the delay used, otherwise 0.002 is used.
`ifndef RANDOMIZE_DELAY
  `define RANDOMIZE_DELAY 0.002
`endif // not def RANDOMIZE_DELAY

// Define INIT_RANDOM_PROLOG_ for use in our modules below.
`ifndef INIT_RANDOM_PROLOG_
  `ifdef RANDOMIZE
    `ifdef VERILATOR
      `define INIT_RANDOM_PROLOG_ `INIT_RANDOM
    `else  // VERILATOR
      `define INIT_RANDOM_PROLOG_ `INIT_RANDOM #`RANDOMIZE_DELAY begin end
    `endif // VERILATOR
  `else  // RANDOMIZE
    `define INIT_RANDOM_PROLOG_
  `endif // RANDOMIZE
`endif // not def INIT_RANDOM_PROLOG_

// Include register initializers in init blocks unless synthesis is set
`ifndef SYNTHESIS
  `ifndef ENABLE_INITIAL_REG_
    `define ENABLE_INITIAL_REG_
  `endif // not def ENABLE_INITIAL_REG_
`endif // not def SYNTHESIS

// Include rmemory initializers in init blocks unless synthesis is set
`ifndef SYNTHESIS
  `ifndef ENABLE_INITIAL_MEM_
    `define ENABLE_INITIAL_MEM_
  `endif // not def ENABLE_INITIAL_MEM_
`endif // not def SYNTHESIS

// Standard header to adapt well known macros for prints and assertions.

// Users can define 'PRINTF_COND' to add an extra gate to prints.
`ifndef PRINTF_COND_
  `ifdef PRINTF_COND
    `define PRINTF_COND_ (`PRINTF_COND)
  `else  // PRINTF_COND
    `define PRINTF_COND_ 1
  `endif // PRINTF_COND
`endif // not def PRINTF_COND_

// Users can define 'ASSERT_VERBOSE_COND' to add an extra gate to assert error printing.
`ifndef ASSERT_VERBOSE_COND_
  `ifdef ASSERT_VERBOSE_COND
    `define ASSERT_VERBOSE_COND_ (`ASSERT_VERBOSE_COND)
  `else  // ASSERT_VERBOSE_COND
    `define ASSERT_VERBOSE_COND_ 1
  `endif // ASSERT_VERBOSE_COND
`endif // not def ASSERT_VERBOSE_COND_

// Users can define 'STOP_COND' to add an extra gate to stop conditions.
`ifndef STOP_COND_
  `ifdef STOP_COND
    `define STOP_COND_ (`STOP_COND)
  `else  // STOP_COND
    `define STOP_COND_ 1
  `endif // STOP_COND
`endif // not def STOP_COND_

module AGC(
  input        clock,
               reset,
  input  [7:0] io_adcIn,	// @[generators/baseband/src/main/scala/modem/AGC.scala:32:14]
  output [4:0] io_vgaLUTIndex,	// @[generators/baseband/src/main/scala/modem/AGC.scala:32:14]
  input  [7:0] io_control_sampleWindow,	// @[generators/baseband/src/main/scala/modem/AGC.scala:32:14]
               io_control_idealPeakToPeak,	// @[generators/baseband/src/main/scala/modem/AGC.scala:32:14]
               io_control_toleranceP2P,	// @[generators/baseband/src/main/scala/modem/AGC.scala:32:14]
               io_control_gainInc,	// @[generators/baseband/src/main/scala/modem/AGC.scala:32:14]
               io_control_gainDec,	// @[generators/baseband/src/main/scala/modem/AGC.scala:32:14]
  input        io_control_reset	// @[generators/baseband/src/main/scala/modem/AGC.scala:32:14]
);

  reg  [7:0] counter;	// @[generators/baseband/src/main/scala/modem/AGC.scala:39:26]
  reg  [7:0] minreg;	// @[generators/baseband/src/main/scala/modem/AGC.scala:44:25]
  reg  [7:0] maxreg;	// @[generators/baseband/src/main/scala/modem/AGC.scala:45:25]
  reg  [4:0] current_gain;	// @[generators/baseband/src/main/scala/modem/AGC.scala:53:31]
  wire [8:0] inc_gain = {4'h0, current_gain} + {1'h0, io_control_gainInc};	// @[generators/baseband/src/main/scala/modem/AGC.scala:53:31, :55:33]
  wire       _minval_T = minreg < io_adcIn;	// @[generators/baseband/src/main/scala/modem/AGC.scala:44:25, :46:29]
  wire       _maxval_T = maxreg > io_adcIn;	// @[generators/baseband/src/main/scala/modem/AGC.scala:45:25, :47:29]
  wire [7:0] _p2p_T = (_maxval_T ? maxreg : io_adcIn) - (_minval_T ? minreg : io_adcIn);	// @[generators/baseband/src/main/scala/modem/AGC.scala:44:25, :45:25, :46:{21,29}, :47:{21,29}, :50:22]
  always @(posedge clock) begin
    if (reset | io_control_reset) begin	// @[generators/baseband/src/main/scala/modem/AGC.scala:38:26]
      counter <= 8'h0;	// @[generators/baseband/src/main/scala/modem/AGC.scala:39:26]
      minreg <= 8'h80;	// @[generators/baseband/src/main/scala/modem/AGC.scala:44:25]
      maxreg <= 8'h80;	// @[generators/baseband/src/main/scala/modem/AGC.scala:44:25, :45:25]
      current_gain <= 5'h1F;	// @[generators/baseband/src/main/scala/modem/AGC.scala:53:31]
    end
    else if (counter >= io_control_sampleWindow) begin	// @[generators/baseband/src/main/scala/modem/AGC.scala:39:26, :40:31]
      counter <= 8'h0;	// @[generators/baseband/src/main/scala/modem/AGC.scala:39:26]
      minreg <= 8'h80;	// @[generators/baseband/src/main/scala/modem/AGC.scala:44:25]
      maxreg <= 8'h80;	// @[generators/baseband/src/main/scala/modem/AGC.scala:44:25, :45:25]
      if (_p2p_T > io_control_idealPeakToPeak + io_control_toleranceP2P)	// @[generators/baseband/src/main/scala/modem/AGC.scala:50:22, :59:{16,45}]
        current_gain <= io_control_gainDec > {3'h0, current_gain} ? 5'h0 : current_gain - io_control_gainDec[4:0];	// @[generators/baseband/src/main/scala/modem/AGC.scala:32:14, :39:26, :53:31, :56:{23,43,77}]
      else if (_p2p_T < io_control_idealPeakToPeak - io_control_toleranceP2P)	// @[generators/baseband/src/main/scala/modem/AGC.scala:50:22, :61:{22,51}]
        current_gain <= (|(inc_gain[8:5])) ? 5'h1F : inc_gain[4:0];	// @[generators/baseband/src/main/scala/modem/AGC.scala:53:31, :55:33, :62:{28,38}]
    end
    else begin	// @[generators/baseband/src/main/scala/modem/AGC.scala:40:31]
      counter <= counter + 8'h1;	// @[generators/baseband/src/main/scala/modem/AGC.scala:39:26, :41:46]
      if (~_minval_T)	// @[generators/baseband/src/main/scala/modem/AGC.scala:46:29]
        minreg <= io_adcIn;	// @[generators/baseband/src/main/scala/modem/AGC.scala:44:25]
      if (~_maxval_T)	// @[generators/baseband/src/main/scala/modem/AGC.scala:47:29]
        maxreg <= io_adcIn;	// @[generators/baseband/src/main/scala/modem/AGC.scala:45:25]
    end
  end // always @(posedge)
  `ifdef ENABLE_INITIAL_REG_
    `ifdef FIRRTL_BEFORE_INITIAL
      `FIRRTL_BEFORE_INITIAL
    `endif // FIRRTL_BEFORE_INITIAL
    logic [31:0] _RANDOM[0:0];
    initial begin
      `ifdef INIT_RANDOM_PROLOG_
        `INIT_RANDOM_PROLOG_
      `endif // INIT_RANDOM_PROLOG_
      `ifdef RANDOMIZE_REG_INIT
        _RANDOM[/*Zero width*/ 1'b0] = `RANDOM;
        counter = _RANDOM[/*Zero width*/ 1'b0][7:0];	// @[generators/baseband/src/main/scala/modem/AGC.scala:39:26]
        minreg = _RANDOM[/*Zero width*/ 1'b0][15:8];	// @[generators/baseband/src/main/scala/modem/AGC.scala:39:26, :44:25]
        maxreg = _RANDOM[/*Zero width*/ 1'b0][23:16];	// @[generators/baseband/src/main/scala/modem/AGC.scala:39:26, :45:25]
        current_gain = _RANDOM[/*Zero width*/ 1'b0][28:24];	// @[generators/baseband/src/main/scala/modem/AGC.scala:39:26, :53:31]
      `endif // RANDOMIZE_REG_INIT
    end // initial
    `ifdef FIRRTL_AFTER_INITIAL
      `FIRRTL_AFTER_INITIAL
    `endif // FIRRTL_AFTER_INITIAL
  `endif // ENABLE_INITIAL_REG_
  assign io_vgaLUTIndex = current_gain;	// @[generators/baseband/src/main/scala/modem/AGC.scala:53:31]
endmodule

