// Generated by CIRCT unknown git version
// Standard header to adapt well known macros for register randomization.
`ifndef RANDOMIZE
  `ifdef RANDOMIZE_MEM_INIT
    `define RANDOMIZE
  `endif // RANDOMIZE_MEM_INIT
`endif // not def RANDOMIZE
`ifndef RANDOMIZE
  `ifdef RANDOMIZE_REG_INIT
    `define RANDOMIZE
  `endif // RANDOMIZE_REG_INIT
`endif // not def RANDOMIZE

// RANDOM may be set to an expression that produces a 32-bit random unsigned value.
`ifndef RANDOM
  `define RANDOM $random
`endif // not def RANDOM

// Users can define INIT_RANDOM as general code that gets injected into the
// initializer block for modules with registers.
`ifndef INIT_RANDOM
  `define INIT_RANDOM
`endif // not def INIT_RANDOM

// If using random initialization, you can also define RANDOMIZE_DELAY to
// customize the delay used, otherwise 0.002 is used.
`ifndef RANDOMIZE_DELAY
  `define RANDOMIZE_DELAY 0.002
`endif // not def RANDOMIZE_DELAY

// Define INIT_RANDOM_PROLOG_ for use in our modules below.
`ifndef INIT_RANDOM_PROLOG_
  `ifdef RANDOMIZE
    `ifdef VERILATOR
      `define INIT_RANDOM_PROLOG_ `INIT_RANDOM
    `else  // VERILATOR
      `define INIT_RANDOM_PROLOG_ `INIT_RANDOM #`RANDOMIZE_DELAY begin end
    `endif // VERILATOR
  `else  // RANDOMIZE
    `define INIT_RANDOM_PROLOG_
  `endif // RANDOMIZE
`endif // not def INIT_RANDOM_PROLOG_

// Include register initializers in init blocks unless synthesis is set
`ifndef SYNTHESIS
  `ifndef ENABLE_INITIAL_REG_
    `define ENABLE_INITIAL_REG_
  `endif // not def ENABLE_INITIAL_REG_
`endif // not def SYNTHESIS

// Include rmemory initializers in init blocks unless synthesis is set
`ifndef SYNTHESIS
  `ifndef ENABLE_INITIAL_MEM_
    `define ENABLE_INITIAL_MEM_
  `endif // not def ENABLE_INITIAL_MEM_
`endif // not def SYNTHESIS

// Standard header to adapt well known macros for prints and assertions.

// Users can define 'PRINTF_COND' to add an extra gate to prints.
`ifndef PRINTF_COND_
  `ifdef PRINTF_COND
    `define PRINTF_COND_ (`PRINTF_COND)
  `else  // PRINTF_COND
    `define PRINTF_COND_ 1
  `endif // PRINTF_COND
`endif // not def PRINTF_COND_

// Users can define 'ASSERT_VERBOSE_COND' to add an extra gate to assert error printing.
`ifndef ASSERT_VERBOSE_COND_
  `ifdef ASSERT_VERBOSE_COND
    `define ASSERT_VERBOSE_COND_ (`ASSERT_VERBOSE_COND)
  `else  // ASSERT_VERBOSE_COND
    `define ASSERT_VERBOSE_COND_ 1
  `endif // ASSERT_VERBOSE_COND
`endif // not def ASSERT_VERBOSE_COND_

// Users can define 'STOP_COND' to add an extra gate to stop conditions.
`ifndef STOP_COND_
  `ifdef STOP_COND
    `define STOP_COND_ (`STOP_COND)
  `else  // STOP_COND
    `define STOP_COND_ 1
  `endif // STOP_COND
`endif // not def STOP_COND_

module GFSKTX(
  input         clock,
                reset,
  output        io_digital_in_ready,	// @[generators/baseband/src/main/scala/modem/FSKTX.scala:34:14]
  input         io_digital_in_valid,	// @[generators/baseband/src/main/scala/modem/FSKTX.scala:34:14]
                io_digital_in_bits,	// @[generators/baseband/src/main/scala/modem/FSKTX.scala:34:14]
  output        io_control_ready,	// @[generators/baseband/src/main/scala/modem/FSKTX.scala:34:14]
  input         io_control_valid,	// @[generators/baseband/src/main/scala/modem/FSKTX.scala:34:14]
  input  [8:0]  io_control_bits_totalBytes,	// @[generators/baseband/src/main/scala/modem/FSKTX.scala:34:14]
  input         io_firCmd_valid,	// @[generators/baseband/src/main/scala/modem/FSKTX.scala:34:14]
  input  [3:0]  io_firCmd_bits_fir,	// @[generators/baseband/src/main/scala/modem/FSKTX.scala:34:14]
  input  [5:0]  io_firCmd_bits_coeff,	// @[generators/baseband/src/main/scala/modem/FSKTX.scala:34:14]
  input  [21:0] io_firCmd_bits_value,	// @[generators/baseband/src/main/scala/modem/FSKTX.scala:34:14]
  output [1:0]  io_out_state,	// @[generators/baseband/src/main/scala/modem/FSKTX.scala:34:14]
  output        io_out_done,	// @[generators/baseband/src/main/scala/modem/FSKTX.scala:34:14]
  output [5:0]  io_modIndex	// @[generators/baseband/src/main/scala/modem/FSKTX.scala:34:14]
);

  wire       _fir_io_in_ready;	// @[generators/baseband/src/main/scala/modem/FSKTX.scala:67:19]
  wire [7:0] _fir_io_out_bits;	// @[generators/baseband/src/main/scala/modem/FSKTX.scala:67:19]
  reg        state;	// @[generators/baseband/src/main/scala/modem/FSKTX.scala:48:22]
  reg  [7:0] counter;	// @[generators/baseband/src/main/scala/modem/FSKTX.scala:54:24]
  reg  [2:0] counterBytes;	// @[generators/baseband/src/main/scala/modem/FSKTX.scala:55:29]
  reg  [8:0] sentBytes;	// @[generators/baseband/src/main/scala/modem/FSKTX.scala:57:26]
  reg  [8:0] totalBytes;	// @[generators/baseband/src/main/scala/modem/FSKTX.scala:58:27]
  reg        done;	// @[generators/baseband/src/main/scala/modem/FSKTX.scala:60:21]
  reg        firInValid;	// @[generators/baseband/src/main/scala/modem/FSKTX.scala:64:27]
  reg  [7:0] firInData;	// @[generators/baseband/src/main/scala/modem/FSKTX.scala:65:26]
  wire       io_digital_in_ready_0 = state & ~(|counter) & sentBytes < totalBytes;	// @[generators/baseband/src/main/scala/modem/FSKTX.scala:48:22, :54:24, :57:26, :58:27, :73:{57,65,78}]
  wire [7:0] _GEN = counter % 8'h2;	// @[generators/baseband/src/main/scala/modem/FSKTX.scala:54:24, :118:26]
  wire       _GEN_0 = ~state & io_control_valid;	// @[generators/baseband/src/main/scala/modem/FSKTX.scala:48:22, :75:29, src/main/scala/chisel3/util/Decoupled.scala:52:35]
  wire       _GEN_1 = io_digital_in_ready_0 & io_digital_in_valid;	// @[generators/baseband/src/main/scala/modem/FSKTX.scala:73:65, src/main/scala/chisel3/util/Decoupled.scala:52:35]
  wire       _GEN_2 = sentBytes >= totalBytes;	// @[generators/baseband/src/main/scala/modem/FSKTX.scala:57:26, :58:27, :92:28]
  wire       _counter_T_4 = counter == 8'h1F;	// @[generators/baseband/src/main/scala/modem/FSKTX.scala:54:24, :100:30]
  wire       _GEN_3 = sentBytes == totalBytes;	// @[generators/baseband/src/main/scala/modem/FSKTX.scala:57:26, :58:27, :106:26]
  wire       _GEN_4 = (|counter) & _counter_T_4 & (&counterBytes) & _GEN_3;	// @[generators/baseband/src/main/scala/modem/FSKTX.scala:54:24, :55:29, :60:21, :73:57, :99:33, :100:30, :102:49, :103:42, :105:36, :106:{26,42}, :108:18]
  always @(posedge clock) begin
    if (reset) begin
      state <= 1'h0;	// @[generators/baseband/src/main/scala/modem/FSKTX.scala:48:22]
      counter <= 8'h0;	// @[generators/baseband/src/main/scala/modem/FSKTX.scala:54:24]
      counterBytes <= 3'h0;	// @[generators/baseband/src/main/scala/modem/FSKTX.scala:55:29]
      sentBytes <= 9'h0;	// @[generators/baseband/src/main/scala/modem/FSKTX.scala:57:26]
      totalBytes <= 9'h0;	// @[generators/baseband/src/main/scala/modem/FSKTX.scala:57:26, :58:27]
      done <= 1'h0;	// @[generators/baseband/src/main/scala/modem/FSKTX.scala:60:21]
      firInValid <= 1'h0;	// @[generators/baseband/src/main/scala/modem/FSKTX.scala:64:27]
      firInData <= 8'h0;	// @[generators/baseband/src/main/scala/modem/FSKTX.scala:54:24, :65:26]
    end
    else begin
      if (state) begin	// @[generators/baseband/src/main/scala/modem/FSKTX.scala:48:22]
        state <= (~state | ~(|counter) | ~_GEN_4) & state;	// @[generators/baseband/src/main/scala/modem/FSKTX.scala:48:22, :54:24, :60:21, :73:57, :86:35, :87:27, :99:33, :102:49, :105:36, :106:42, :108:18, :109:19]
        if (|counter) begin	// @[generators/baseband/src/main/scala/modem/FSKTX.scala:54:24, :73:57]
          if (_counter_T_4)	// @[generators/baseband/src/main/scala/modem/FSKTX.scala:100:30]
            counter <= 8'h0;	// @[generators/baseband/src/main/scala/modem/FSKTX.scala:54:24]
          else	// @[generators/baseband/src/main/scala/modem/FSKTX.scala:100:30]
            counter <= counter + 8'h1;	// @[generators/baseband/src/main/scala/modem/FSKTX.scala:54:24, :91:28, :100:72]
          firInValid <= ~(_fir_io_in_ready & firInValid) & (_GEN[1:0] == 2'h0 | firInValid);	// @[generators/baseband/src/main/scala/modem/FSKTX.scala:64:27, :67:19, :116:30, :117:20, :118:{26,46,55}, :119:20, src/main/scala/chisel3/util/Decoupled.scala:52:35]
        end
        else begin	// @[generators/baseband/src/main/scala/modem/FSKTX.scala:73:57]
          if (_GEN_1)	// @[src/main/scala/chisel3/util/Decoupled.scala:52:35]
            counter <= counter + 8'h1;	// @[generators/baseband/src/main/scala/modem/FSKTX.scala:54:24, :91:28]
          else if (_GEN_2)	// @[generators/baseband/src/main/scala/modem/FSKTX.scala:92:28]
            counter <= counter + 8'h1;	// @[generators/baseband/src/main/scala/modem/FSKTX.scala:54:24, :91:28, :95:28]
          firInValid <= _GEN_1 | _GEN_2;	// @[generators/baseband/src/main/scala/modem/FSKTX.scala:64:27, :88:34, :89:20, :92:{28,42}, src/main/scala/chisel3/util/Decoupled.scala:52:35]
        end
        if (state & (|counter) & _counter_T_4 & (&counterBytes)) begin	// @[generators/baseband/src/main/scala/modem/FSKTX.scala:48:22, :54:24, :55:29, :57:26, :73:57, :86:35, :87:27, :100:30, :103:42]
          if (_GEN_3)	// @[generators/baseband/src/main/scala/modem/FSKTX.scala:106:26]
            sentBytes <= 9'h0;	// @[generators/baseband/src/main/scala/modem/FSKTX.scala:57:26]
          else	// @[generators/baseband/src/main/scala/modem/FSKTX.scala:106:26]
            sentBytes <= sentBytes + 9'h1;	// @[generators/baseband/src/main/scala/modem/FSKTX.scala:57:26, :111:36]
        end
      end
      else begin	// @[generators/baseband/src/main/scala/modem/FSKTX.scala:48:22]
        state <= _GEN_0 | state;	// @[generators/baseband/src/main/scala/modem/FSKTX.scala:48:22, :80:30, :81:13, src/main/scala/chisel3/util/Decoupled.scala:52:35]
        if (_GEN_0) begin	// @[src/main/scala/chisel3/util/Decoupled.scala:52:35]
          counter <= 8'h0;	// @[generators/baseband/src/main/scala/modem/FSKTX.scala:54:24]
          sentBytes <= 9'h0;	// @[generators/baseband/src/main/scala/modem/FSKTX.scala:57:26]
        end
      end
      if (state & (|counter) & _counter_T_4) begin	// @[generators/baseband/src/main/scala/modem/FSKTX.scala:48:22, :54:24, :55:29, :73:57, :78:26, :86:35, :100:30]
        if (&counterBytes)	// @[generators/baseband/src/main/scala/modem/FSKTX.scala:55:29, :103:42]
          counterBytes <= 3'h0;	// @[generators/baseband/src/main/scala/modem/FSKTX.scala:55:29]
        else	// @[generators/baseband/src/main/scala/modem/FSKTX.scala:103:42]
          counterBytes <= counterBytes + 3'h1;	// @[generators/baseband/src/main/scala/modem/FSKTX.scala:55:29, :103:69]
      end
      if (~state & _GEN_0)	// @[generators/baseband/src/main/scala/modem/FSKTX.scala:48:22, :58:27, :75:29, :78:26, :80:30, :83:18, src/main/scala/chisel3/util/Decoupled.scala:52:35]
        totalBytes <= io_control_bits_totalBytes + 9'h8;	// @[generators/baseband/src/main/scala/modem/FSKTX.scala:58:27, :83:48]
      done <= state & (state & (|counter) & _GEN_4 | done);	// @[generators/baseband/src/main/scala/modem/FSKTX.scala:48:22, :54:24, :60:21, :73:57, :78:26, :79:10, :86:35, :87:27, :99:33, :102:49, :105:36, :106:42, :108:18]
      if (state & ~(|counter)) begin	// @[generators/baseband/src/main/scala/modem/FSKTX.scala:48:22, :54:24, :65:26, :73:57, :78:26, :86:35]
        if (_GEN_1)	// @[src/main/scala/chisel3/util/Decoupled.scala:52:35]
          firInData <= {~io_digital_in_bits, 7'h40};	// @[generators/baseband/src/main/scala/modem/FSKTX.scala:65:26, :90:{25,45}]
        else if (_GEN_2)	// @[generators/baseband/src/main/scala/modem/FSKTX.scala:92:28]
          firInData <= 8'h0;	// @[generators/baseband/src/main/scala/modem/FSKTX.scala:54:24, :65:26]
      end
    end
  end // always @(posedge)
  `ifdef ENABLE_INITIAL_REG_
    `ifdef FIRRTL_BEFORE_INITIAL
      `FIRRTL_BEFORE_INITIAL
    `endif // FIRRTL_BEFORE_INITIAL
    logic [31:0] _RANDOM[0:1];
    initial begin
      `ifdef INIT_RANDOM_PROLOG_
        `INIT_RANDOM_PROLOG_
      `endif // INIT_RANDOM_PROLOG_
      `ifdef RANDOMIZE_REG_INIT
        for (logic [1:0] i = 2'h0; i < 2'h2; i += 2'h1) begin
          _RANDOM[i[0]] = `RANDOM;
        end
        state = _RANDOM[1'h0][0];	// @[generators/baseband/src/main/scala/modem/FSKTX.scala:48:22]
        counter = _RANDOM[1'h0][8:1];	// @[generators/baseband/src/main/scala/modem/FSKTX.scala:48:22, :54:24]
        counterBytes = _RANDOM[1'h0][11:9];	// @[generators/baseband/src/main/scala/modem/FSKTX.scala:48:22, :55:29]
        sentBytes = _RANDOM[1'h0][20:12];	// @[generators/baseband/src/main/scala/modem/FSKTX.scala:48:22, :57:26]
        totalBytes = _RANDOM[1'h0][29:21];	// @[generators/baseband/src/main/scala/modem/FSKTX.scala:48:22, :58:27]
        done = _RANDOM[1'h0][30];	// @[generators/baseband/src/main/scala/modem/FSKTX.scala:48:22, :60:21]
        firInValid = _RANDOM[1'h0][31];	// @[generators/baseband/src/main/scala/modem/FSKTX.scala:48:22, :64:27]
        firInData = _RANDOM[1'h1][7:0];	// @[generators/baseband/src/main/scala/modem/FSKTX.scala:65:26]
      `endif // RANDOMIZE_REG_INIT
    end // initial
    `ifdef FIRRTL_AFTER_INITIAL
      `FIRRTL_AFTER_INITIAL
    `endif // FIRRTL_AFTER_INITIAL
  `endif // ENABLE_INITIAL_REG_
  FIR fir (	// @[generators/baseband/src/main/scala/modem/FSKTX.scala:67:19]
    .clock                (clock),
    .reset                (reset),
    .io_in_ready          (_fir_io_in_ready),
    .io_in_valid          (firInValid),	// @[generators/baseband/src/main/scala/modem/FSKTX.scala:64:27]
    .io_in_bits           (firInData),	// @[generators/baseband/src/main/scala/modem/FSKTX.scala:65:26]
    .io_out_ready         (state),	// @[generators/baseband/src/main/scala/modem/FSKTX.scala:48:22]
    .io_out_bits          (_fir_io_out_bits),
    .io_firCmd_valid      (io_firCmd_valid),
    .io_firCmd_bits_fir   (io_firCmd_bits_fir),
    .io_firCmd_bits_coeff (io_firCmd_bits_coeff),
    .io_firCmd_bits_value (io_firCmd_bits_value)
  );
  assign io_digital_in_ready = io_digital_in_ready_0;	// @[generators/baseband/src/main/scala/modem/FSKTX.scala:73:65]
  assign io_control_ready = ~state;	// @[generators/baseband/src/main/scala/modem/FSKTX.scala:48:22, :75:29]
  assign io_out_state = {1'h0, state};	// @[generators/baseband/src/main/scala/modem/FSKTX.scala:48:22, :49:16]
  assign io_out_done = done;	// @[generators/baseband/src/main/scala/modem/FSKTX.scala:60:21]
  assign io_modIndex = state ? _fir_io_out_bits[7:2] ^ 6'h20 : 6'h1F;	// @[generators/baseband/src/main/scala/modem/FSKTX.scala:48:22, :67:19, :126:29, :127:21, tools/fixedpoint/src/main/scala/fixedpoint/FixedPoint.scala:390:47]
endmodule

