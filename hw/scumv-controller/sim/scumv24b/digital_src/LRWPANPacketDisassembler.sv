// Generated by CIRCT unknown git version
// Standard header to adapt well known macros for register randomization.
`ifndef RANDOMIZE
  `ifdef RANDOMIZE_MEM_INIT
    `define RANDOMIZE
  `endif // RANDOMIZE_MEM_INIT
`endif // not def RANDOMIZE
`ifndef RANDOMIZE
  `ifdef RANDOMIZE_REG_INIT
    `define RANDOMIZE
  `endif // RANDOMIZE_REG_INIT
`endif // not def RANDOMIZE

// RANDOM may be set to an expression that produces a 32-bit random unsigned value.
`ifndef RANDOM
  `define RANDOM $random
`endif // not def RANDOM

// Users can define INIT_RANDOM as general code that gets injected into the
// initializer block for modules with registers.
`ifndef INIT_RANDOM
  `define INIT_RANDOM
`endif // not def INIT_RANDOM

// If using random initialization, you can also define RANDOMIZE_DELAY to
// customize the delay used, otherwise 0.002 is used.
`ifndef RANDOMIZE_DELAY
  `define RANDOMIZE_DELAY 0.002
`endif // not def RANDOMIZE_DELAY

// Define INIT_RANDOM_PROLOG_ for use in our modules below.
`ifndef INIT_RANDOM_PROLOG_
  `ifdef RANDOMIZE
    `ifdef VERILATOR
      `define INIT_RANDOM_PROLOG_ `INIT_RANDOM
    `else  // VERILATOR
      `define INIT_RANDOM_PROLOG_ `INIT_RANDOM #`RANDOMIZE_DELAY begin end
    `endif // VERILATOR
  `else  // RANDOMIZE
    `define INIT_RANDOM_PROLOG_
  `endif // RANDOMIZE
`endif // not def INIT_RANDOM_PROLOG_

// Include register initializers in init blocks unless synthesis is set
`ifndef SYNTHESIS
  `ifndef ENABLE_INITIAL_REG_
    `define ENABLE_INITIAL_REG_
  `endif // not def ENABLE_INITIAL_REG_
`endif // not def SYNTHESIS

// Include rmemory initializers in init blocks unless synthesis is set
`ifndef SYNTHESIS
  `ifndef ENABLE_INITIAL_MEM_
    `define ENABLE_INITIAL_MEM_
  `endif // not def ENABLE_INITIAL_MEM_
`endif // not def SYNTHESIS

// Standard header to adapt well known macros for prints and assertions.

// Users can define 'PRINTF_COND' to add an extra gate to prints.
`ifndef PRINTF_COND_
  `ifdef PRINTF_COND
    `define PRINTF_COND_ (`PRINTF_COND)
  `else  // PRINTF_COND
    `define PRINTF_COND_ 1
  `endif // PRINTF_COND
`endif // not def PRINTF_COND_

// Users can define 'ASSERT_VERBOSE_COND' to add an extra gate to assert error printing.
`ifndef ASSERT_VERBOSE_COND_
  `ifdef ASSERT_VERBOSE_COND
    `define ASSERT_VERBOSE_COND_ (`ASSERT_VERBOSE_COND)
  `else  // ASSERT_VERBOSE_COND
    `define ASSERT_VERBOSE_COND_ 1
  `endif // ASSERT_VERBOSE_COND
`endif // not def ASSERT_VERBOSE_COND_

// Users can define 'STOP_COND' to add an extra gate to stop conditions.
`ifndef STOP_COND_
  `ifdef STOP_COND
    `define STOP_COND_ (`STOP_COND)
  `else  // STOP_COND
    `define STOP_COND_ 1
  `endif // STOP_COND
`endif // not def STOP_COND_

module LRWPANPacketDisassembler(
  input         clock,
                reset,
                io_in_control_valid,	// @[generators/baseband/src/main/scala/baseband/LRWPANPacketDisassembler.scala:8:14]
  input  [1:0]  io_in_control_bits_command,	// @[generators/baseband/src/main/scala/baseband/LRWPANPacketDisassembler.scala:8:14]
  input         io_in_data_sop,	// @[generators/baseband/src/main/scala/baseband/LRWPANPacketDisassembler.scala:8:14]
  output        io_in_data_eop,	// @[generators/baseband/src/main/scala/baseband/LRWPANPacketDisassembler.scala:8:14]
  input         io_in_data_data_valid,	// @[generators/baseband/src/main/scala/baseband/LRWPANPacketDisassembler.scala:8:14]
  input  [7:0]  io_in_data_data_bits,	// @[generators/baseband/src/main/scala/baseband/LRWPANPacketDisassembler.scala:8:14]
  output [7:0]  io_out_control_length,	// @[generators/baseband/src/main/scala/baseband/LRWPANPacketDisassembler.scala:8:14]
  output        io_out_control_flag_crc,	// @[generators/baseband/src/main/scala/baseband/LRWPANPacketDisassembler.scala:8:14]
                io_out_control_done,	// @[generators/baseband/src/main/scala/baseband/LRWPANPacketDisassembler.scala:8:14]
                io_out_control_busy,	// @[generators/baseband/src/main/scala/baseband/LRWPANPacketDisassembler.scala:8:14]
  input         io_out_data_ready,	// @[generators/baseband/src/main/scala/baseband/LRWPANPacketDisassembler.scala:8:14]
  output        io_out_data_valid,	// @[generators/baseband/src/main/scala/baseband/LRWPANPacketDisassembler.scala:8:14]
  output [7:0]  io_out_data_bits,	// @[generators/baseband/src/main/scala/baseband/LRWPANPacketDisassembler.scala:8:14]
  input  [23:0] io_constants_crcSeed,	// @[generators/baseband/src/main/scala/baseband/LRWPANPacketDisassembler.scala:8:14]
  output [2:0]  io_state	// @[generators/baseband/src/main/scala/baseband/LRWPANPacketDisassembler.scala:8:14]
);

  wire [8:0]  _queue_io_count;	// @[generators/baseband/src/main/scala/baseband/LRWPANPacketDisassembler.scala:37:11]
  wire        _crc_io_out_valid;	// @[generators/baseband/src/main/scala/baseband/LRWPANPacketDisassembler.scala:29:19]
  wire [15:0] _crc_io_out_bits;	// @[generators/baseband/src/main/scala/baseband/LRWPANPacketDisassembler.scala:29:19]
  reg  [2:0]  state;	// @[generators/baseband/src/main/scala/baseband/LRWPANPacketDisassembler.scala:19:24]
  reg  [7:0]  counter;	// @[generators/baseband/src/main/scala/baseband/LRWPANPacketDisassembler.scala:20:24]
  reg         eop;	// @[generators/baseband/src/main/scala/baseband/LRWPANPacketDisassembler.scala:25:20]
  reg  [7:0]  length;	// @[generators/baseband/src/main/scala/baseband/LRWPANPacketDisassembler.scala:44:25]
  reg         flag_crc;	// @[generators/baseband/src/main/scala/baseband/LRWPANPacketDisassembler.scala:45:25]
  reg         done;	// @[generators/baseband/src/main/scala/baseband/LRWPANPacketDisassembler.scala:46:25]
  reg         busy;	// @[generators/baseband/src/main/scala/baseband/LRWPANPacketDisassembler.scala:47:25]
  wire        _GEN = state == 3'h0;	// @[generators/baseband/src/main/scala/baseband/LRWPANPacketDisassembler.scala:19:24, :61:14, :69:14]
  wire        _GEN_0 = io_in_control_valid & io_in_control_bits_command == 2'h2;	// @[generators/baseband/src/main/scala/baseband/LRWPANPacketDisassembler.scala:68:{35,66}]
  wire        _GEN_1 = state == 3'h1;	// @[generators/baseband/src/main/scala/baseband/LRWPANPacketDisassembler.scala:19:24, :66:13, :74:20]
  wire        _GEN_2 = state == 3'h2;	// @[generators/baseband/src/main/scala/baseband/LRWPANPacketDisassembler.scala:19:24, :76:16, :83:19]
  wire        _GEN_3 = state == 3'h3;	// @[generators/baseband/src/main/scala/baseband/LRWPANPacketDisassembler.scala:19:24, :83:19, :87:17]
  wire        _GEN_4 = _GEN_0 | _GEN_1;	// @[generators/baseband/src/main/scala/baseband/LRWPANPacketDisassembler.scala:20:24, :68:{35,105}, :74:{20,38}, :80:38]
  wire        _GEN_5 = _GEN | _GEN_4;	// @[generators/baseband/src/main/scala/baseband/LRWPANPacketDisassembler.scala:20:24, :61:{14,36}, :68:105, :74:38, :80:38]
  wire        _GEN_6 = state == 3'h4;	// @[generators/baseband/src/main/scala/baseband/LRWPANPacketDisassembler.scala:19:24, :83:19, :95:19]
  wire        _GEN_7 = counter == 8'h0;	// @[generators/baseband/src/main/scala/baseband/LRWPANPacketDisassembler.scala:20:24, :94:22]
  wire        _GEN_8 = state == 3'h5;	// @[generators/baseband/src/main/scala/baseband/LRWPANPacketDisassembler.scala:19:24, :103:19, :108:20]
  wire        _GEN_9 = _crc_io_out_valid & _queue_io_count == 9'h0;	// @[generators/baseband/src/main/scala/baseband/LRWPANPacketDisassembler.scala:29:19, :37:11, :115:{44,62}]
  wire        _GEN_10 = io_in_data_data_valid | ~_GEN_8;	// @[generators/baseband/src/main/scala/baseband/LRWPANPacketDisassembler.scala:45:25, :80:38, :108:{20,38}]
  always @(posedge clock) begin
    if (reset) begin
      state <= 3'h0;	// @[generators/baseband/src/main/scala/baseband/LRWPANPacketDisassembler.scala:19:24, :69:14]
      counter <= 8'h0;	// @[generators/baseband/src/main/scala/baseband/LRWPANPacketDisassembler.scala:20:24]
      eop <= 1'h0;	// @[generators/baseband/src/main/scala/baseband/LRWPANPacketDisassembler.scala:25:20]
      length <= 8'h0;	// @[generators/baseband/src/main/scala/baseband/LRWPANPacketDisassembler.scala:20:24, :44:25]
      flag_crc <= 1'h0;	// @[generators/baseband/src/main/scala/baseband/LRWPANPacketDisassembler.scala:45:25]
      done <= 1'h0;	// @[generators/baseband/src/main/scala/baseband/LRWPANPacketDisassembler.scala:46:25]
      busy <= 1'h0;	// @[generators/baseband/src/main/scala/baseband/LRWPANPacketDisassembler.scala:47:25]
    end
    else begin
      if (_GEN) begin	// @[generators/baseband/src/main/scala/baseband/LRWPANPacketDisassembler.scala:61:14]
        if (io_in_control_valid & (io_in_control_bits_command == 2'h0 | io_in_control_bits_command == 2'h1))	// @[generators/baseband/src/main/scala/baseband/LRWPANPacketDisassembler.scala:19:24, :64:{31,62,100}, :65:62]
          state <= 3'h1;	// @[generators/baseband/src/main/scala/baseband/LRWPANPacketDisassembler.scala:19:24, :66:13]
      end
      else begin	// @[generators/baseband/src/main/scala/baseband/LRWPANPacketDisassembler.scala:61:14]
        if (_GEN_0) begin	// @[generators/baseband/src/main/scala/baseband/LRWPANPacketDisassembler.scala:68:35]
          state <= 3'h0;	// @[generators/baseband/src/main/scala/baseband/LRWPANPacketDisassembler.scala:19:24, :69:14]
          length <= 8'h0;	// @[generators/baseband/src/main/scala/baseband/LRWPANPacketDisassembler.scala:20:24, :44:25]
        end
        else if (_GEN_1) begin	// @[generators/baseband/src/main/scala/baseband/LRWPANPacketDisassembler.scala:74:20]
          if (io_in_data_sop)	// @[generators/baseband/src/main/scala/baseband/LRWPANPacketDisassembler.scala:8:14]
            state <= 3'h2;	// @[generators/baseband/src/main/scala/baseband/LRWPANPacketDisassembler.scala:19:24, :76:16]
        end
        else if (io_in_data_data_valid) begin	// @[generators/baseband/src/main/scala/baseband/LRWPANPacketDisassembler.scala:8:14]
          if (_GEN_2) begin	// @[generators/baseband/src/main/scala/baseband/LRWPANPacketDisassembler.scala:83:19]
            state <= 3'h3;	// @[generators/baseband/src/main/scala/baseband/LRWPANPacketDisassembler.scala:19:24, :87:17]
            length <= {1'h0, io_in_data_data_bits[6:0]};	// @[generators/baseband/src/main/scala/baseband/LRWPANPacketDisassembler.scala:44:25, :88:{40,46}]
          end
          else if (_GEN_3) begin	// @[generators/baseband/src/main/scala/baseband/LRWPANPacketDisassembler.scala:83:19]
            if (_GEN_7)	// @[generators/baseband/src/main/scala/baseband/LRWPANPacketDisassembler.scala:94:22]
              state <= 3'h4;	// @[generators/baseband/src/main/scala/baseband/LRWPANPacketDisassembler.scala:19:24, :95:19]
          end
          else if (_GEN_6 & _GEN_7)	// @[generators/baseband/src/main/scala/baseband/LRWPANPacketDisassembler.scala:19:24, :83:19, :94:22, :102:31, :103:19]
            state <= 3'h5;	// @[generators/baseband/src/main/scala/baseband/LRWPANPacketDisassembler.scala:19:24, :103:19]
        end
        else begin	// @[generators/baseband/src/main/scala/baseband/LRWPANPacketDisassembler.scala:8:14]
          if (_GEN_8) begin	// @[generators/baseband/src/main/scala/baseband/LRWPANPacketDisassembler.scala:108:20]
            if (io_in_data_sop)	// @[generators/baseband/src/main/scala/baseband/LRWPANPacketDisassembler.scala:8:14]
              state <= 3'h2;	// @[generators/baseband/src/main/scala/baseband/LRWPANPacketDisassembler.scala:19:24, :76:16]
            else if (_GEN_9)	// @[generators/baseband/src/main/scala/baseband/LRWPANPacketDisassembler.scala:115:44]
              state <= 3'h1;	// @[generators/baseband/src/main/scala/baseband/LRWPANPacketDisassembler.scala:19:24, :66:13]
          end
          if (_GEN_8 & io_in_data_sop)	// @[generators/baseband/src/main/scala/baseband/LRWPANPacketDisassembler.scala:44:25, :108:{20,38}, :109:37, :111:16]
            length <= 8'h0;	// @[generators/baseband/src/main/scala/baseband/LRWPANPacketDisassembler.scala:20:24, :44:25]
        end
        flag_crc <= ~_GEN_0 & (_GEN_1 ? ~io_in_data_sop & flag_crc : _GEN_10 ? flag_crc : ~io_in_data_sop & (_GEN_9 ? (|_crc_io_out_bits) : flag_crc));	// @[generators/baseband/src/main/scala/baseband/LRWPANPacketDisassembler.scala:29:19, :45:25, :68:{35,105}, :71:14, :74:{20,38}, :75:37, :77:16, :80:38, :108:38, :109:37, :112:16, :115:{44,71}, :117:{16,35}]
        busy <= ~_GEN_0 & (_GEN_1 ? io_in_data_sop | busy : _GEN_10 ? busy : io_in_data_sop | ~_GEN_9 & busy);	// @[generators/baseband/src/main/scala/baseband/LRWPANPacketDisassembler.scala:45:25, :47:25, :68:{35,105}, :71:14, :73:14, :74:{20,38}, :75:37, :78:16, :80:38, :108:38, :109:37, :114:16, :115:{44,71}, :119:16]
      end
      if (_GEN_5 | ~io_in_data_data_valid) begin	// @[generators/baseband/src/main/scala/baseband/LRWPANPacketDisassembler.scala:20:24, :61:36, :68:105, :74:38, :80:38]
      end
      else if (_GEN_2)	// @[generators/baseband/src/main/scala/baseband/LRWPANPacketDisassembler.scala:83:19]
        counter <= {1'h0, io_in_data_data_bits[6:0] - 7'h3};	// @[generators/baseband/src/main/scala/baseband/LRWPANPacketDisassembler.scala:20:24, :88:{17,40,52}]
      else if (_GEN_3 & _GEN_7)	// @[generators/baseband/src/main/scala/baseband/LRWPANPacketDisassembler.scala:81:13, :83:19, :94:{22,31}, :96:19]
        counter <= 8'h1;	// @[generators/baseband/src/main/scala/baseband/LRWPANPacketDisassembler.scala:20:24, :96:19]
      else	// @[generators/baseband/src/main/scala/baseband/LRWPANPacketDisassembler.scala:81:13, :83:19, :94:31, :96:19]
        counter <= counter - 8'h1;	// @[generators/baseband/src/main/scala/baseband/LRWPANPacketDisassembler.scala:20:24, :81:24]
      eop <= _GEN | ~_GEN_4 & io_in_data_data_valid & ~(_GEN_2 | _GEN_3) & _GEN_6 & _GEN_7;	// @[generators/baseband/src/main/scala/baseband/LRWPANPacketDisassembler.scala:20:24, :25:20, :56:8, :61:{14,36}, :62:9, :68:105, :74:38, :80:38, :83:19, :94:22]
      done <= ~_GEN & (_GEN_0 | ~(_GEN_1 | io_in_data_data_valid) & _GEN_8 & (io_in_data_sop | _GEN_9));	// @[generators/baseband/src/main/scala/baseband/LRWPANPacketDisassembler.scala:46:25, :57:8, :61:{14,36}, :68:{35,105}, :72:14, :74:{20,38}, :80:38, :108:{20,38}, :109:37, :113:16, :115:{44,71}]
    end
  end // always @(posedge)
  `ifdef ENABLE_INITIAL_REG_
    `ifdef FIRRTL_BEFORE_INITIAL
      `FIRRTL_BEFORE_INITIAL
    `endif // FIRRTL_BEFORE_INITIAL
    logic [31:0] _RANDOM[0:0];
    initial begin
      `ifdef INIT_RANDOM_PROLOG_
        `INIT_RANDOM_PROLOG_
      `endif // INIT_RANDOM_PROLOG_
      `ifdef RANDOMIZE_REG_INIT
        _RANDOM[/*Zero width*/ 1'b0] = `RANDOM;
        state = _RANDOM[/*Zero width*/ 1'b0][2:0];	// @[generators/baseband/src/main/scala/baseband/LRWPANPacketDisassembler.scala:19:24]
        counter = _RANDOM[/*Zero width*/ 1'b0][10:3];	// @[generators/baseband/src/main/scala/baseband/LRWPANPacketDisassembler.scala:19:24, :20:24]
        eop = _RANDOM[/*Zero width*/ 1'b0][11];	// @[generators/baseband/src/main/scala/baseband/LRWPANPacketDisassembler.scala:19:24, :25:20]
        length = _RANDOM[/*Zero width*/ 1'b0][19:12];	// @[generators/baseband/src/main/scala/baseband/LRWPANPacketDisassembler.scala:19:24, :44:25]
        flag_crc = _RANDOM[/*Zero width*/ 1'b0][20];	// @[generators/baseband/src/main/scala/baseband/LRWPANPacketDisassembler.scala:19:24, :45:25]
        done = _RANDOM[/*Zero width*/ 1'b0][21];	// @[generators/baseband/src/main/scala/baseband/LRWPANPacketDisassembler.scala:19:24, :46:25]
        busy = _RANDOM[/*Zero width*/ 1'b0][22];	// @[generators/baseband/src/main/scala/baseband/LRWPANPacketDisassembler.scala:19:24, :47:25]
      `endif // RANDOMIZE_REG_INIT
    end // initial
    `ifdef FIRRTL_AFTER_INITIAL
      `FIRRTL_AFTER_INITIAL
    `endif // FIRRTL_AFTER_INITIAL
  `endif // ENABLE_INITIAL_REG_
  CRCBytes_1 crc (	// @[generators/baseband/src/main/scala/baseband/LRWPANPacketDisassembler.scala:29:19]
    .clock         (clock),
    .reset         (reset),
    .io_in_valid   (~_GEN_5 & io_in_data_data_valid & ~_GEN_2 & (_GEN_3 | _GEN_6)),	// @[generators/baseband/src/main/scala/baseband/LRWPANPacketDisassembler.scala:20:24, :58:19, :61:36, :68:105, :74:38, :80:38, :83:19, :85:25, :93:25]
    .io_in_bits    (io_in_data_data_bits),
    .io_out_valid  (_crc_io_out_valid),
    .io_out_bits   (_crc_io_out_bits),
    .io_seed_valid (io_in_data_sop),
    .io_seed_bits  (io_constants_crcSeed[15:0])	// @[generators/baseband/src/main/scala/baseband/LRWPANPacketDisassembler.scala:31:21]
  );
  Queue_23 queue (	// @[generators/baseband/src/main/scala/baseband/LRWPANPacketDisassembler.scala:37:11]
    .clock        (clock),
    .reset        (reset | io_in_data_sop),	// @[generators/baseband/src/main/scala/baseband/LRWPANPacketDisassembler.scala:36:38]
    .io_enq_ready (/* unused */),
    .io_enq_valid (io_in_data_data_valid),
    .io_enq_bits  (io_in_data_data_bits),
    .io_deq_ready (io_out_data_ready),
    .io_deq_valid (io_out_data_valid),
    .io_deq_bits  (io_out_data_bits),
    .io_count     (_queue_io_count)
  );
  assign io_in_data_eop = eop;	// @[generators/baseband/src/main/scala/baseband/LRWPANPacketDisassembler.scala:25:20]
  assign io_out_control_length = length;	// @[generators/baseband/src/main/scala/baseband/LRWPANPacketDisassembler.scala:44:25]
  assign io_out_control_flag_crc = flag_crc;	// @[generators/baseband/src/main/scala/baseband/LRWPANPacketDisassembler.scala:45:25]
  assign io_out_control_done = done;	// @[generators/baseband/src/main/scala/baseband/LRWPANPacketDisassembler.scala:46:25]
  assign io_out_control_busy = busy;	// @[generators/baseband/src/main/scala/baseband/LRWPANPacketDisassembler.scala:47:25]
  assign io_state = state;	// @[generators/baseband/src/main/scala/baseband/LRWPANPacketDisassembler.scala:19:24]
endmodule

