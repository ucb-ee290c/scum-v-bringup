// Generated by CIRCT unknown git version
// Standard header to adapt well known macros for register randomization.
`ifndef RANDOMIZE
  `ifdef RANDOMIZE_MEM_INIT
    `define RANDOMIZE
  `endif // RANDOMIZE_MEM_INIT
`endif // not def RANDOMIZE
`ifndef RANDOMIZE
  `ifdef RANDOMIZE_REG_INIT
    `define RANDOMIZE
  `endif // RANDOMIZE_REG_INIT
`endif // not def RANDOMIZE

// RANDOM may be set to an expression that produces a 32-bit random unsigned value.
`ifndef RANDOM
  `define RANDOM $random
`endif // not def RANDOM

// Users can define INIT_RANDOM as general code that gets injected into the
// initializer block for modules with registers.
`ifndef INIT_RANDOM
  `define INIT_RANDOM
`endif // not def INIT_RANDOM

// If using random initialization, you can also define RANDOMIZE_DELAY to
// customize the delay used, otherwise 0.002 is used.
`ifndef RANDOMIZE_DELAY
  `define RANDOMIZE_DELAY 0.002
`endif // not def RANDOMIZE_DELAY

// Define INIT_RANDOM_PROLOG_ for use in our modules below.
`ifndef INIT_RANDOM_PROLOG_
  `ifdef RANDOMIZE
    `ifdef VERILATOR
      `define INIT_RANDOM_PROLOG_ `INIT_RANDOM
    `else  // VERILATOR
      `define INIT_RANDOM_PROLOG_ `INIT_RANDOM #`RANDOMIZE_DELAY begin end
    `endif // VERILATOR
  `else  // RANDOMIZE
    `define INIT_RANDOM_PROLOG_
  `endif // RANDOMIZE
`endif // not def INIT_RANDOM_PROLOG_

// Include register initializers in init blocks unless synthesis is set
`ifndef SYNTHESIS
  `ifndef ENABLE_INITIAL_REG_
    `define ENABLE_INITIAL_REG_
  `endif // not def ENABLE_INITIAL_REG_
`endif // not def SYNTHESIS

// Include rmemory initializers in init blocks unless synthesis is set
`ifndef SYNTHESIS
  `ifndef ENABLE_INITIAL_MEM_
    `define ENABLE_INITIAL_MEM_
  `endif // not def ENABLE_INITIAL_MEM_
`endif // not def SYNTHESIS

// Standard header to adapt well known macros for prints and assertions.

// Users can define 'PRINTF_COND' to add an extra gate to prints.
`ifndef PRINTF_COND_
  `ifdef PRINTF_COND
    `define PRINTF_COND_ (`PRINTF_COND)
  `else  // PRINTF_COND
    `define PRINTF_COND_ 1
  `endif // PRINTF_COND
`endif // not def PRINTF_COND_

// Users can define 'ASSERT_VERBOSE_COND' to add an extra gate to assert error printing.
`ifndef ASSERT_VERBOSE_COND_
  `ifdef ASSERT_VERBOSE_COND
    `define ASSERT_VERBOSE_COND_ (`ASSERT_VERBOSE_COND)
  `else  // ASSERT_VERBOSE_COND
    `define ASSERT_VERBOSE_COND_ 1
  `endif // ASSERT_VERBOSE_COND
`endif // not def ASSERT_VERBOSE_COND_

// Users can define 'STOP_COND' to add an extra gate to stop conditions.
`ifndef STOP_COND_
  `ifdef STOP_COND
    `define STOP_COND_ (`STOP_COND)
  `else  // STOP_COND
    `define STOP_COND_ 1
  `endif // STOP_COND
`endif // not def STOP_COND_

module MulDiv(
  input         clock,
                reset,
  output        io_req_ready,	// @[generators/rocket-chip/src/main/scala/rocket/Multiplier.scala:43:14]
  input         io_req_valid,	// @[generators/rocket-chip/src/main/scala/rocket/Multiplier.scala:43:14]
  input  [3:0]  io_req_bits_fn,	// @[generators/rocket-chip/src/main/scala/rocket/Multiplier.scala:43:14]
  input  [31:0] io_req_bits_in1,	// @[generators/rocket-chip/src/main/scala/rocket/Multiplier.scala:43:14]
                io_req_bits_in2,	// @[generators/rocket-chip/src/main/scala/rocket/Multiplier.scala:43:14]
  input  [4:0]  io_req_bits_tag,	// @[generators/rocket-chip/src/main/scala/rocket/Multiplier.scala:43:14]
  input         io_kill,	// @[generators/rocket-chip/src/main/scala/rocket/Multiplier.scala:43:14]
                io_resp_ready,	// @[generators/rocket-chip/src/main/scala/rocket/Multiplier.scala:43:14]
  output        io_resp_valid,	// @[generators/rocket-chip/src/main/scala/rocket/Multiplier.scala:43:14]
  output [31:0] io_resp_bits_data,	// @[generators/rocket-chip/src/main/scala/rocket/Multiplier.scala:43:14]
  output [4:0]  io_resp_bits_tag	// @[generators/rocket-chip/src/main/scala/rocket/Multiplier.scala:43:14]
);

  reg  [2:0]  state;	// @[generators/rocket-chip/src/main/scala/rocket/Multiplier.scala:49:22]
  reg  [4:0]  req_tag;	// @[generators/rocket-chip/src/main/scala/rocket/Multiplier.scala:51:16]
  reg  [5:0]  count;	// @[generators/rocket-chip/src/main/scala/rocket/Multiplier.scala:52:18]
  reg         neg_out;	// @[generators/rocket-chip/src/main/scala/rocket/Multiplier.scala:55:20]
  reg         isHi;	// @[generators/rocket-chip/src/main/scala/rocket/Multiplier.scala:56:17]
  reg         resHi;	// @[generators/rocket-chip/src/main/scala/rocket/Multiplier.scala:57:18]
  reg  [32:0] divisor;	// @[generators/rocket-chip/src/main/scala/rocket/Multiplier.scala:58:20]
  reg  [65:0] remainder;	// @[generators/rocket-chip/src/main/scala/rocket/Multiplier.scala:59:22]
  wire [31:0] io_resp_bits_data_0 = resHi ? remainder[64:33] : remainder[31:0];	// @[generators/rocket-chip/src/main/scala/rocket/Multiplier.scala:57:18, :59:22, :87:{19,36,57}]
  wire        io_resp_valid_0 = state == 3'h6 | (&state);	// @[generators/rocket-chip/src/main/scala/rocket/Multiplier.scala:49:22, :180:{27,42,51}]
  wire        io_req_ready_0 = state == 3'h0;	// @[generators/rocket-chip/src/main/scala/rocket/Multiplier.scala:49:22, :181:25]
  wire [40:0] _prod_T_4 = {{33{remainder[32]}}, remainder[7:0]} * {{8{divisor[32]}}, divisor} + {{8{remainder[65]}}, remainder[65:33]};	// @[generators/rocket-chip/src/main/scala/rocket/Multiplier.scala:58:20, :59:22, :105:31, :106:31, :107:24, :110:{38,67,76}]
  wire [32:0] _subtractor_T_1 = remainder[64:32] - divisor;	// @[generators/rocket-chip/src/main/scala/rocket/Multiplier.scala:58:20, :59:22, :86:{29,37}]
  wire [2:0]  decoded_invInputs = ~(io_req_bits_fn[2:0]);	// @[src/main/scala/chisel3/util/experimental/decode/decoder.scala:39:16, src/main/scala/chisel3/util/pla.scala:78:21]
  wire [1:0]  _decoded_T_2 = {decoded_invInputs[1], decoded_invInputs[2]};	// @[src/main/scala/chisel3/util/pla.scala:78:21, :91:29, :98:53]
  wire        lhs_sign = (|{decoded_invInputs[0], &_decoded_T_2}) & io_req_bits_in1[31];	// @[generators/rocket-chip/src/main/scala/rocket/Multiplier.scala:79:{23,48}, src/main/scala/chisel3/util/pla.scala:78:21, :91:29, :98:{53,70}, :114:{19,36}]
  wire        rhs_sign = (|{&_decoded_T_2, &{decoded_invInputs[0], io_req_bits_fn[2]}}) & io_req_bits_in2[31];	// @[generators/rocket-chip/src/main/scala/rocket/Multiplier.scala:79:{23,48}, src/main/scala/chisel3/util/pla.scala:78:21, :90:45, :91:29, :98:{53,70}, :114:{19,36}]
  wire        _GEN = state == 3'h1;	// @[generators/rocket-chip/src/main/scala/rocket/Multiplier.scala:49:22, :90:39]
  wire        _GEN_0 = state == 3'h5;	// @[generators/rocket-chip/src/main/scala/rocket/Multiplier.scala:49:22, :99:39]
  wire        _GEN_1 = state == 3'h2;	// @[generators/rocket-chip/src/main/scala/rocket/Multiplier.scala:49:22, :104:39]
  wire        _GEN_2 = _GEN_1 & count == 6'h3;	// @[generators/rocket-chip/src/main/scala/rocket/Multiplier.scala:52:18, :99:57, :104:{39,50}, :122:{25,55}, :123:13]
  wire        _GEN_3 = state == 3'h3;	// @[generators/rocket-chip/src/main/scala/rocket/Multiplier.scala:49:22, :127:39]
  wire        _GEN_4 = count == 6'h20;	// @[generators/rocket-chip/src/main/scala/rocket/Multiplier.scala:52:18, :117:38, :136:17]
  wire        _GEN_5 = io_req_ready_0 & io_req_valid;	// @[generators/rocket-chip/src/main/scala/rocket/Multiplier.scala:181:25, src/main/scala/chisel3/util/Decoupled.scala:52:35]
  wire [1:0]  _decoded_orMatrixOutputs_T_4 = {&{io_req_bits_fn[0], decoded_invInputs[2]}, io_req_bits_fn[1]};	// @[src/main/scala/chisel3/util/pla.scala:78:21, :90:45, :91:29, :98:{53,70}, :114:19]
  always @(posedge clock) begin
    if (reset)
      state <= 3'h0;	// @[generators/rocket-chip/src/main/scala/rocket/Multiplier.scala:49:22]
    else if (_GEN_5)	// @[src/main/scala/chisel3/util/Decoupled.scala:52:35]
      state <= decoded_invInputs[2] ? 3'h2 : {1'h0, ~(lhs_sign | rhs_sign), 1'h1};	// @[generators/rocket-chip/src/main/scala/rocket/Multiplier.scala:49:22, :51:16, :79:23, :121:20, :163:{17,36,46}, src/main/scala/chisel3/util/pla.scala:78:21, :91:29]
    else if (io_resp_ready & io_resp_valid_0 | io_kill)	// @[generators/rocket-chip/src/main/scala/rocket/Multiplier.scala:159:22, :180:42, src/main/scala/chisel3/util/Decoupled.scala:52:35]
      state <= 3'h0;	// @[generators/rocket-chip/src/main/scala/rocket/Multiplier.scala:49:22]
    else if (_GEN_3 & _GEN_4)	// @[generators/rocket-chip/src/main/scala/rocket/Multiplier.scala:104:50, :127:{39,50}, :136:{17,42}, :137:13]
      state <= {1'h1, ~neg_out, 1'h1};	// @[generators/rocket-chip/src/main/scala/rocket/Multiplier.scala:49:22, :55:20, :121:20, :137:19]
    else if (_GEN_2)	// @[generators/rocket-chip/src/main/scala/rocket/Multiplier.scala:99:57, :104:50, :122:55, :123:13]
      state <= 3'h6;	// @[generators/rocket-chip/src/main/scala/rocket/Multiplier.scala:49:22]
    else if (_GEN_0)	// @[generators/rocket-chip/src/main/scala/rocket/Multiplier.scala:99:39]
      state <= 3'h7;	// @[generators/rocket-chip/src/main/scala/rocket/Multiplier.scala:49:22, :101:11]
    else if (_GEN)	// @[generators/rocket-chip/src/main/scala/rocket/Multiplier.scala:90:39]
      state <= 3'h3;	// @[generators/rocket-chip/src/main/scala/rocket/Multiplier.scala:49:22]
    if (_GEN_5) begin	// @[src/main/scala/chisel3/util/Decoupled.scala:52:35]
      req_tag <= io_req_bits_tag;	// @[generators/rocket-chip/src/main/scala/rocket/Multiplier.scala:51:16]
      count <= 6'h0;	// @[generators/rocket-chip/src/main/scala/rocket/Multiplier.scala:52:18, :166:11]
      neg_out <= (|_decoded_orMatrixOutputs_T_4) ? lhs_sign : lhs_sign != rhs_sign;	// @[generators/rocket-chip/src/main/scala/rocket/Multiplier.scala:55:20, :79:23, :167:{19,46}, src/main/scala/chisel3/util/pla.scala:114:{19,36}]
      isHi <= |_decoded_orMatrixOutputs_T_4;	// @[generators/rocket-chip/src/main/scala/rocket/Multiplier.scala:56:17, src/main/scala/chisel3/util/pla.scala:114:{19,36}]
      divisor <= {rhs_sign, io_req_bits_in2};	// @[generators/rocket-chip/src/main/scala/rocket/Multiplier.scala:58:20, :79:23, :168:19]
      remainder <= {34'h0, io_req_bits_in1};	// @[generators/rocket-chip/src/main/scala/rocket/Multiplier.scala:59:22, :92:17, :169:15]
    end
    else begin	// @[src/main/scala/chisel3/util/Decoupled.scala:52:35]
      if (_GEN_3) begin	// @[generators/rocket-chip/src/main/scala/rocket/Multiplier.scala:127:39]
        count <= count + 6'h1;	// @[generators/rocket-chip/src/main/scala/rocket/Multiplier.scala:52:18, :121:20, :142:20]
        remainder <= {1'h0, _subtractor_T_1[32] ? remainder[63:32] : _subtractor_T_1[31:0], remainder[31:0], ~(_subtractor_T_1[32])};	// @[generators/rocket-chip/src/main/scala/rocket/Multiplier.scala:51:16, :59:22, :86:37, :87:57, :131:28, :132:{14,24,45,67}, :135:15]
      end
      else if (_GEN_1) begin	// @[generators/rocket-chip/src/main/scala/rocket/Multiplier.scala:104:39]
        count <= count + 6'h1;	// @[generators/rocket-chip/src/main/scala/rocket/Multiplier.scala:52:18, :121:20]
        remainder <= {_prod_T_4[40:8], count == 6'h2 & neg_out, _prod_T_4[7:0], remainder[31:8]};	// @[generators/rocket-chip/src/main/scala/rocket/Multiplier.scala:52:18, :55:20, :59:22, :107:24, :110:76, :111:38, :112:{32,61}, :118:26, :119:{21,34,67}]
      end
      else if (_GEN_0 | _GEN & remainder[31])	// @[generators/rocket-chip/src/main/scala/rocket/Multiplier.scala:59:22, :90:{39,57}, :91:{20,27}, :92:17, :99:{39,57}, :100:15]
        remainder <= {34'h0, 32'h0 - io_resp_bits_data_0};	// @[generators/rocket-chip/src/main/scala/rocket/Multiplier.scala:51:16, :59:22, :87:19, :88:27, :92:17]
      neg_out <= ~(_GEN_3 & count == 6'h0 & ~(_subtractor_T_1[32]) & ~isHi) & neg_out;	// @[generators/rocket-chip/src/main/scala/rocket/Multiplier.scala:52:18, :55:20, :56:17, :86:37, :127:{39,50}, :131:28, :144:{24,35}, :157:{21,28,38}, :166:11]
      if (_GEN & divisor[31])	// @[generators/rocket-chip/src/main/scala/rocket/Multiplier.scala:58:20, :90:{39,57}, :94:{18,25}, :95:15]
        divisor <= _subtractor_T_1;	// @[generators/rocket-chip/src/main/scala/rocket/Multiplier.scala:58:20, :86:37]
    end
    resHi <= ~_GEN_5 & (_GEN_3 & _GEN_4 | _GEN_2 ? isHi : ~_GEN_0 & resHi);	// @[generators/rocket-chip/src/main/scala/rocket/Multiplier.scala:56:17, :57:18, :99:{39,57}, :102:11, :104:50, :122:55, :123:13, :124:13, :127:{39,50}, :136:{17,42}, :138:13, :162:22, :165:11, src/main/scala/chisel3/util/Decoupled.scala:52:35]
  end // always @(posedge)
  `ifdef ENABLE_INITIAL_REG_
    `ifdef FIRRTL_BEFORE_INITIAL
      `FIRRTL_BEFORE_INITIAL
    `endif // FIRRTL_BEFORE_INITIAL
    logic [31:0] _RANDOM[0:5];
    initial begin
      `ifdef INIT_RANDOM_PROLOG_
        `INIT_RANDOM_PROLOG_
      `endif // INIT_RANDOM_PROLOG_
      `ifdef RANDOMIZE_REG_INIT
        for (logic [2:0] i = 3'h0; i < 3'h6; i += 3'h1) begin
          _RANDOM[i] = `RANDOM;
        end
        state = _RANDOM[3'h0][2:0];	// @[generators/rocket-chip/src/main/scala/rocket/Multiplier.scala:49:22]
        req_tag = _RANDOM[3'h2][12:8];	// @[generators/rocket-chip/src/main/scala/rocket/Multiplier.scala:51:16]
        count = _RANDOM[3'h2][18:13];	// @[generators/rocket-chip/src/main/scala/rocket/Multiplier.scala:51:16, :52:18]
        neg_out = _RANDOM[3'h2][19];	// @[generators/rocket-chip/src/main/scala/rocket/Multiplier.scala:51:16, :55:20]
        isHi = _RANDOM[3'h2][20];	// @[generators/rocket-chip/src/main/scala/rocket/Multiplier.scala:51:16, :56:17]
        resHi = _RANDOM[3'h2][21];	// @[generators/rocket-chip/src/main/scala/rocket/Multiplier.scala:51:16, :57:18]
        divisor = {_RANDOM[3'h2][31:22], _RANDOM[3'h3][22:0]};	// @[generators/rocket-chip/src/main/scala/rocket/Multiplier.scala:51:16, :58:20]
        remainder = {_RANDOM[3'h3][31:23], _RANDOM[3'h4], _RANDOM[3'h5][24:0]};	// @[generators/rocket-chip/src/main/scala/rocket/Multiplier.scala:58:20, :59:22]
      `endif // RANDOMIZE_REG_INIT
    end // initial
    `ifdef FIRRTL_AFTER_INITIAL
      `FIRRTL_AFTER_INITIAL
    `endif // FIRRTL_AFTER_INITIAL
  `endif // ENABLE_INITIAL_REG_
  assign io_req_ready = io_req_ready_0;	// @[generators/rocket-chip/src/main/scala/rocket/Multiplier.scala:181:25]
  assign io_resp_valid = io_resp_valid_0;	// @[generators/rocket-chip/src/main/scala/rocket/Multiplier.scala:180:42]
  assign io_resp_bits_data = io_resp_bits_data_0;	// @[generators/rocket-chip/src/main/scala/rocket/Multiplier.scala:87:19]
  assign io_resp_bits_tag = req_tag;	// @[generators/rocket-chip/src/main/scala/rocket/Multiplier.scala:51:16]
endmodule

