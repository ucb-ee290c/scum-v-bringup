// Generated by CIRCT unknown git version
// Standard header to adapt well known macros for register randomization.
`ifndef RANDOMIZE
  `ifdef RANDOMIZE_MEM_INIT
    `define RANDOMIZE
  `endif // RANDOMIZE_MEM_INIT
`endif // not def RANDOMIZE
`ifndef RANDOMIZE
  `ifdef RANDOMIZE_REG_INIT
    `define RANDOMIZE
  `endif // RANDOMIZE_REG_INIT
`endif // not def RANDOMIZE

// RANDOM may be set to an expression that produces a 32-bit random unsigned value.
`ifndef RANDOM
  `define RANDOM $random
`endif // not def RANDOM

// Users can define INIT_RANDOM as general code that gets injected into the
// initializer block for modules with registers.
`ifndef INIT_RANDOM
  `define INIT_RANDOM
`endif // not def INIT_RANDOM

// If using random initialization, you can also define RANDOMIZE_DELAY to
// customize the delay used, otherwise 0.002 is used.
`ifndef RANDOMIZE_DELAY
  `define RANDOMIZE_DELAY 0.002
`endif // not def RANDOMIZE_DELAY

// Define INIT_RANDOM_PROLOG_ for use in our modules below.
`ifndef INIT_RANDOM_PROLOG_
  `ifdef RANDOMIZE
    `ifdef VERILATOR
      `define INIT_RANDOM_PROLOG_ `INIT_RANDOM
    `else  // VERILATOR
      `define INIT_RANDOM_PROLOG_ `INIT_RANDOM #`RANDOMIZE_DELAY begin end
    `endif // VERILATOR
  `else  // RANDOMIZE
    `define INIT_RANDOM_PROLOG_
  `endif // RANDOMIZE
`endif // not def INIT_RANDOM_PROLOG_

// Include register initializers in init blocks unless synthesis is set
`ifndef SYNTHESIS
  `ifndef ENABLE_INITIAL_REG_
    `define ENABLE_INITIAL_REG_
  `endif // not def ENABLE_INITIAL_REG_
`endif // not def SYNTHESIS

// Include rmemory initializers in init blocks unless synthesis is set
`ifndef SYNTHESIS
  `ifndef ENABLE_INITIAL_MEM_
    `define ENABLE_INITIAL_MEM_
  `endif // not def ENABLE_INITIAL_MEM_
`endif // not def SYNTHESIS

// Standard header to adapt well known macros for prints and assertions.

// Users can define 'PRINTF_COND' to add an extra gate to prints.
`ifndef PRINTF_COND_
  `ifdef PRINTF_COND
    `define PRINTF_COND_ (`PRINTF_COND)
  `else  // PRINTF_COND
    `define PRINTF_COND_ 1
  `endif // PRINTF_COND
`endif // not def PRINTF_COND_

// Users can define 'ASSERT_VERBOSE_COND' to add an extra gate to assert error printing.
`ifndef ASSERT_VERBOSE_COND_
  `ifdef ASSERT_VERBOSE_COND
    `define ASSERT_VERBOSE_COND_ (`ASSERT_VERBOSE_COND)
  `else  // ASSERT_VERBOSE_COND
    `define ASSERT_VERBOSE_COND_ 1
  `endif // ASSERT_VERBOSE_COND
`endif // not def ASSERT_VERBOSE_COND_

// Users can define 'STOP_COND' to add an extra gate to stop conditions.
`ifndef STOP_COND_
  `ifdef STOP_COND
    `define STOP_COND_ (`STOP_COND)
  `else  // STOP_COND
    `define STOP_COND_ 1
  `endif // STOP_COND
`endif // not def STOP_COND_

module CSRFile(
  input         clock,
                reset,
                io_ungated_clock,	// @[generators/rocket-chip/src/main/scala/rocket/CSR.scala:383:14]
                io_interrupts_debug,	// @[generators/rocket-chip/src/main/scala/rocket/CSR.scala:383:14]
                io_interrupts_mtip,	// @[generators/rocket-chip/src/main/scala/rocket/CSR.scala:383:14]
                io_interrupts_msip,	// @[generators/rocket-chip/src/main/scala/rocket/CSR.scala:383:14]
                io_interrupts_meip,	// @[generators/rocket-chip/src/main/scala/rocket/CSR.scala:383:14]
                io_hartid,	// @[generators/rocket-chip/src/main/scala/rocket/CSR.scala:383:14]
  input  [11:0] io_rw_addr,	// @[generators/rocket-chip/src/main/scala/rocket/CSR.scala:383:14]
  input  [2:0]  io_rw_cmd,	// @[generators/rocket-chip/src/main/scala/rocket/CSR.scala:383:14]
  output [31:0] io_rw_rdata,	// @[generators/rocket-chip/src/main/scala/rocket/CSR.scala:383:14]
  input  [31:0] io_rw_wdata,	// @[generators/rocket-chip/src/main/scala/rocket/CSR.scala:383:14]
                io_decode_0_inst,	// @[generators/rocket-chip/src/main/scala/rocket/CSR.scala:383:14]
  output        io_decode_0_read_illegal,	// @[generators/rocket-chip/src/main/scala/rocket/CSR.scala:383:14]
                io_decode_0_write_illegal,	// @[generators/rocket-chip/src/main/scala/rocket/CSR.scala:383:14]
                io_decode_0_write_flush,	// @[generators/rocket-chip/src/main/scala/rocket/CSR.scala:383:14]
                io_decode_0_system_illegal,	// @[generators/rocket-chip/src/main/scala/rocket/CSR.scala:383:14]
                io_decode_0_virtual_access_illegal,	// @[generators/rocket-chip/src/main/scala/rocket/CSR.scala:383:14]
                io_decode_0_virtual_system_illegal,	// @[generators/rocket-chip/src/main/scala/rocket/CSR.scala:383:14]
                io_csr_stall,	// @[generators/rocket-chip/src/main/scala/rocket/CSR.scala:383:14]
                io_eret,	// @[generators/rocket-chip/src/main/scala/rocket/CSR.scala:383:14]
                io_singleStep,	// @[generators/rocket-chip/src/main/scala/rocket/CSR.scala:383:14]
                io_status_debug,	// @[generators/rocket-chip/src/main/scala/rocket/CSR.scala:383:14]
                io_status_wfi,	// @[generators/rocket-chip/src/main/scala/rocket/CSR.scala:383:14]
  output [31:0] io_status_isa,	// @[generators/rocket-chip/src/main/scala/rocket/CSR.scala:383:14]
  output        io_status_dv,	// @[generators/rocket-chip/src/main/scala/rocket/CSR.scala:383:14]
                io_status_v,	// @[generators/rocket-chip/src/main/scala/rocket/CSR.scala:383:14]
  output [31:0] io_evec,	// @[generators/rocket-chip/src/main/scala/rocket/CSR.scala:383:14]
  input         io_exception,	// @[generators/rocket-chip/src/main/scala/rocket/CSR.scala:383:14]
                io_retire,	// @[generators/rocket-chip/src/main/scala/rocket/CSR.scala:383:14]
  input  [31:0] io_cause,	// @[generators/rocket-chip/src/main/scala/rocket/CSR.scala:383:14]
                io_pc,	// @[generators/rocket-chip/src/main/scala/rocket/CSR.scala:383:14]
                io_tval,	// @[generators/rocket-chip/src/main/scala/rocket/CSR.scala:383:14]
  input         io_gva,	// @[generators/rocket-chip/src/main/scala/rocket/CSR.scala:383:14]
  output [31:0] io_time,	// @[generators/rocket-chip/src/main/scala/rocket/CSR.scala:383:14]
  output        io_interrupt,	// @[generators/rocket-chip/src/main/scala/rocket/CSR.scala:383:14]
  output [31:0] io_interrupt_cause,	// @[generators/rocket-chip/src/main/scala/rocket/CSR.scala:383:14]
  output        io_bp_0_control_action,	// @[generators/rocket-chip/src/main/scala/rocket/CSR.scala:383:14]
  output [1:0]  io_bp_0_control_tmatch,	// @[generators/rocket-chip/src/main/scala/rocket/CSR.scala:383:14]
  output        io_bp_0_control_x,	// @[generators/rocket-chip/src/main/scala/rocket/CSR.scala:383:14]
                io_bp_0_control_w,	// @[generators/rocket-chip/src/main/scala/rocket/CSR.scala:383:14]
                io_bp_0_control_r,	// @[generators/rocket-chip/src/main/scala/rocket/CSR.scala:383:14]
  output [31:0] io_bp_0_address,	// @[generators/rocket-chip/src/main/scala/rocket/CSR.scala:383:14]
  output        io_inhibit_cycle,	// @[generators/rocket-chip/src/main/scala/rocket/CSR.scala:383:14]
  input  [31:0] io_inst_0,	// @[generators/rocket-chip/src/main/scala/rocket/CSR.scala:383:14]
  output        io_trace_0_valid,	// @[generators/rocket-chip/src/main/scala/rocket/CSR.scala:383:14]
  output [31:0] io_trace_0_iaddr,	// @[generators/rocket-chip/src/main/scala/rocket/CSR.scala:383:14]
                io_trace_0_insn,	// @[generators/rocket-chip/src/main/scala/rocket/CSR.scala:383:14]
  output        io_trace_0_exception,	// @[generators/rocket-chip/src/main/scala/rocket/CSR.scala:383:14]
  output [31:0] io_customCSRs_0_value	// @[generators/rocket-chip/src/main/scala/rocket/CSR.scala:383:14]
);

  wire [31:0] io_rw_rdata_0;	// @[src/main/scala/chisel3/util/Mux.scala:30:73]
  reg         io_status_cease_r;	// @[generators/rocket-chip/src/main/scala/rocket/CSR.scala:1152:31]
  wire        io_singleStep_0;	// @[generators/rocket-chip/src/main/scala/rocket/CSR.scala:993:34]
  reg         reg_mstatus_v;	// @[generators/rocket-chip/src/main/scala/rocket/CSR.scala:394:28]
  reg         reg_mstatus_mpv;	// @[generators/rocket-chip/src/main/scala/rocket/CSR.scala:394:28]
  reg         reg_mstatus_gva;	// @[generators/rocket-chip/src/main/scala/rocket/CSR.scala:394:28]
  reg  [1:0]  reg_mstatus_mpp;	// @[generators/rocket-chip/src/main/scala/rocket/CSR.scala:394:28]
  reg         reg_mstatus_mpie;	// @[generators/rocket-chip/src/main/scala/rocket/CSR.scala:394:28]
  reg         reg_mstatus_mie;	// @[generators/rocket-chip/src/main/scala/rocket/CSR.scala:394:28]
  reg         reg_dcsr_ebreakm;	// @[generators/rocket-chip/src/main/scala/rocket/CSR.scala:402:25]
  reg  [2:0]  reg_dcsr_cause;	// @[generators/rocket-chip/src/main/scala/rocket/CSR.scala:402:25]
  reg         reg_dcsr_v;	// @[generators/rocket-chip/src/main/scala/rocket/CSR.scala:402:25]
  reg         reg_dcsr_step;	// @[generators/rocket-chip/src/main/scala/rocket/CSR.scala:402:25]
  reg         reg_debug;	// @[generators/rocket-chip/src/main/scala/rocket/CSR.scala:481:26]
  reg  [31:0] reg_dpc;	// @[generators/rocket-chip/src/main/scala/rocket/CSR.scala:482:20]
  reg  [31:0] reg_dscratch0;	// @[generators/rocket-chip/src/main/scala/rocket/CSR.scala:483:26]
  reg         reg_singleStepped;	// @[generators/rocket-chip/src/main/scala/rocket/CSR.scala:485:30]
  reg         reg_bp_0_control_dmode;	// @[generators/rocket-chip/src/main/scala/rocket/CSR.scala:491:19]
  reg         reg_bp_0_control_action;	// @[generators/rocket-chip/src/main/scala/rocket/CSR.scala:491:19]
  reg  [1:0]  reg_bp_0_control_tmatch;	// @[generators/rocket-chip/src/main/scala/rocket/CSR.scala:491:19]
  reg         reg_bp_0_control_x;	// @[generators/rocket-chip/src/main/scala/rocket/CSR.scala:491:19]
  reg         reg_bp_0_control_w;	// @[generators/rocket-chip/src/main/scala/rocket/CSR.scala:491:19]
  reg         reg_bp_0_control_r;	// @[generators/rocket-chip/src/main/scala/rocket/CSR.scala:491:19]
  reg  [31:0] reg_bp_0_address;	// @[generators/rocket-chip/src/main/scala/rocket/CSR.scala:491:19]
  reg  [31:0] reg_mie;	// @[generators/rocket-chip/src/main/scala/rocket/CSR.scala:494:20]
  reg  [31:0] reg_mepc;	// @[generators/rocket-chip/src/main/scala/rocket/CSR.scala:504:21]
  reg  [31:0] reg_mcause;	// @[generators/rocket-chip/src/main/scala/rocket/CSR.scala:505:27]
  reg  [31:0] reg_mtval;	// @[generators/rocket-chip/src/main/scala/rocket/CSR.scala:506:22]
  reg  [31:0] reg_mscratch;	// @[generators/rocket-chip/src/main/scala/rocket/CSR.scala:508:25]
  reg  [31:0] reg_mtvec;	// @[generators/rocket-chip/src/main/scala/rocket/CSR.scala:511:31]
  reg         reg_wfi;	// @[generators/rocket-chip/src/main/scala/rocket/CSR.scala:574:54]
  reg  [2:0]  reg_mcountinhibit;	// @[generators/rocket-chip/src/main/scala/rocket/CSR.scala:583:34]
  reg  [5:0]  small_0;	// @[generators/rocket-chip/src/main/scala/util/Counters.scala:45:41]
  reg  [57:0] large_0;	// @[generators/rocket-chip/src/main/scala/util/Counters.scala:50:31]
  reg  [5:0]  small_1;	// @[generators/rocket-chip/src/main/scala/util/Counters.scala:45:41]
  reg  [57:0] large_1;	// @[generators/rocket-chip/src/main/scala/util/Counters.scala:50:31]
  wire [15:0] read_mip = {4'h0, io_interrupts_meip, 3'h0, io_interrupts_mtip, 3'h0, io_interrupts_msip, 3'h0};	// @[generators/rocket-chip/src/main/scala/rocket/CSR.scala:603:22, :642:32, :663:27]
  wire [15:0] _GEN = reg_mie[15:0] & read_mip;	// @[generators/rocket-chip/src/main/scala/rocket/CSR.scala:494:20, :603:22, :607:56]
  wire [15:0] m_interrupts = reg_mstatus_mie ? _GEN : 16'h0;	// @[generators/rocket-chip/src/main/scala/rocket/CSR.scala:394:28, :607:56, :613:25, src/main/scala/chisel3/util/Mux.scala:30:73]
  reg  [31:0] reg_misa;	// @[generators/rocket-chip/src/main/scala/rocket/CSR.scala:641:25]
  wire [6:0]  _GEN_0 = ~(reg_mtvec[0] ? 7'h7E : 7'h2);	// @[generators/rocket-chip/src/main/scala/rocket/CSR.scala:511:31, :1652:{39,41}, generators/rocket-chip/src/main/scala/util/package.scala:166:37]
  wire [31:0] _io_evec_T_20 = ~reg_mepc;	// @[generators/rocket-chip/src/main/scala/rocket/CSR.scala:504:21, :1651:28]
  wire [1:0]  _GEN_1 = {~(reg_misa[2]), 1'h1};	// @[generators/rocket-chip/src/main/scala/rocket/CSR.scala:383:14, :641:25, :938:105, :1651:{36,45}]
  wire [31:0] _io_evec_T_10 = ~reg_dpc;	// @[generators/rocket-chip/src/main/scala/rocket/CSR.scala:482:20, :1651:28]
  reg  [31:0] reg_custom_0;	// @[generators/rocket-chip/src/main/scala/rocket/CSR.scala:791:43]
  wire [11:0] decoded_decoded_invInputs = ~io_rw_addr;	// @[src/main/scala/chisel3/util/pla.scala:78:21]
  wire [11:0] _decoded_decoded_T = {decoded_decoded_invInputs[0], decoded_decoded_invInputs[1], decoded_decoded_invInputs[2], decoded_decoded_invInputs[3], decoded_decoded_invInputs[4], decoded_decoded_invInputs[5], decoded_decoded_invInputs[6], decoded_decoded_invInputs[7], io_rw_addr[8], io_rw_addr[9], decoded_decoded_invInputs[10], decoded_decoded_invInputs[11]};	// @[src/main/scala/chisel3/util/pla.scala:78:21, :90:45, :91:29, :98:53]
  wire [11:0] _decoded_decoded_T_2 = {io_rw_addr[0], decoded_decoded_invInputs[1], decoded_decoded_invInputs[2], decoded_decoded_invInputs[3], decoded_decoded_invInputs[4], decoded_decoded_invInputs[5], decoded_decoded_invInputs[6], decoded_decoded_invInputs[7], io_rw_addr[8], io_rw_addr[9], decoded_decoded_invInputs[10], decoded_decoded_invInputs[11]};	// @[src/main/scala/chisel3/util/pla.scala:78:21, :90:45, :91:29, :98:53]
  wire [11:0] _decoded_decoded_T_4 = {decoded_decoded_invInputs[0], decoded_decoded_invInputs[1], io_rw_addr[2], decoded_decoded_invInputs[3], decoded_decoded_invInputs[4], decoded_decoded_invInputs[5], decoded_decoded_invInputs[6], decoded_decoded_invInputs[7], io_rw_addr[8], io_rw_addr[9], decoded_decoded_invInputs[10], decoded_decoded_invInputs[11]};	// @[src/main/scala/chisel3/util/pla.scala:78:21, :90:45, :91:29, :98:53]
  wire [11:0] _decoded_decoded_T_6 = {io_rw_addr[0], decoded_decoded_invInputs[1], io_rw_addr[2], decoded_decoded_invInputs[3], decoded_decoded_invInputs[4], decoded_decoded_invInputs[5], decoded_decoded_invInputs[6], decoded_decoded_invInputs[7], io_rw_addr[8], io_rw_addr[9], decoded_decoded_invInputs[10], decoded_decoded_invInputs[11]};	// @[src/main/scala/chisel3/util/pla.scala:78:21, :90:45, :91:29, :98:53]
  wire [10:0] _decoded_decoded_T_8 = {decoded_decoded_invInputs[1], decoded_decoded_invInputs[2], decoded_decoded_invInputs[3], decoded_decoded_invInputs[4], io_rw_addr[5], decoded_decoded_invInputs[6], decoded_decoded_invInputs[7], io_rw_addr[8], io_rw_addr[9], decoded_decoded_invInputs[10], decoded_decoded_invInputs[11]};	// @[src/main/scala/chisel3/util/pla.scala:78:21, :90:45, :91:29, :98:53]
  wire [11:0] _decoded_decoded_T_68 = {decoded_decoded_invInputs[0], decoded_decoded_invInputs[1], decoded_decoded_invInputs[2], decoded_decoded_invInputs[3], decoded_decoded_invInputs[4], decoded_decoded_invInputs[5], io_rw_addr[6], decoded_decoded_invInputs[7], io_rw_addr[8], io_rw_addr[9], decoded_decoded_invInputs[10], decoded_decoded_invInputs[11]};	// @[src/main/scala/chisel3/util/pla.scala:78:21, :90:45, :91:29, :98:53]
  wire [11:0] _decoded_decoded_T_70 = {io_rw_addr[0], decoded_decoded_invInputs[1], decoded_decoded_invInputs[2], decoded_decoded_invInputs[3], decoded_decoded_invInputs[4], decoded_decoded_invInputs[5], io_rw_addr[6], decoded_decoded_invInputs[7], io_rw_addr[8], io_rw_addr[9], decoded_decoded_invInputs[10], decoded_decoded_invInputs[11]};	// @[src/main/scala/chisel3/util/pla.scala:78:21, :90:45, :91:29, :98:53]
  wire [11:0] _decoded_decoded_T_72 = {decoded_decoded_invInputs[0], io_rw_addr[1], decoded_decoded_invInputs[2], decoded_decoded_invInputs[3], decoded_decoded_invInputs[4], decoded_decoded_invInputs[5], io_rw_addr[6], decoded_decoded_invInputs[7], io_rw_addr[8], io_rw_addr[9], decoded_decoded_invInputs[10], decoded_decoded_invInputs[11]};	// @[src/main/scala/chisel3/util/pla.scala:78:21, :90:45, :91:29, :98:53]
  wire [11:0] _decoded_decoded_T_74 = {io_rw_addr[0], io_rw_addr[1], decoded_decoded_invInputs[2], decoded_decoded_invInputs[3], decoded_decoded_invInputs[4], decoded_decoded_invInputs[5], io_rw_addr[6], decoded_decoded_invInputs[7], io_rw_addr[8], io_rw_addr[9], decoded_decoded_invInputs[10], decoded_decoded_invInputs[11]};	// @[src/main/scala/chisel3/util/pla.scala:78:21, :90:45, :91:29, :98:53]
  wire [11:0] _decoded_decoded_T_80 = {io_rw_addr[0], decoded_decoded_invInputs[1], decoded_decoded_invInputs[2], decoded_decoded_invInputs[3], decoded_decoded_invInputs[4], io_rw_addr[5], decoded_decoded_invInputs[6], io_rw_addr[7], io_rw_addr[8], io_rw_addr[9], io_rw_addr[10], decoded_decoded_invInputs[11]};	// @[src/main/scala/chisel3/util/pla.scala:78:21, :90:45, :91:29, :98:53]
  wire [11:0] _decoded_decoded_T_82 = {decoded_decoded_invInputs[0], io_rw_addr[1], decoded_decoded_invInputs[2], decoded_decoded_invInputs[3], decoded_decoded_invInputs[4], io_rw_addr[5], decoded_decoded_invInputs[6], io_rw_addr[7], io_rw_addr[8], io_rw_addr[9], io_rw_addr[10], decoded_decoded_invInputs[11]};	// @[src/main/scala/chisel3/util/pla.scala:78:21, :90:45, :91:29, :98:53]
  wire [11:0] _decoded_decoded_T_86 = {decoded_decoded_invInputs[0], decoded_decoded_invInputs[1], decoded_decoded_invInputs[2], decoded_decoded_invInputs[3], io_rw_addr[4], io_rw_addr[5], decoded_decoded_invInputs[6], io_rw_addr[7], io_rw_addr[8], io_rw_addr[9], io_rw_addr[10], decoded_decoded_invInputs[11]};	// @[src/main/scala/chisel3/util/pla.scala:78:21, :90:45, :91:29, :98:53]
  wire [11:0] _decoded_decoded_T_88 = {io_rw_addr[0], decoded_decoded_invInputs[1], decoded_decoded_invInputs[2], decoded_decoded_invInputs[3], io_rw_addr[4], io_rw_addr[5], decoded_decoded_invInputs[6], io_rw_addr[7], io_rw_addr[8], io_rw_addr[9], io_rw_addr[10], decoded_decoded_invInputs[11]};	// @[src/main/scala/chisel3/util/pla.scala:78:21, :90:45, :91:29, :98:53]
  wire [10:0] _decoded_decoded_T_90 = {io_rw_addr[1], decoded_decoded_invInputs[2], decoded_decoded_invInputs[3], io_rw_addr[4], io_rw_addr[5], decoded_decoded_invInputs[6], io_rw_addr[7], io_rw_addr[8], io_rw_addr[9], io_rw_addr[10], decoded_decoded_invInputs[11]};	// @[src/main/scala/chisel3/util/pla.scala:78:21, :90:45, :91:29, :98:53]
  wire [5:0]  _decoded_decoded_T_92 = {io_rw_addr[6], io_rw_addr[7], io_rw_addr[8], io_rw_addr[9], io_rw_addr[10], decoded_decoded_invInputs[11]};	// @[src/main/scala/chisel3/util/pla.scala:78:21, :90:45, :91:29, :98:53]
  wire [10:0] _decoded_decoded_T_94 = {decoded_decoded_invInputs[1], decoded_decoded_invInputs[2], decoded_decoded_invInputs[3], decoded_decoded_invInputs[4], decoded_decoded_invInputs[5], decoded_decoded_invInputs[6], decoded_decoded_invInputs[7], io_rw_addr[8], io_rw_addr[9], decoded_decoded_invInputs[10], io_rw_addr[11]};	// @[src/main/scala/chisel3/util/pla.scala:78:21, :90:45, :91:29, :98:53]
  wire [11:0] _decoded_decoded_T_96 = {decoded_decoded_invInputs[0], io_rw_addr[1], decoded_decoded_invInputs[2], decoded_decoded_invInputs[3], decoded_decoded_invInputs[4], decoded_decoded_invInputs[5], decoded_decoded_invInputs[6], decoded_decoded_invInputs[7], io_rw_addr[8], io_rw_addr[9], decoded_decoded_invInputs[10], io_rw_addr[11]};	// @[src/main/scala/chisel3/util/pla.scala:78:21, :90:45, :91:29, :98:53]
  wire [10:0] _decoded_decoded_T_156 = {decoded_decoded_invInputs[1], decoded_decoded_invInputs[2], decoded_decoded_invInputs[3], decoded_decoded_invInputs[4], decoded_decoded_invInputs[5], decoded_decoded_invInputs[6], io_rw_addr[7], io_rw_addr[8], io_rw_addr[9], decoded_decoded_invInputs[10], io_rw_addr[11]};	// @[src/main/scala/chisel3/util/pla.scala:78:21, :90:45, :91:29, :98:53]
  wire [11:0] _decoded_decoded_T_158 = {decoded_decoded_invInputs[0], io_rw_addr[1], decoded_decoded_invInputs[2], decoded_decoded_invInputs[3], decoded_decoded_invInputs[4], decoded_decoded_invInputs[5], decoded_decoded_invInputs[6], io_rw_addr[7], io_rw_addr[8], io_rw_addr[9], decoded_decoded_invInputs[10], io_rw_addr[11]};	// @[src/main/scala/chisel3/util/pla.scala:78:21, :90:45, :91:29, :98:53]
  wire [31:0] _wdata_T_2 = (io_rw_cmd[1] ? io_rw_rdata_0 : 32'h0) | io_rw_wdata;	// @[generators/rocket-chip/src/main/scala/rocket/CSR.scala:1629:{9,13,30}, src/main/scala/chisel3/util/Mux.scala:30:73]
  wire [31:0] _wdata_T_6 = ~((&(io_rw_cmd[1:0])) ? io_rw_wdata : 32'h0);	// @[generators/rocket-chip/src/main/scala/rocket/CSR.scala:1629:{41,45,49,55}, src/main/scala/chisel3/util/Mux.scala:30:73]
  wire [31:0] _reg_bp_0_control_WIRE_1 = _wdata_T_2 & _wdata_T_6;	// @[generators/rocket-chip/src/main/scala/rocket/CSR.scala:1629:{30,39,41}]
  wire        system_insn = io_rw_cmd == 3'h4;	// @[generators/rocket-chip/src/main/scala/rocket/CSR.scala:869:31, src/main/scala/chisel3/util/Mux.scala:50:70]
  wire [11:0] _GEN_2 = ~io_rw_addr;	// @[src/main/scala/chisel3/util/pla.scala:78:21]
  wire        insn_call = system_insn & (&{_GEN_2[0], _GEN_2[1], _GEN_2[2], _GEN_2[3], _GEN_2[4], _GEN_2[5], _GEN_2[6], _GEN_2[7], _GEN_2[8], _GEN_2[9], _GEN_2[10], _GEN_2[11]});	// @[generators/rocket-chip/src/main/scala/rocket/CSR.scala:869:31, :886:83, src/main/scala/chisel3/util/pla.scala:78:21, :91:29, :98:{53,70}]
  wire        insn_break = system_insn & (&{io_rw_addr[0], _GEN_2[1], _GEN_2[2], _GEN_2[3], _GEN_2[4], _GEN_2[5], _GEN_2[6], _GEN_2[7], _GEN_2[8], _GEN_2[9], _GEN_2[10], _GEN_2[11]});	// @[generators/rocket-chip/src/main/scala/rocket/CSR.scala:869:31, :886:83, src/main/scala/chisel3/util/pla.scala:78:21, :90:45, :91:29, :98:{53,70}]
  wire        insn_ret = system_insn & (|{&{_GEN_2[2], _GEN_2[3], _GEN_2[4], _GEN_2[5], _GEN_2[6], _GEN_2[7], io_rw_addr[8], io_rw_addr[9], _GEN_2[10], _GEN_2[11]}, &{io_rw_addr[10], _GEN_2[11]}});	// @[generators/rocket-chip/src/main/scala/rocket/CSR.scala:869:31, :886:83, src/main/scala/chisel3/util/pla.scala:78:21, :90:45, :91:29, :98:{53,70}, :114:{19,36}]
  wire [9:0]  decoded_invInputs_1 = ~(io_decode_0_inst[31:22]);	// @[generators/rocket-chip/src/main/scala/rocket/CSR.scala:383:14, src/main/scala/chisel3/util/pla.scala:78:21]
  wire [31:0] _GEN_3 = {27'h0, io_decode_0_inst[24:20]};	// @[generators/rocket-chip/src/main/scala/rocket/CSR.scala:890:27, :904:28, :905:70]
  wire [31:0] _io_decode_0_virtual_access_illegal_T_3 = 32'h0 >> _GEN_3;	// @[generators/rocket-chip/src/main/scala/rocket/CSR.scala:905:70, src/main/scala/chisel3/util/Mux.scala:30:73]
  wire [31:0] _io_decode_0_virtual_access_illegal_T_6 = 32'h0 >> _GEN_3;	// @[generators/rocket-chip/src/main/scala/rocket/CSR.scala:905:70, :907:63, src/main/scala/chisel3/util/Mux.scala:30:73]
  wire        csr_exists =
    io_decode_0_inst[31:20] == 12'h7A0 | io_decode_0_inst[31:20] == 12'h7A1 | io_decode_0_inst[31:20] == 12'h7A2 | io_decode_0_inst[31:20] == 12'h7A3 | io_decode_0_inst[31:20] == 12'h301 | io_decode_0_inst[31:20] == 12'h300 | io_decode_0_inst[31:20] == 12'h305 | io_decode_0_inst[31:20] == 12'h344 | io_decode_0_inst[31:20] == 12'h304 | io_decode_0_inst[31:20] == 12'h340 | io_decode_0_inst[31:20] == 12'h341 | io_decode_0_inst[31:20] == 12'h343 | io_decode_0_inst[31:20] == 12'h342 | io_decode_0_inst[31:20] == 12'hF14 | io_decode_0_inst[31:20] == 12'h7B0 | io_decode_0_inst[31:20] == 12'h7B1 | io_decode_0_inst[31:20] == 12'h7B2 | io_decode_0_inst[31:20] == 12'h320 | io_decode_0_inst[31:20] == 12'hB00 | io_decode_0_inst[31:20] == 12'hB02 | io_decode_0_inst[31:20] == 12'h323 | io_decode_0_inst[31:20] == 12'hB03 | io_decode_0_inst[31:20] == 12'hC03 | io_decode_0_inst[31:20] == 12'hB83 | io_decode_0_inst[31:20] == 12'hC83 | io_decode_0_inst[31:20] == 12'h324 | io_decode_0_inst[31:20] == 12'hB04 | io_decode_0_inst[31:20] == 12'hC04 | io_decode_0_inst[31:20] == 12'hB84 | io_decode_0_inst[31:20] == 12'hC84 | io_decode_0_inst[31:20] == 12'h325 | io_decode_0_inst[31:20] == 12'hB05 | io_decode_0_inst[31:20] == 12'hC05 | io_decode_0_inst[31:20] == 12'hB85 | io_decode_0_inst[31:20] == 12'hC85 | io_decode_0_inst[31:20] == 12'h326 | io_decode_0_inst[31:20] == 12'hB06 | io_decode_0_inst[31:20] == 12'hC06 | io_decode_0_inst[31:20] == 12'hB86 | io_decode_0_inst[31:20] == 12'hC86 | io_decode_0_inst[31:20] == 12'h327 | io_decode_0_inst[31:20] == 12'hB07 | io_decode_0_inst[31:20] == 12'hC07 | io_decode_0_inst[31:20] == 12'hB87 | io_decode_0_inst[31:20] == 12'hC87 | io_decode_0_inst[31:20] == 12'h328 | io_decode_0_inst[31:20] == 12'hB08 | io_decode_0_inst[31:20] == 12'hC08 | io_decode_0_inst[31:20] == 12'hB88 | io_decode_0_inst[31:20] == 12'hC88 | io_decode_0_inst[31:20] == 12'h329 | io_decode_0_inst[31:20] == 12'hB09 | io_decode_0_inst[31:20] == 12'hC09 | io_decode_0_inst[31:20] == 12'hB89 | io_decode_0_inst[31:20] == 12'hC89
    | io_decode_0_inst[31:20] == 12'h32A | io_decode_0_inst[31:20] == 12'hB0A | io_decode_0_inst[31:20] == 12'hC0A | io_decode_0_inst[31:20] == 12'hB8A | io_decode_0_inst[31:20] == 12'hC8A | io_decode_0_inst[31:20] == 12'h32B | io_decode_0_inst[31:20] == 12'hB0B | io_decode_0_inst[31:20] == 12'hC0B | io_decode_0_inst[31:20] == 12'hB8B | io_decode_0_inst[31:20] == 12'hC8B | io_decode_0_inst[31:20] == 12'h32C | io_decode_0_inst[31:20] == 12'hB0C | io_decode_0_inst[31:20] == 12'hC0C | io_decode_0_inst[31:20] == 12'hB8C | io_decode_0_inst[31:20] == 12'hC8C | io_decode_0_inst[31:20] == 12'h32D | io_decode_0_inst[31:20] == 12'hB0D | io_decode_0_inst[31:20] == 12'hC0D | io_decode_0_inst[31:20] == 12'hB8D | io_decode_0_inst[31:20] == 12'hC8D | io_decode_0_inst[31:20] == 12'h32E | io_decode_0_inst[31:20] == 12'hB0E | io_decode_0_inst[31:20] == 12'hC0E | io_decode_0_inst[31:20] == 12'hB8E | io_decode_0_inst[31:20] == 12'hC8E | io_decode_0_inst[31:20] == 12'h32F | io_decode_0_inst[31:20] == 12'hB0F | io_decode_0_inst[31:20] == 12'hC0F | io_decode_0_inst[31:20] == 12'hB8F | io_decode_0_inst[31:20] == 12'hC8F | io_decode_0_inst[31:20] == 12'h330 | io_decode_0_inst[31:20] == 12'hB10 | io_decode_0_inst[31:20] == 12'hC10 | io_decode_0_inst[31:20] == 12'hB90 | io_decode_0_inst[31:20] == 12'hC90 | io_decode_0_inst[31:20] == 12'h331 | io_decode_0_inst[31:20] == 12'hB11 | io_decode_0_inst[31:20] == 12'hC11 | io_decode_0_inst[31:20] == 12'hB91 | io_decode_0_inst[31:20] == 12'hC91 | io_decode_0_inst[31:20] == 12'h332 | io_decode_0_inst[31:20] == 12'hB12 | io_decode_0_inst[31:20] == 12'hC12 | io_decode_0_inst[31:20] == 12'hB92 | io_decode_0_inst[31:20] == 12'hC92 | io_decode_0_inst[31:20] == 12'h333 | io_decode_0_inst[31:20] == 12'hB13 | io_decode_0_inst[31:20] == 12'hC13 | io_decode_0_inst[31:20] == 12'hB93 | io_decode_0_inst[31:20] == 12'hC93 | io_decode_0_inst[31:20] == 12'h334 | io_decode_0_inst[31:20] == 12'hB14 | io_decode_0_inst[31:20] == 12'hC14 | io_decode_0_inst[31:20] == 12'hB94 | io_decode_0_inst[31:20] == 12'hC94
    | io_decode_0_inst[31:20] == 12'h335 | io_decode_0_inst[31:20] == 12'hB15 | io_decode_0_inst[31:20] == 12'hC15 | io_decode_0_inst[31:20] == 12'hB95 | io_decode_0_inst[31:20] == 12'hC95 | io_decode_0_inst[31:20] == 12'h336 | io_decode_0_inst[31:20] == 12'hB16 | io_decode_0_inst[31:20] == 12'hC16 | io_decode_0_inst[31:20] == 12'hB96 | io_decode_0_inst[31:20] == 12'hC96 | io_decode_0_inst[31:20] == 12'h337 | io_decode_0_inst[31:20] == 12'hB17 | io_decode_0_inst[31:20] == 12'hC17 | io_decode_0_inst[31:20] == 12'hB97 | io_decode_0_inst[31:20] == 12'hC97 | io_decode_0_inst[31:20] == 12'h338 | io_decode_0_inst[31:20] == 12'hB18 | io_decode_0_inst[31:20] == 12'hC18 | io_decode_0_inst[31:20] == 12'hB98 | io_decode_0_inst[31:20] == 12'hC98 | io_decode_0_inst[31:20] == 12'h339 | io_decode_0_inst[31:20] == 12'hB19 | io_decode_0_inst[31:20] == 12'hC19 | io_decode_0_inst[31:20] == 12'hB99 | io_decode_0_inst[31:20] == 12'hC99 | io_decode_0_inst[31:20] == 12'h33A | io_decode_0_inst[31:20] == 12'hB1A | io_decode_0_inst[31:20] == 12'hC1A | io_decode_0_inst[31:20] == 12'hB9A | io_decode_0_inst[31:20] == 12'hC9A | io_decode_0_inst[31:20] == 12'h33B | io_decode_0_inst[31:20] == 12'hB1B | io_decode_0_inst[31:20] == 12'hC1B | io_decode_0_inst[31:20] == 12'hB9B | io_decode_0_inst[31:20] == 12'hC9B | io_decode_0_inst[31:20] == 12'h33C | io_decode_0_inst[31:20] == 12'hB1C | io_decode_0_inst[31:20] == 12'hC1C | io_decode_0_inst[31:20] == 12'hB9C | io_decode_0_inst[31:20] == 12'hC9C | io_decode_0_inst[31:20] == 12'h33D | io_decode_0_inst[31:20] == 12'hB1D | io_decode_0_inst[31:20] == 12'hC1D | io_decode_0_inst[31:20] == 12'hB9D | io_decode_0_inst[31:20] == 12'hC9D | io_decode_0_inst[31:20] == 12'h33E | io_decode_0_inst[31:20] == 12'hB1E | io_decode_0_inst[31:20] == 12'hC1E | io_decode_0_inst[31:20] == 12'hB9E | io_decode_0_inst[31:20] == 12'hC9E | io_decode_0_inst[31:20] == 12'h33F | io_decode_0_inst[31:20] == 12'hB1F | io_decode_0_inst[31:20] == 12'hC1F | io_decode_0_inst[31:20] == 12'hB9F | io_decode_0_inst[31:20] == 12'hC9F
    | io_decode_0_inst[31:20] == 12'hC00 | io_decode_0_inst[31:20] == 12'hC02 | io_decode_0_inst[31:20] == 12'hB80 | io_decode_0_inst[31:20] == 12'hB82 | io_decode_0_inst[31:20] == 12'hC80 | io_decode_0_inst[31:20] == 12'hC82 | io_decode_0_inst[31:20] == 12'h7C1 | io_decode_0_inst[31:20] == 12'hF12 | io_decode_0_inst[31:20] == 12'hF11 | io_decode_0_inst[31:20] == 12'hF13 | io_decode_0_inst[31:20] == 12'hF15;	// @[generators/rocket-chip/src/main/scala/rocket/CSR.scala:792:50, :890:27, :892:{93,111}, generators/rocket-chip/src/main/scala/util/package.scala:205:47]
  wire [5:0]  io_decode_0_read_illegal_invInputs = ~(io_decode_0_inst[31:26]);	// @[generators/rocket-chip/src/main/scala/rocket/CSR.scala:890:27, src/main/scala/chisel3/util/pla.scala:78:21]
  wire [11:0] io_decode_0_write_flush_addr_m = {io_decode_0_inst[31:30], io_decode_0_inst[29:20] | 10'h300};	// @[generators/rocket-chip/src/main/scala/rocket/CSR.scala:890:27, :892:93, :925:25]
  wire [31:0] cause = insn_call ? {28'h0, {3'h1, ~reg_mstatus_v} - 4'h8} : insn_break ? 32'h3 : io_cause;	// @[generators/rocket-chip/src/main/scala/rocket/CSR.scala:394:28, :886:83, :952:{8,40,45}, :953:14, :1013:79]
  wire        _causeIsDebugTrigger_T_2 = cause[7:0] == 8'hE;	// @[generators/rocket-chip/src/main/scala/rocket/CSR.scala:952:8, :954:25, :955:53]
  wire        causeIsDebugInt = cause[31] & _causeIsDebugTrigger_T_2;	// @[generators/rocket-chip/src/main/scala/rocket/CSR.scala:952:8, :955:{30,39,53}]
  wire        causeIsDebugTrigger = ~(cause[31]) & _causeIsDebugTrigger_T_2;	// @[generators/rocket-chip/src/main/scala/rocket/CSR.scala:952:8, :955:{30,53}, :956:{29,44}]
  wire        trapToDebug = reg_singleStepped | causeIsDebugInt | causeIsDebugTrigger | ~(cause[31]) & insn_break & reg_dcsr_ebreakm | reg_debug;	// @[generators/rocket-chip/src/main/scala/rocket/CSR.scala:402:25, :481:26, :485:30, :886:83, :952:8, :955:{30,39}, :956:44, :957:{27,56}, :958:119]
  wire        _exception_T = insn_call | insn_break;	// @[generators/rocket-chip/src/main/scala/rocket/CSR.scala:886:83, :992:24]
  assign io_singleStep_0 = reg_dcsr_step & ~reg_debug;	// @[generators/rocket-chip/src/main/scala/rocket/CSR.scala:402:25, :481:26, :920:45, :993:34]
  wire        io_trace_0_exception_0 = _exception_T | io_exception;	// @[generators/rocket-chip/src/main/scala/rocket/CSR.scala:992:24, :1012:43]
  `ifndef SYNTHESIS	// @[generators/rocket-chip/src/main/scala/rocket/CSR.scala:1013:9]
    wire [2:0] _GEN_4 = {1'h0, {1'h0, insn_ret} + {1'h0, insn_call}} + {1'h0, {1'h0, insn_break} + {1'h0, io_exception}};	// @[generators/rocket-chip/src/main/scala/rocket/CSR.scala:383:14, :613:51, :886:83, :919:18, :938:109, :939:34, :940:50, :946:14, :947:44, :948:17, :1001:39, :1013:18]
    always @(posedge clock) begin	// @[generators/rocket-chip/src/main/scala/rocket/CSR.scala:1013:9]
      if (~reset & (|(_GEN_4[2:1]))) begin	// @[generators/rocket-chip/src/main/scala/rocket/CSR.scala:1013:{9,18,79}]
        if (`ASSERT_VERBOSE_COND_)	// @[generators/rocket-chip/src/main/scala/rocket/CSR.scala:1013:9]
          $error("Assertion failed: these conditions must be mutually exclusive\n    at CSR.scala:1013 assert(PopCount(insn_ret :: insn_call :: insn_break :: io.exception :: Nil) <= 1.U, \"these conditions must be mutually exclusive\")\n");	// @[generators/rocket-chip/src/main/scala/rocket/CSR.scala:1013:9]
        if (`STOP_COND_)	// @[generators/rocket-chip/src/main/scala/rocket/CSR.scala:1013:9]
          $fatal;	// @[generators/rocket-chip/src/main/scala/rocket/CSR.scala:1013:9]
      end
      if (~reset & ~(~reg_singleStepped | ~io_retire)) begin	// @[generators/rocket-chip/src/main/scala/rocket/CSR.scala:485:30, :1013:9, :1022:{9,10,29,42}]
        if (`ASSERT_VERBOSE_COND_)	// @[generators/rocket-chip/src/main/scala/rocket/CSR.scala:1022:9]
          $error("Assertion failed\n    at CSR.scala:1022 assert(!reg_singleStepped || io.retire === 0.U)\n");	// @[generators/rocket-chip/src/main/scala/rocket/CSR.scala:1022:9]
        if (`STOP_COND_)	// @[generators/rocket-chip/src/main/scala/rocket/CSR.scala:1022:9]
          $fatal;	// @[generators/rocket-chip/src/main/scala/rocket/CSR.scala:1022:9]
      end
    end // always @(posedge)
  `endif // not def SYNTHESIS
  wire        _GEN_5 = io_rw_addr[10] & io_rw_addr[7];	// @[generators/rocket-chip/src/main/scala/rocket/CSR.scala:1124:{43,48,61}]
  wire        io_csr_stall_0 = reg_wfi | io_status_cease_r;	// @[generators/rocket-chip/src/main/scala/rocket/CSR.scala:574:54, :1151:27, :1152:31]
  wire [31:0] _GEN_6 = {large_1[25:0], small_1};	// @[generators/rocket-chip/src/main/scala/rocket/CSR.scala:1150:11, generators/rocket-chip/src/main/scala/util/Counters.scala:45:41, :50:31, :55:30]
  wire [31:0] _GEN_7 = {large_0[25:0], small_0};	// @[generators/rocket-chip/src/main/scala/util/Counters.scala:45:41, :50:31, :55:30]
  wire [31:0] _io_rw_rdata_T_181 = ((&_decoded_decoded_T_80) ? {4'h2, reg_bp_0_control_dmode, 14'h400, reg_bp_0_control_action, 3'h0, reg_bp_0_control_tmatch, 4'h8, reg_bp_0_control_x, reg_bp_0_control_w, reg_bp_0_control_r} : 32'h0) | ((&_decoded_decoded_T_82) ? reg_bp_0_address : 32'h0) | ((&_decoded_decoded_T_2) ? reg_misa : 32'h0) | ((&_decoded_decoded_T) ? {19'h0, reg_mstatus_mpp, 3'h0, reg_mstatus_mpie, 3'h0, reg_mstatus_mie, 3'h0} : 32'h0) | ((&_decoded_decoded_T_6) ? reg_mtvec & {25'h1FFFFFF, _GEN_0} : 32'h0);	// @[generators/rocket-chip/src/main/scala/rocket/CSR.scala:390:47, :394:28, :491:19, :511:31, :641:25, :642:32, :648:48, :1463:67, generators/rocket-chip/src/main/scala/util/package.scala:155:13, :166:{35,37,41}, src/main/scala/chisel3/util/Mux.scala:30:73, :50:70, src/main/scala/chisel3/util/pla.scala:98:{53,70}]
  wire [31:0] _io_rw_rdata_T_187 = {_io_rw_rdata_T_181[31:16], _io_rw_rdata_T_181[15:0] | ((&{io_rw_addr[2], decoded_decoded_invInputs[3], decoded_decoded_invInputs[4], decoded_decoded_invInputs[5], io_rw_addr[6], decoded_decoded_invInputs[7], io_rw_addr[8], io_rw_addr[9], decoded_decoded_invInputs[10], decoded_decoded_invInputs[11]}) ? read_mip : 16'h0)} | ((&_decoded_decoded_T_4) ? reg_mie : 32'h0) | ((&_decoded_decoded_T_68) ? reg_mscratch : 32'h0) | ((&_decoded_decoded_T_70) ? ~{_io_evec_T_20[31:2], _io_evec_T_20[1:0] | _GEN_1} : 32'h0) | ((&_decoded_decoded_T_74) ? reg_mtval : 32'h0) | ((&_decoded_decoded_T_72) ? reg_mcause : 32'h0);	// @[generators/rocket-chip/src/main/scala/rocket/CSR.scala:494:20, :505:27, :506:22, :508:25, :603:22, :1651:{26,28,31,36}, src/main/scala/chisel3/util/Mux.scala:30:73, src/main/scala/chisel3/util/pla.scala:78:21, :90:45, :91:29, :98:{53,70}]
  wire [31:0] _io_rw_rdata_T_191 = {_io_rw_rdata_T_187[31:1], _io_rw_rdata_T_187[0] | (&{decoded_decoded_invInputs[0], decoded_decoded_invInputs[1], io_rw_addr[2], decoded_decoded_invInputs[3], io_rw_addr[4], decoded_decoded_invInputs[5], decoded_decoded_invInputs[6], decoded_decoded_invInputs[7], io_rw_addr[8], io_rw_addr[9], io_rw_addr[10], io_rw_addr[11]}) & io_hartid} | ((&_decoded_decoded_T_86) ? {16'h4000, reg_dcsr_ebreakm, 6'h0, reg_dcsr_cause, reg_dcsr_v, 2'h0, reg_dcsr_step, 2'h3} : 32'h0) | ((&_decoded_decoded_T_88) ? ~{_io_evec_T_10[31:2], _io_evec_T_10[1:0] | _GEN_1} : 32'h0) | ((&_decoded_decoded_T_90) ? reg_dscratch0 : 32'h0);	// @[generators/rocket-chip/src/main/scala/rocket/CSR.scala:383:14, :402:25, :483:26, :551:41, :642:32, :663:27, :957:62, :1651:{26,28,31,36}, src/main/scala/chisel3/util/Mux.scala:30:73, src/main/scala/chisel3/util/pla.scala:78:21, :90:45, :91:29, :98:{53,70}]
  wire [2:0]  _GEN_8 = _io_rw_rdata_T_191[2:0] | ((&_decoded_decoded_T_8) ? reg_mcountinhibit : 3'h0);	// @[generators/rocket-chip/src/main/scala/rocket/CSR.scala:583:34, :642:32, src/main/scala/chisel3/util/Mux.scala:30:73, src/main/scala/chisel3/util/pla.scala:98:{53,70}]
  assign io_rw_rdata_0 =
    ((&_decoded_decoded_T_94) ? _GEN_6 : 32'h0) | ((&_decoded_decoded_T_96) ? _GEN_7 : 32'h0) | ((&{decoded_decoded_invInputs[1], decoded_decoded_invInputs[2], decoded_decoded_invInputs[3], decoded_decoded_invInputs[4], decoded_decoded_invInputs[5], decoded_decoded_invInputs[6], decoded_decoded_invInputs[7], decoded_decoded_invInputs[8], decoded_decoded_invInputs[9], io_rw_addr[10], io_rw_addr[11]}) ? _GEN_6 : 32'h0) | ((&{decoded_decoded_invInputs[0], io_rw_addr[1], decoded_decoded_invInputs[2], decoded_decoded_invInputs[3], decoded_decoded_invInputs[4], decoded_decoded_invInputs[5], decoded_decoded_invInputs[6], decoded_decoded_invInputs[7], decoded_decoded_invInputs[8], decoded_decoded_invInputs[9], io_rw_addr[10], io_rw_addr[11]}) ? _GEN_7 : 32'h0) | ((&_decoded_decoded_T_156) ? large_1[57:26] : 32'h0) | ((&_decoded_decoded_T_158) ? large_0[57:26] : 32'h0) | ((&{decoded_decoded_invInputs[1], decoded_decoded_invInputs[2], decoded_decoded_invInputs[3], decoded_decoded_invInputs[4], decoded_decoded_invInputs[5], decoded_decoded_invInputs[6], io_rw_addr[7], decoded_decoded_invInputs[8], decoded_decoded_invInputs[9], io_rw_addr[10], io_rw_addr[11]}) ? large_1[57:26] : 32'h0) | ((&{decoded_decoded_invInputs[0], io_rw_addr[1], decoded_decoded_invInputs[2], decoded_decoded_invInputs[3], decoded_decoded_invInputs[4], decoded_decoded_invInputs[5], decoded_decoded_invInputs[6], io_rw_addr[7], decoded_decoded_invInputs[8], decoded_decoded_invInputs[9], io_rw_addr[10], io_rw_addr[11]}) ? large_0[57:26] : 32'h0) | ((&_decoded_decoded_T_92) ? reg_custom_0 : 32'h0) | ((&{io_rw_addr[0], io_rw_addr[1], decoded_decoded_invInputs[2], decoded_decoded_invInputs[3], io_rw_addr[4], decoded_decoded_invInputs[5], decoded_decoded_invInputs[6], decoded_decoded_invInputs[7], io_rw_addr[8], io_rw_addr[9], io_rw_addr[10], io_rw_addr[11]}) ? 32'h20181004 : 32'h0)
    | {_io_rw_rdata_T_191[31:3], _GEN_8[2:1], _GEN_8[0] | (&{decoded_decoded_invInputs[0], io_rw_addr[1], decoded_decoded_invInputs[2], decoded_decoded_invInputs[3], io_rw_addr[4], decoded_decoded_invInputs[5], decoded_decoded_invInputs[6], decoded_decoded_invInputs[7], io_rw_addr[8], io_rw_addr[9], io_rw_addr[10], io_rw_addr[11]})};	// @[generators/rocket-chip/src/main/scala/rocket/CSR.scala:727:50, :728:54, :791:43, generators/rocket-chip/src/main/scala/util/Counters.scala:50:31, :55:30, src/main/scala/chisel3/util/Mux.scala:30:73, src/main/scala/chisel3/util/pla.scala:78:21, :90:45, :91:29, :98:{53,70}]
  wire        _csr_wen_T_4 = io_rw_cmd == 3'h6 | (&io_rw_cmd) | io_rw_cmd == 3'h5;	// @[generators/rocket-chip/src/main/scala/util/package.scala:16:47, :73:59, src/main/scala/chisel3/util/Mux.scala:50:70]
  wire [15:0] _newBPC_WIRE = ((io_rw_cmd[1] ? {reg_bp_0_control_dmode, 14'h400, reg_bp_0_control_action} : 16'h0) | io_rw_wdata[27:12]) & ~((&(io_rw_cmd[1:0])) ? io_rw_wdata[27:12] : 16'h0);	// @[generators/rocket-chip/src/main/scala/rocket/CSR.scala:383:14, :491:19, :1463:67, :1629:{9,13,30,39,41,45,49,55}, src/main/scala/chisel3/util/Mux.scala:30:73]
  wire        dMode = _newBPC_WIRE[15] & reg_debug;	// @[generators/rocket-chip/src/main/scala/rocket/CSR.scala:481:26, :1463:96, :1464:38, :1629:39]
  wire [31:0] _reg_misa_T = ~_reg_bp_0_control_WIRE_1;	// @[generators/rocket-chip/src/main/scala/rocket/CSR.scala:1253:25, :1629:39]
  wire [6:0]  nextSmall = {1'h0, small_0} + {6'h0, io_retire};	// @[generators/rocket-chip/src/main/scala/rocket/CSR.scala:383:14, :551:41, :613:51, :919:18, :938:109, :939:34, :940:50, :946:14, :947:44, :948:17, :1001:39, generators/rocket-chip/src/main/scala/util/Counters.scala:45:41, :46:33]
  wire        _large_T_2 = nextSmall[6] & ~(reg_mcountinhibit[2]);	// @[generators/rocket-chip/src/main/scala/rocket/CSR.scala:583:34, :585:75, generators/rocket-chip/src/main/scala/util/Counters.scala:46:33, :47:9, :51:{20,33}]
  wire [57:0] _large_r_T = large_0 + 58'h1;	// @[generators/rocket-chip/src/main/scala/util/Counters.scala:50:31, :51:55]
  wire        _GEN_9 = ~insn_ret | _GEN_5;	// @[generators/rocket-chip/src/main/scala/rocket/CSR.scala:886:83, :1027:20, :1105:19, :1107:48, :1124:48]
  wire [31:0] epc = {io_pc[31:1], 1'h0};	// @[generators/rocket-chip/src/main/scala/rocket/CSR.scala:383:14, :613:51, :919:18, :938:109, :939:34, :940:50, :946:14, :947:44, :948:17, :1001:39, :1650:31]
  wire        _GEN_10 = io_trace_0_exception_0 & trapToDebug & ~reg_debug;	// @[generators/rocket-chip/src/main/scala/rocket/CSR.scala:481:26, :920:45, :958:119, :1012:43, :1027:20, :1028:24, :1029:25, :1031:19]
  wire        _GEN_11 = ~io_trace_0_exception_0 | trapToDebug;	// @[generators/rocket-chip/src/main/scala/rocket/CSR.scala:394:28, :958:119, :1012:43, :1027:20, :1028:24]
  wire        _GEN_12 = ~reg_bp_0_control_dmode | reg_debug;	// @[generators/rocket-chip/src/main/scala/rocket/CSR.scala:481:26, :491:19, :1444:{39,57}]
  wire        _GEN_13 = _csr_wen_T_4 & _GEN_12 & (&_decoded_decoded_T_80);	// @[generators/rocket-chip/src/main/scala/rocket/CSR.scala:491:19, :1214:18, :1444:{57,72}, :1456:44, :1457:24, generators/rocket-chip/src/main/scala/util/package.scala:73:59, src/main/scala/chisel3/util/pla.scala:98:{53,70}]
  always @(posedge clock) begin
    if (reset) begin
      reg_mstatus_v <= 1'h0;	// @[generators/rocket-chip/src/main/scala/rocket/CSR.scala:383:14, :394:28, :613:51, :919:18, :938:109, :939:34, :940:50, :946:14, :947:44, :948:17, :1001:39]
      reg_mstatus_mpv <= 1'h0;	// @[generators/rocket-chip/src/main/scala/rocket/CSR.scala:383:14, :394:28, :613:51, :919:18, :938:109, :939:34, :940:50, :946:14, :947:44, :948:17, :1001:39]
      reg_mstatus_gva <= 1'h0;	// @[generators/rocket-chip/src/main/scala/rocket/CSR.scala:383:14, :394:28, :613:51, :919:18, :938:109, :939:34, :940:50, :946:14, :947:44, :948:17, :1001:39]
      reg_mstatus_mpp <= 2'h3;	// @[generators/rocket-chip/src/main/scala/rocket/CSR.scala:383:14, :394:28]
      reg_mstatus_mpie <= 1'h0;	// @[generators/rocket-chip/src/main/scala/rocket/CSR.scala:383:14, :394:28, :613:51, :919:18, :938:109, :939:34, :940:50, :946:14, :947:44, :948:17, :1001:39]
      reg_mstatus_mie <= 1'h0;	// @[generators/rocket-chip/src/main/scala/rocket/CSR.scala:383:14, :394:28, :613:51, :919:18, :938:109, :939:34, :940:50, :946:14, :947:44, :948:17, :1001:39]
      reg_dcsr_ebreakm <= 1'h0;	// @[generators/rocket-chip/src/main/scala/rocket/CSR.scala:383:14, :402:25, :613:51, :919:18, :938:109, :939:34, :940:50, :946:14, :947:44, :948:17, :1001:39]
      reg_dcsr_cause <= 3'h0;	// @[generators/rocket-chip/src/main/scala/rocket/CSR.scala:402:25, :642:32]
      reg_dcsr_v <= 1'h0;	// @[generators/rocket-chip/src/main/scala/rocket/CSR.scala:383:14, :402:25, :613:51, :919:18, :938:109, :939:34, :940:50, :946:14, :947:44, :948:17, :1001:39]
      reg_dcsr_step <= 1'h0;	// @[generators/rocket-chip/src/main/scala/rocket/CSR.scala:383:14, :402:25, :613:51, :919:18, :938:109, :939:34, :940:50, :946:14, :947:44, :948:17, :1001:39]
      reg_debug <= 1'h0;	// @[generators/rocket-chip/src/main/scala/rocket/CSR.scala:383:14, :481:26, :613:51, :919:18, :938:109, :939:34, :940:50, :946:14, :947:44, :948:17, :1001:39]
      reg_bp_0_control_dmode <= 1'h0;	// @[generators/rocket-chip/src/main/scala/rocket/CSR.scala:383:14, :491:19, :613:51, :919:18, :938:109, :939:34, :940:50, :946:14, :947:44, :948:17, :1001:39]
      reg_bp_0_control_action <= 1'h0;	// @[generators/rocket-chip/src/main/scala/rocket/CSR.scala:383:14, :491:19, :613:51, :919:18, :938:109, :939:34, :940:50, :946:14, :947:44, :948:17, :1001:39]
      reg_bp_0_control_x <= 1'h0;	// @[generators/rocket-chip/src/main/scala/rocket/CSR.scala:383:14, :491:19, :613:51, :919:18, :938:109, :939:34, :940:50, :946:14, :947:44, :948:17, :1001:39]
      reg_bp_0_control_w <= 1'h0;	// @[generators/rocket-chip/src/main/scala/rocket/CSR.scala:383:14, :491:19, :613:51, :919:18, :938:109, :939:34, :940:50, :946:14, :947:44, :948:17, :1001:39]
      reg_bp_0_control_r <= 1'h0;	// @[generators/rocket-chip/src/main/scala/rocket/CSR.scala:383:14, :491:19, :613:51, :919:18, :938:109, :939:34, :940:50, :946:14, :947:44, :948:17, :1001:39]
      reg_mcause <= 32'h0;	// @[generators/rocket-chip/src/main/scala/rocket/CSR.scala:505:27, src/main/scala/chisel3/util/Mux.scala:30:73]
      reg_mtvec <= 32'h0;	// @[generators/rocket-chip/src/main/scala/rocket/CSR.scala:511:31, src/main/scala/chisel3/util/Mux.scala:30:73]
      reg_mcountinhibit <= 3'h0;	// @[generators/rocket-chip/src/main/scala/rocket/CSR.scala:583:34, :642:32]
      small_0 <= 6'h0;	// @[generators/rocket-chip/src/main/scala/rocket/CSR.scala:551:41, generators/rocket-chip/src/main/scala/util/Counters.scala:45:41]
      large_0 <= 58'h0;	// @[generators/rocket-chip/src/main/scala/util/Counters.scala:50:31]
      reg_misa <= 32'h40801105;	// @[generators/rocket-chip/src/main/scala/rocket/CSR.scala:641:25]
      reg_custom_0 <= 32'h208;	// @[generators/rocket-chip/src/main/scala/rocket/CSR.scala:791:43]
      io_status_cease_r <= 1'h0;	// @[generators/rocket-chip/src/main/scala/rocket/CSR.scala:383:14, :613:51, :919:18, :938:109, :939:34, :940:50, :946:14, :947:44, :948:17, :1001:39, :1152:31]
    end
    else begin
      reg_mstatus_v <= ~insn_ret & (~io_trace_0_exception_0 | trapToDebug & reg_debug) & reg_mstatus_v;	// @[generators/rocket-chip/src/main/scala/rocket/CSR.scala:394:28, :481:26, :886:83, :958:119, :1012:43, :1027:20, :1028:24, :1029:25, :1038:31, :1105:19, :1107:48]
      reg_mstatus_mpv <= _GEN_9 & (_GEN_11 ? reg_mstatus_mpv : reg_mstatus_v);	// @[generators/rocket-chip/src/main/scala/rocket/CSR.scala:394:28, :1027:20, :1028:24, :1105:19, :1107:48]
      if (_GEN_11) begin	// @[generators/rocket-chip/src/main/scala/rocket/CSR.scala:394:28, :1027:20, :1028:24]
      end
      else	// @[generators/rocket-chip/src/main/scala/rocket/CSR.scala:394:28, :1027:20, :1028:24]
        reg_mstatus_gva <= io_gva;	// @[generators/rocket-chip/src/main/scala/rocket/CSR.scala:394:28]
      if (_GEN_9 & _GEN_11) begin	// @[generators/rocket-chip/src/main/scala/rocket/CSR.scala:394:28, :1027:20, :1028:24, :1105:19, :1107:48, :1124:66, :1129:65]
      end
      else	// @[generators/rocket-chip/src/main/scala/rocket/CSR.scala:394:28, :1027:20, :1028:24, :1105:19, :1107:48, :1124:66, :1129:65]
        reg_mstatus_mpp <= 2'h3;	// @[generators/rocket-chip/src/main/scala/rocket/CSR.scala:383:14, :394:28]
      if (_csr_wen_T_4 & (&_decoded_decoded_T)) begin	// @[generators/rocket-chip/src/main/scala/rocket/CSR.scala:1105:19, :1214:18, :1218:39, :1220:23, generators/rocket-chip/src/main/scala/util/package.scala:73:59, src/main/scala/chisel3/util/pla.scala:98:{53,70}]
        reg_mstatus_mpie <= _reg_bp_0_control_WIRE_1[7];	// @[generators/rocket-chip/src/main/scala/rocket/CSR.scala:394:28, :1219:39, :1629:39]
        reg_mstatus_mie <= _reg_bp_0_control_WIRE_1[3];	// @[generators/rocket-chip/src/main/scala/rocket/CSR.scala:394:28, :1219:39, :1629:39]
      end
      else begin	// @[generators/rocket-chip/src/main/scala/rocket/CSR.scala:1105:19, :1214:18, :1218:39, :1220:23]
        reg_mstatus_mpie <= insn_ret & ~_GEN_5 | (_GEN_11 ? reg_mstatus_mpie : reg_mstatus_mie);	// @[generators/rocket-chip/src/main/scala/rocket/CSR.scala:394:28, :886:83, :1027:20, :1028:24, :1105:19, :1107:48, :1124:{48,66}, :1129:65]
        if (_GEN_9)	// @[generators/rocket-chip/src/main/scala/rocket/CSR.scala:1027:20, :1105:19, :1107:48]
          reg_mstatus_mie <= _GEN_11 & reg_mstatus_mie;	// @[generators/rocket-chip/src/main/scala/rocket/CSR.scala:394:28, :1027:20, :1028:24]
        else	// @[generators/rocket-chip/src/main/scala/rocket/CSR.scala:1027:20, :1105:19, :1107:48]
          reg_mstatus_mie <= reg_mstatus_mpie;	// @[generators/rocket-chip/src/main/scala/rocket/CSR.scala:394:28]
      end
      if (_csr_wen_T_4 & (&_decoded_decoded_T_86)) begin	// @[generators/rocket-chip/src/main/scala/rocket/CSR.scala:402:25, :1214:18, :1311:38, :1313:23, generators/rocket-chip/src/main/scala/util/package.scala:73:59, src/main/scala/chisel3/util/pla.scala:98:{53,70}]
        reg_dcsr_ebreakm <= _reg_bp_0_control_WIRE_1[15];	// @[generators/rocket-chip/src/main/scala/rocket/CSR.scala:402:25, :1312:38, :1629:39]
        reg_dcsr_step <= _reg_bp_0_control_WIRE_1[2];	// @[generators/rocket-chip/src/main/scala/rocket/CSR.scala:402:25, :1312:38, :1629:39]
      end
      if (_GEN_10) begin	// @[generators/rocket-chip/src/main/scala/rocket/CSR.scala:481:26, :1027:20, :1028:24, :1029:25, :1031:19]
        reg_dcsr_cause <= reg_singleStepped ? 3'h4 : {1'h0, causeIsDebugInt ? 2'h3 : causeIsDebugTrigger ? 2'h2 : 2'h1};	// @[generators/rocket-chip/src/main/scala/rocket/CSR.scala:383:14, :402:25, :485:30, :613:51, :919:18, :938:109, :939:34, :940:50, :946:14, :947:44, :948:17, :955:39, :956:44, :1001:39, :1033:{30,58,90}, :1052:44, :1652:39, src/main/scala/chisel3/util/Mux.scala:50:70]
        reg_dcsr_v <= reg_mstatus_v;	// @[generators/rocket-chip/src/main/scala/rocket/CSR.scala:394:28, :402:25]
      end
      reg_debug <= ~(insn_ret & _GEN_5) & (_GEN_10 | reg_debug);	// @[generators/rocket-chip/src/main/scala/rocket/CSR.scala:481:26, :886:83, :1027:20, :1028:24, :1029:25, :1031:19, :1105:19, :1107:48, :1124:{48,66}, :1127:17]
      if (_GEN_13) begin	// @[generators/rocket-chip/src/main/scala/rocket/CSR.scala:491:19, :1214:18, :1444:72, :1456:44, :1457:24]
        reg_bp_0_control_dmode <= dMode;	// @[generators/rocket-chip/src/main/scala/rocket/CSR.scala:491:19, :1464:38]
        reg_bp_0_control_action <= dMode & _newBPC_WIRE[0];	// @[generators/rocket-chip/src/main/scala/rocket/CSR.scala:491:19, :1463:96, :1464:38, :1466:{51,71,120}, :1629:39]
        reg_bp_0_control_x <= _reg_bp_0_control_WIRE_1[2];	// @[generators/rocket-chip/src/main/scala/rocket/CSR.scala:491:19, :1457:41, :1629:39]
        reg_bp_0_control_w <= _reg_bp_0_control_WIRE_1[1];	// @[generators/rocket-chip/src/main/scala/rocket/CSR.scala:491:19, :1457:41, :1629:39]
        reg_bp_0_control_r <= _reg_bp_0_control_WIRE_1[0];	// @[generators/rocket-chip/src/main/scala/rocket/CSR.scala:491:19, :1457:41, :1629:39]
      end
      if (_csr_wen_T_4 & (&_decoded_decoded_T_72))	// @[generators/rocket-chip/src/main/scala/rocket/CSR.scala:1027:20, :1214:18, :1276:{40,53}, generators/rocket-chip/src/main/scala/util/package.scala:73:59, src/main/scala/chisel3/util/pla.scala:98:{53,70}]
        reg_mcause <= _reg_bp_0_control_WIRE_1 & 32'h8000000F;	// @[generators/rocket-chip/src/main/scala/rocket/CSR.scala:505:27, :1276:62, :1629:39]
      else if (_GEN_11) begin	// @[generators/rocket-chip/src/main/scala/rocket/CSR.scala:394:28, :505:27, :1027:20, :1028:24]
      end
      else	// @[generators/rocket-chip/src/main/scala/rocket/CSR.scala:505:27, :1027:20, :1028:24]
        reg_mcause <= cause;	// @[generators/rocket-chip/src/main/scala/rocket/CSR.scala:505:27, :952:8]
      if (_csr_wen_T_4 & (&_decoded_decoded_T_6))	// @[generators/rocket-chip/src/main/scala/rocket/CSR.scala:511:31, :1214:18, :1275:{40,52}, generators/rocket-chip/src/main/scala/util/package.scala:73:59, src/main/scala/chisel3/util/pla.scala:98:{53,70}]
        reg_mtvec <= _reg_bp_0_control_WIRE_1;	// @[generators/rocket-chip/src/main/scala/rocket/CSR.scala:511:31, :1629:39]
      if (_csr_wen_T_4 & (&_decoded_decoded_T_8))	// @[generators/rocket-chip/src/main/scala/rocket/CSR.scala:583:34, :1214:18, :1296:{47,67}, generators/rocket-chip/src/main/scala/util/package.scala:73:59, src/main/scala/chisel3/util/pla.scala:98:{53,70}]
        reg_mcountinhibit <= _wdata_T_2[2:0] & _wdata_T_6[2:0] & 3'h5;	// @[generators/rocket-chip/src/main/scala/rocket/CSR.scala:583:34, :1296:{67,76}, :1629:{30,39,41}, src/main/scala/chisel3/util/Mux.scala:50:70]
      if (_csr_wen_T_4) begin	// @[generators/rocket-chip/src/main/scala/util/package.scala:73:59]
        if (&_decoded_decoded_T_158)	// @[src/main/scala/chisel3/util/pla.scala:98:{53,70}]
          large_0 <= {_reg_bp_0_control_WIRE_1, large_0[25:0]};	// @[generators/rocket-chip/src/main/scala/rocket/CSR.scala:1629:39, generators/rocket-chip/src/main/scala/util/Counters.scala:50:31, :55:30, :68:28]
        else if (&_decoded_decoded_T_96) begin	// @[src/main/scala/chisel3/util/pla.scala:98:{53,70}]
          small_0 <= _reg_bp_0_control_WIRE_1[5:0];	// @[generators/rocket-chip/src/main/scala/rocket/CSR.scala:1629:39, generators/rocket-chip/src/main/scala/util/Counters.scala:45:41, :67:11]
          large_0 <= {large_0[57:26], _reg_bp_0_control_WIRE_1[31:6]};	// @[generators/rocket-chip/src/main/scala/rocket/CSR.scala:728:54, :1629:39, generators/rocket-chip/src/main/scala/util/Counters.scala:50:31, :68:28]
        end
        else begin	// @[src/main/scala/chisel3/util/pla.scala:98:70]
          if (reg_mcountinhibit[2]) begin	// @[generators/rocket-chip/src/main/scala/rocket/CSR.scala:583:34, :585:75]
          end
          else	// @[generators/rocket-chip/src/main/scala/rocket/CSR.scala:585:75]
            small_0 <= nextSmall[5:0];	// @[generators/rocket-chip/src/main/scala/util/Counters.scala:45:41, :46:33, :47:27]
          if (_large_T_2)	// @[generators/rocket-chip/src/main/scala/util/Counters.scala:51:33]
            large_0 <= _large_r_T;	// @[generators/rocket-chip/src/main/scala/util/Counters.scala:50:31, :51:55]
        end
      end
      else begin	// @[generators/rocket-chip/src/main/scala/util/package.scala:73:59]
        if (reg_mcountinhibit[2]) begin	// @[generators/rocket-chip/src/main/scala/rocket/CSR.scala:583:34, :585:75]
        end
        else	// @[generators/rocket-chip/src/main/scala/rocket/CSR.scala:585:75]
          small_0 <= nextSmall[5:0];	// @[generators/rocket-chip/src/main/scala/util/Counters.scala:45:41, :46:33, :47:27]
        if (_large_T_2)	// @[generators/rocket-chip/src/main/scala/util/Counters.scala:51:33]
          large_0 <= _large_r_T;	// @[generators/rocket-chip/src/main/scala/util/Counters.scala:50:31, :51:55]
      end
      if (_csr_wen_T_4 & (&_decoded_decoded_T_2) & (~(io_pc[1]) | _wdata_T_2[2] & _wdata_T_6[2]))	// @[generators/rocket-chip/src/main/scala/rocket/CSR.scala:641:25, :1214:18, :1247:36, :1251:{35,41,45,53,66}, :1253:20, :1629:{30,39,41}, generators/rocket-chip/src/main/scala/util/package.scala:73:59, src/main/scala/chisel3/util/pla.scala:98:{53,70}]
        reg_misa <= ~{_reg_misa_T[31:4], _reg_misa_T[3:0] | {~(_wdata_T_2[5] & _wdata_T_6[5]), 3'h0}} & 32'h1005 | reg_misa & 32'hFFFFEFFA;	// @[generators/rocket-chip/src/main/scala/rocket/CSR.scala:641:25, :642:32, :1249:20, :1253:{23,25,32,35,38,55,62,73,75}, :1629:{30,39,41}]
      if (_csr_wen_T_4 & (&_decoded_decoded_T_92))	// @[generators/rocket-chip/src/main/scala/rocket/CSR.scala:791:43, :1214:18, :1491:35, :1492:13, generators/rocket-chip/src/main/scala/util/package.scala:73:59, src/main/scala/chisel3/util/pla.scala:98:{53,70}]
        reg_custom_0 <= _reg_bp_0_control_WIRE_1 & 32'h208 | reg_custom_0 & 32'hFFFFFDF7;	// @[generators/rocket-chip/src/main/scala/rocket/CSR.scala:791:43, :1492:{23,31,38,40}, :1629:39]
      io_status_cease_r <= system_insn & (&{io_rw_addr[2], _GEN_2[3], _GEN_2[4], _GEN_2[5], _GEN_2[6], _GEN_2[7], io_rw_addr[8], io_rw_addr[9], _GEN_2[10], _GEN_2[11]}) | io_status_cease_r;	// @[generators/rocket-chip/src/main/scala/rocket/CSR.scala:869:31, :886:83, :1152:31, src/main/scala/chisel3/util/pla.scala:78:21, :90:45, :91:29, :98:{53,70}]
    end
    if (_csr_wen_T_4 & (&_decoded_decoded_T_88))	// @[generators/rocket-chip/src/main/scala/rocket/CSR.scala:1027:20, :1214:18, :1320:{42,52}, generators/rocket-chip/src/main/scala/util/package.scala:73:59, src/main/scala/chisel3/util/pla.scala:98:{53,70}]
      reg_dpc <= {_reg_bp_0_control_WIRE_1[31:1], 1'h0};	// @[generators/rocket-chip/src/main/scala/rocket/CSR.scala:383:14, :482:20, :613:51, :919:18, :938:109, :939:34, :940:50, :946:14, :947:44, :948:17, :1001:39, :1629:39, :1650:31]
    else if (_GEN_10)	// @[generators/rocket-chip/src/main/scala/rocket/CSR.scala:481:26, :1027:20, :1028:24, :1029:25, :1031:19]
      reg_dpc <= epc;	// @[generators/rocket-chip/src/main/scala/rocket/CSR.scala:482:20, :1650:31]
    if (_csr_wen_T_4 & (&_decoded_decoded_T_90))	// @[generators/rocket-chip/src/main/scala/rocket/CSR.scala:483:26, :1214:18, :1321:{43,59}, generators/rocket-chip/src/main/scala/util/package.scala:73:59, src/main/scala/chisel3/util/pla.scala:98:{53,70}]
      reg_dscratch0 <= _reg_bp_0_control_WIRE_1;	// @[generators/rocket-chip/src/main/scala/rocket/CSR.scala:483:26, :1629:39]
    reg_singleStepped <= io_singleStep_0 & (io_retire | io_trace_0_exception_0 | reg_singleStepped);	// @[generators/rocket-chip/src/main/scala/rocket/CSR.scala:485:30, :993:34, :1012:43, :1019:{36,56}, :1020:{25,45}]
    if (_GEN_13)	// @[generators/rocket-chip/src/main/scala/rocket/CSR.scala:491:19, :1214:18, :1444:72, :1456:44, :1457:24]
      reg_bp_0_control_tmatch <= _reg_bp_0_control_WIRE_1[8:7];	// @[generators/rocket-chip/src/main/scala/rocket/CSR.scala:491:19, :1457:41, :1629:39]
    if (_csr_wen_T_4 & _GEN_12 & (&_decoded_decoded_T_82))	// @[generators/rocket-chip/src/main/scala/rocket/CSR.scala:491:19, :1214:18, :1444:{57,72}, :1445:{44,57}, generators/rocket-chip/src/main/scala/util/package.scala:73:59, src/main/scala/chisel3/util/pla.scala:98:{53,70}]
      reg_bp_0_address <= _reg_bp_0_control_WIRE_1;	// @[generators/rocket-chip/src/main/scala/rocket/CSR.scala:491:19, :1629:39]
    if (_csr_wen_T_4 & (&_decoded_decoded_T_4))	// @[generators/rocket-chip/src/main/scala/rocket/CSR.scala:494:20, :1214:18, :1271:{40,50}, generators/rocket-chip/src/main/scala/util/package.scala:73:59, src/main/scala/chisel3/util/pla.scala:98:{53,70}]
      reg_mie <= {16'h0, _wdata_T_2[15:0] & _wdata_T_6[15:0] & 16'h888};	// @[generators/rocket-chip/src/main/scala/rocket/CSR.scala:430:10, :494:20, :1271:59, :1629:{30,39,41}, src/main/scala/chisel3/util/Mux.scala:30:73]
    if (_csr_wen_T_4 & (&_decoded_decoded_T_70))	// @[generators/rocket-chip/src/main/scala/rocket/CSR.scala:1027:20, :1214:18, :1272:{40,51}, generators/rocket-chip/src/main/scala/util/package.scala:73:59, src/main/scala/chisel3/util/pla.scala:98:{53,70}]
      reg_mepc <= {_reg_bp_0_control_WIRE_1[31:1], 1'h0};	// @[generators/rocket-chip/src/main/scala/rocket/CSR.scala:383:14, :504:21, :613:51, :919:18, :938:109, :939:34, :940:50, :946:14, :947:44, :948:17, :1001:39, :1629:39, :1650:31]
    else if (_GEN_11) begin	// @[generators/rocket-chip/src/main/scala/rocket/CSR.scala:394:28, :504:21, :1027:20, :1028:24]
    end
    else	// @[generators/rocket-chip/src/main/scala/rocket/CSR.scala:504:21, :1027:20, :1028:24]
      reg_mepc <= epc;	// @[generators/rocket-chip/src/main/scala/rocket/CSR.scala:504:21, :1650:31]
    if (_csr_wen_T_4 & (&_decoded_decoded_T_74))	// @[generators/rocket-chip/src/main/scala/rocket/CSR.scala:1027:20, :1214:18, :1277:{40,52}, generators/rocket-chip/src/main/scala/util/package.scala:73:59, src/main/scala/chisel3/util/pla.scala:98:{53,70}]
      reg_mtval <= _reg_bp_0_control_WIRE_1;	// @[generators/rocket-chip/src/main/scala/rocket/CSR.scala:506:22, :1629:39]
    else if (_GEN_11) begin	// @[generators/rocket-chip/src/main/scala/rocket/CSR.scala:394:28, :506:22, :1027:20, :1028:24]
    end
    else	// @[generators/rocket-chip/src/main/scala/rocket/CSR.scala:506:22, :1027:20, :1028:24]
      reg_mtval <= insn_break ? epc : io_tval;	// @[generators/rocket-chip/src/main/scala/rocket/CSR.scala:506:22, :886:83, :1025:17, :1650:31]
    if (_csr_wen_T_4 & (&_decoded_decoded_T_68))	// @[generators/rocket-chip/src/main/scala/rocket/CSR.scala:508:25, :1214:18, :1273:{40,55}, generators/rocket-chip/src/main/scala/util/package.scala:73:59, src/main/scala/chisel3/util/pla.scala:98:{53,70}]
      reg_mscratch <= _reg_bp_0_control_WIRE_1;	// @[generators/rocket-chip/src/main/scala/rocket/CSR.scala:508:25, :1629:39]
  end // always @(posedge)
  wire [6:0]  nextSmall_1 = {1'h0, small_1} + {6'h0, ~io_csr_stall_0};	// @[generators/rocket-chip/src/main/scala/rocket/CSR.scala:383:14, :551:41, :587:56, :613:51, :919:18, :938:109, :939:34, :940:50, :946:14, :947:44, :948:17, :1001:39, :1151:27, generators/rocket-chip/src/main/scala/util/Counters.scala:45:41, :46:33]
  wire        _large_T_5 = nextSmall_1[6] & ~(reg_mcountinhibit[0]);	// @[generators/rocket-chip/src/main/scala/rocket/CSR.scala:583:34, :584:40, generators/rocket-chip/src/main/scala/util/Counters.scala:46:33, :47:9, :51:{20,33}]
  wire [57:0] _large_r_T_2 = large_1 + 58'h1;	// @[generators/rocket-chip/src/main/scala/util/Counters.scala:50:31, :51:55]
  always @(posedge io_ungated_clock) begin	// @[generators/rocket-chip/src/main/scala/rocket/CSR.scala:383:14]
    if (reset) begin	// @[generators/rocket-chip/src/main/scala/rocket/CSR.scala:383:14]
      reg_wfi <= 1'h0;	// @[generators/rocket-chip/src/main/scala/rocket/CSR.scala:383:14, :574:54, :613:51, :919:18, :938:109, :939:34, :940:50, :946:14, :947:44, :948:17, :1001:39]
      small_1 <= 6'h0;	// @[generators/rocket-chip/src/main/scala/rocket/CSR.scala:551:41, generators/rocket-chip/src/main/scala/util/Counters.scala:45:41]
      large_1 <= 58'h0;	// @[generators/rocket-chip/src/main/scala/util/Counters.scala:50:31]
    end
    else begin	// @[generators/rocket-chip/src/main/scala/rocket/CSR.scala:383:14]
      reg_wfi <= ~((|{_GEN[11], _GEN[7], _GEN[3]}) | io_interrupts_debug | io_trace_0_exception_0) & (system_insn & (&{io_rw_addr[8], _GEN_2[9], _GEN_2[10], _GEN_2[11]}) & ~io_singleStep_0 & ~reg_debug | reg_wfi);	// @[generators/rocket-chip/src/main/scala/rocket/CSR.scala:481:26, :574:54, :607:56, :619:36, :869:31, :920:45, :993:34, :1012:43, :1015:{36,51,61}, :1016:{28,55,69,79}, src/main/scala/chisel3/util/pla.scala:78:21, :90:45, :91:29, :98:{53,70}]
      if (_csr_wen_T_4) begin	// @[generators/rocket-chip/src/main/scala/util/package.scala:73:59]
        if (&_decoded_decoded_T_156)	// @[src/main/scala/chisel3/util/pla.scala:98:{53,70}]
          large_1 <= {_reg_bp_0_control_WIRE_1, large_1[25:0]};	// @[generators/rocket-chip/src/main/scala/rocket/CSR.scala:1150:11, :1629:39, generators/rocket-chip/src/main/scala/util/Counters.scala:50:31, :68:28]
        else if (&_decoded_decoded_T_94) begin	// @[src/main/scala/chisel3/util/pla.scala:98:{53,70}]
          small_1 <= _reg_bp_0_control_WIRE_1[5:0];	// @[generators/rocket-chip/src/main/scala/rocket/CSR.scala:1629:39, generators/rocket-chip/src/main/scala/util/Counters.scala:45:41, :67:11]
          large_1 <= {large_1[57:26], _reg_bp_0_control_WIRE_1[31:6]};	// @[generators/rocket-chip/src/main/scala/rocket/CSR.scala:727:50, :1629:39, generators/rocket-chip/src/main/scala/util/Counters.scala:50:31, :68:28]
        end
        else begin	// @[src/main/scala/chisel3/util/pla.scala:98:70]
          if (reg_mcountinhibit[0]) begin	// @[generators/rocket-chip/src/main/scala/rocket/CSR.scala:583:34, :584:40]
          end
          else	// @[generators/rocket-chip/src/main/scala/rocket/CSR.scala:584:40]
            small_1 <= nextSmall_1[5:0];	// @[generators/rocket-chip/src/main/scala/util/Counters.scala:45:41, :46:33, :47:27]
          if (_large_T_5)	// @[generators/rocket-chip/src/main/scala/util/Counters.scala:51:33]
            large_1 <= _large_r_T_2;	// @[generators/rocket-chip/src/main/scala/util/Counters.scala:50:31, :51:55]
        end
      end
      else begin	// @[generators/rocket-chip/src/main/scala/util/package.scala:73:59]
        if (reg_mcountinhibit[0]) begin	// @[generators/rocket-chip/src/main/scala/rocket/CSR.scala:583:34, :584:40]
        end
        else	// @[generators/rocket-chip/src/main/scala/rocket/CSR.scala:584:40]
          small_1 <= nextSmall_1[5:0];	// @[generators/rocket-chip/src/main/scala/util/Counters.scala:45:41, :46:33, :47:27]
        if (_large_T_5)	// @[generators/rocket-chip/src/main/scala/util/Counters.scala:51:33]
          large_1 <= _large_r_T_2;	// @[generators/rocket-chip/src/main/scala/util/Counters.scala:50:31, :51:55]
      end
    end
  end // always @(posedge)
  `ifdef ENABLE_INITIAL_REG_
    `ifdef FIRRTL_BEFORE_INITIAL
      `FIRRTL_BEFORE_INITIAL
    `endif // FIRRTL_BEFORE_INITIAL
    logic [31:0] _RANDOM[0:64];
    initial begin
      `ifdef INIT_RANDOM_PROLOG_
        `INIT_RANDOM_PROLOG_
      `endif // INIT_RANDOM_PROLOG_
      `ifdef RANDOMIZE_REG_INIT
        for (logic [6:0] i = 7'h0; i < 7'h41; i += 7'h1) begin
          _RANDOM[i] = `RANDOM;
        end
        reg_mstatus_v = _RANDOM[7'h1][8];	// @[generators/rocket-chip/src/main/scala/rocket/CSR.scala:394:28]
        reg_mstatus_mpv = _RANDOM[7'h2][1];	// @[generators/rocket-chip/src/main/scala/rocket/CSR.scala:394:28]
        reg_mstatus_gva = _RANDOM[7'h2][2];	// @[generators/rocket-chip/src/main/scala/rocket/CSR.scala:394:28]
        reg_mstatus_mpp = _RANDOM[7'h2][29:28];	// @[generators/rocket-chip/src/main/scala/rocket/CSR.scala:394:28]
        reg_mstatus_mpie = _RANDOM[7'h3][1];	// @[generators/rocket-chip/src/main/scala/rocket/CSR.scala:394:28]
        reg_mstatus_mie = _RANDOM[7'h3][5];	// @[generators/rocket-chip/src/main/scala/rocket/CSR.scala:394:28]
        reg_dcsr_ebreakm = _RANDOM[7'h3][25];	// @[generators/rocket-chip/src/main/scala/rocket/CSR.scala:394:28, :402:25]
        reg_dcsr_cause = _RANDOM[7'h4][2:0];	// @[generators/rocket-chip/src/main/scala/rocket/CSR.scala:402:25]
        reg_dcsr_v = _RANDOM[7'h4][3];	// @[generators/rocket-chip/src/main/scala/rocket/CSR.scala:402:25]
        reg_dcsr_step = _RANDOM[7'h4][6];	// @[generators/rocket-chip/src/main/scala/rocket/CSR.scala:402:25]
        reg_debug = _RANDOM[7'h4][9];	// @[generators/rocket-chip/src/main/scala/rocket/CSR.scala:402:25, :481:26]
        reg_dpc = {_RANDOM[7'h4][31:10], _RANDOM[7'h5][9:0]};	// @[generators/rocket-chip/src/main/scala/rocket/CSR.scala:402:25, :482:20]
        reg_dscratch0 = {_RANDOM[7'h5][31:10], _RANDOM[7'h6][9:0]};	// @[generators/rocket-chip/src/main/scala/rocket/CSR.scala:482:20, :483:26]
        reg_singleStepped = _RANDOM[7'h6][10];	// @[generators/rocket-chip/src/main/scala/rocket/CSR.scala:483:26, :485:30]
        reg_bp_0_control_dmode = _RANDOM[7'h6][16];	// @[generators/rocket-chip/src/main/scala/rocket/CSR.scala:483:26, :491:19]
        reg_bp_0_control_action = _RANDOM[7'h6][31];	// @[generators/rocket-chip/src/main/scala/rocket/CSR.scala:483:26, :491:19]
        reg_bp_0_control_tmatch = _RANDOM[7'h7][4:3];	// @[generators/rocket-chip/src/main/scala/rocket/CSR.scala:491:19]
        reg_bp_0_control_x = _RANDOM[7'h7][9];	// @[generators/rocket-chip/src/main/scala/rocket/CSR.scala:491:19]
        reg_bp_0_control_w = _RANDOM[7'h7][10];	// @[generators/rocket-chip/src/main/scala/rocket/CSR.scala:491:19]
        reg_bp_0_control_r = _RANDOM[7'h7][11];	// @[generators/rocket-chip/src/main/scala/rocket/CSR.scala:491:19]
        reg_bp_0_address = {_RANDOM[7'h7][31:12], _RANDOM[7'h8][11:0]};	// @[generators/rocket-chip/src/main/scala/rocket/CSR.scala:491:19]
        reg_mie = _RANDOM[7'hC];	// @[generators/rocket-chip/src/main/scala/rocket/CSR.scala:494:20]
        reg_mepc = {_RANDOM[7'hF][31:16], _RANDOM[7'h10][15:0]};	// @[generators/rocket-chip/src/main/scala/rocket/CSR.scala:504:21]
        reg_mcause = {_RANDOM[7'h10][31:16], _RANDOM[7'h11][15:0]};	// @[generators/rocket-chip/src/main/scala/rocket/CSR.scala:504:21, :505:27]
        reg_mtval = {_RANDOM[7'h11][31:16], _RANDOM[7'h12][15:0]};	// @[generators/rocket-chip/src/main/scala/rocket/CSR.scala:505:27, :506:22]
        reg_mscratch = {_RANDOM[7'h13][31:16], _RANDOM[7'h14][15:0]};	// @[generators/rocket-chip/src/main/scala/rocket/CSR.scala:508:25]
        reg_mtvec = {_RANDOM[7'h14][31:16], _RANDOM[7'h15][15:0]};	// @[generators/rocket-chip/src/main/scala/rocket/CSR.scala:508:25, :511:31]
        reg_wfi = _RANDOM[7'h37][7];	// @[generators/rocket-chip/src/main/scala/rocket/CSR.scala:574:54]
        reg_mcountinhibit = _RANDOM[7'h37][18:16];	// @[generators/rocket-chip/src/main/scala/rocket/CSR.scala:574:54, :583:34]
        small_0 = _RANDOM[7'h37][24:19];	// @[generators/rocket-chip/src/main/scala/rocket/CSR.scala:574:54, generators/rocket-chip/src/main/scala/util/Counters.scala:45:41]
        large_0 = {_RANDOM[7'h37][31:25], _RANDOM[7'h38], _RANDOM[7'h39][18:0]};	// @[generators/rocket-chip/src/main/scala/rocket/CSR.scala:574:54, generators/rocket-chip/src/main/scala/util/Counters.scala:50:31]
        small_1 = _RANDOM[7'h39][24:19];	// @[generators/rocket-chip/src/main/scala/util/Counters.scala:45:41, :50:31]
        large_1 = {_RANDOM[7'h39][31:25], _RANDOM[7'h3A], _RANDOM[7'h3B][18:0]};	// @[generators/rocket-chip/src/main/scala/util/Counters.scala:50:31]
        reg_misa = {_RANDOM[7'h3B][31:19], _RANDOM[7'h3C][18:0]};	// @[generators/rocket-chip/src/main/scala/rocket/CSR.scala:641:25, generators/rocket-chip/src/main/scala/util/Counters.scala:50:31]
        reg_custom_0 = {_RANDOM[7'h3C][31:19], _RANDOM[7'h3D][18:0]};	// @[generators/rocket-chip/src/main/scala/rocket/CSR.scala:641:25, :791:43]
        io_status_cease_r = _RANDOM[7'h40][19];	// @[generators/rocket-chip/src/main/scala/rocket/CSR.scala:1152:31]
      `endif // RANDOMIZE_REG_INIT
    end // initial
    `ifdef FIRRTL_AFTER_INITIAL
      `FIRRTL_AFTER_INITIAL
    `endif // FIRRTL_AFTER_INITIAL
  `endif // ENABLE_INITIAL_REG_
  assign io_rw_rdata = io_rw_rdata_0;	// @[src/main/scala/chisel3/util/Mux.scala:30:73]
  assign io_decode_0_read_illegal = ~csr_exists | (&{io_decode_0_inst[24], io_decode_0_inst[25], io_decode_0_read_illegal_invInputs[0], io_decode_0_inst[27], io_decode_0_inst[28], io_decode_0_inst[29], io_decode_0_inst[30], io_decode_0_read_illegal_invInputs[5]}) & ~reg_debug;	// @[generators/rocket-chip/src/main/scala/rocket/CSR.scala:481:26, :892:111, :917:7, :919:36, :920:{42,45}, src/main/scala/chisel3/util/pla.scala:78:21, :90:45, :91:29, :98:{53,70}]
  assign io_decode_0_write_illegal = &(io_decode_0_inst[31:30]);	// @[generators/rocket-chip/src/main/scala/rocket/CSR.scala:890:27, :923:{33,41}]
  assign io_decode_0_write_flush = ~(io_decode_0_write_flush_addr_m > 12'h33F & io_decode_0_write_flush_addr_m < 12'h344);	// @[generators/rocket-chip/src/main/scala/rocket/CSR.scala:892:93, :925:25, :926:{7,16,35,45}]
  assign io_decode_0_system_illegal = (|{&{decoded_invInputs_1[0], decoded_invInputs_1[1], decoded_invInputs_1[2], decoded_invInputs_1[3], decoded_invInputs_1[4], decoded_invInputs_1[5], io_decode_0_inst[28], io_decode_0_inst[29], decoded_invInputs_1[8], decoded_invInputs_1[9]}, &{io_decode_0_inst[30], decoded_invInputs_1[9]}}) & io_decode_0_inst[30] & io_decode_0_inst[27] & ~reg_debug;	// @[generators/rocket-chip/src/main/scala/rocket/CSR.scala:481:26, :890:27, :920:45, :931:{21,33,37}, src/main/scala/chisel3/util/pla.scala:78:21, :90:45, :91:29, :98:{53,70}, :114:{19,36}]
  assign io_decode_0_virtual_access_illegal = reg_mstatus_v & csr_exists & (io_decode_0_inst[29:28] == 2'h2 | (io_decode_0_inst[31:20] > 12'hBFF & io_decode_0_inst[31:20] < 12'hC20 | io_decode_0_inst[31:20] > 12'hC7F & io_decode_0_inst[31:20] < 12'hCA0) & _io_decode_0_virtual_access_illegal_T_3[0] & ~(_io_decode_0_virtual_access_illegal_T_6[0]));	// @[generators/rocket-chip/src/main/scala/rocket/CSR.scala:190:36, :394:28, :890:27, :892:111, :897:81, :905:70, :907:63, :936:66, :937:{22,34}, :938:{36,51,55,71}, :1652:39, generators/rocket-chip/src/main/scala/util/package.scala:205:{47,55,60}]
  assign io_decode_0_virtual_system_illegal = 1'h0;	// @[generators/rocket-chip/src/main/scala/rocket/CSR.scala:383:14, :613:51, :919:18, :938:109, :939:34, :940:50, :946:14, :947:44, :948:17, :1001:39]
  assign io_csr_stall = io_csr_stall_0;	// @[generators/rocket-chip/src/main/scala/rocket/CSR.scala:1151:27]
  assign io_eret = _exception_T | insn_ret;	// @[generators/rocket-chip/src/main/scala/rocket/CSR.scala:886:83, :992:{24,38}]
  assign io_singleStep = io_singleStep_0;	// @[generators/rocket-chip/src/main/scala/rocket/CSR.scala:993:34]
  assign io_status_debug = reg_debug;	// @[generators/rocket-chip/src/main/scala/rocket/CSR.scala:481:26]
  assign io_status_wfi = reg_wfi;	// @[generators/rocket-chip/src/main/scala/rocket/CSR.scala:574:54]
  assign io_status_isa = reg_misa;	// @[generators/rocket-chip/src/main/scala/rocket/CSR.scala:641:25]
  assign io_status_dv = reg_mstatus_v;	// @[generators/rocket-chip/src/main/scala/rocket/CSR.scala:394:28]
  assign io_status_v = reg_mstatus_v;	// @[generators/rocket-chip/src/main/scala/rocket/CSR.scala:394:28]
  assign io_evec = insn_ret ? (_GEN_5 ? ~{_io_evec_T_10[31:2], _io_evec_T_10[1:0] | {~(reg_misa[2]), 1'h1}} : ~{_io_evec_T_20[31:2], _io_evec_T_20[1:0] | {~(reg_misa[2]), 1'h1}}) : trapToDebug ? {20'h0, reg_debug ? {8'h80, ~insn_break, 3'h0} : 12'h800} : {reg_mtvec[0] & _GEN_0[0] & cause[31] & cause[7:5] == 3'h0 ? {reg_mtvec[31:7], cause[4:0]} : reg_mtvec[31:2] & {25'h1FFFFFF, _GEN_0[6:2]}, 2'h0};	// @[generators/rocket-chip/src/main/scala/rocket/CSR.scala:383:14, :481:26, :511:31, :641:25, :642:32, :663:27, :885:44, :886:83, :938:105, :952:8, :954:25, :955:30, :957:62, :958:119, :961:{22,37}, :971:32, :972:{27,33}, :973:{24,55,70,94}, :974:{8,38}, :987:17, :988:11, :1105:19, :1107:48, :1124:{48,66}, :1128:15, :1129:65, :1651:{26,28,31,36,45}, generators/rocket-chip/src/main/scala/util/package.scala:166:{35,37}]
  assign io_time = {large_1[25:0], small_1};	// @[generators/rocket-chip/src/main/scala/rocket/CSR.scala:1150:11, generators/rocket-chip/src/main/scala/util/Counters.scala:45:41, :50:31]
  assign io_interrupt = ((io_interrupts_debug | m_interrupts[15] | m_interrupts[14] | m_interrupts[13] | m_interrupts[12] | m_interrupts[11] | m_interrupts[3] | m_interrupts[7] | m_interrupts[9] | m_interrupts[1] | m_interrupts[5] | m_interrupts[10] | m_interrupts[2] | m_interrupts[6] | m_interrupts[8] | m_interrupts[0] | m_interrupts[4]) & ~io_singleStep_0 | reg_singleStepped) & ~(reg_debug | io_status_cease_r);	// @[generators/rocket-chip/src/main/scala/rocket/CSR.scala:481:26, :485:30, :613:25, :619:{33,36,51,73,76,88}, :993:34, :1152:31, :1623:{76,90}]
  assign io_interrupt_cause = {28'h0, io_interrupts_debug ? 4'hE : m_interrupts[15] ? 4'hF : m_interrupts[14] ? 4'hE : m_interrupts[13] ? 4'hD : m_interrupts[12] ? 4'hC : m_interrupts[11] ? 4'hB : m_interrupts[3] ? 4'h3 : m_interrupts[7] ? 4'h7 : m_interrupts[9] ? 4'h9 : m_interrupts[1] ? 4'h1 : m_interrupts[5] ? 4'h5 : m_interrupts[10] ? 4'hA : m_interrupts[2] ? 4'h2 : m_interrupts[6] ? 4'h6 : m_interrupts[8] ? 4'h8 : {1'h0, ~(m_interrupts[0]), 2'h0}} - 32'h80000000;	// @[generators/rocket-chip/src/main/scala/rocket/CSR.scala:383:14, :613:{25,51}, :618:63, :642:32, :663:27, :919:18, :938:109, :939:34, :940:50, :946:14, :947:44, :948:17, :952:8, :957:62, :1001:39, :1623:76, src/main/scala/chisel3/util/Mux.scala:50:70]
  assign io_bp_0_control_action = reg_bp_0_control_action;	// @[generators/rocket-chip/src/main/scala/rocket/CSR.scala:491:19]
  assign io_bp_0_control_tmatch = reg_bp_0_control_tmatch;	// @[generators/rocket-chip/src/main/scala/rocket/CSR.scala:491:19]
  assign io_bp_0_control_x = reg_bp_0_control_x;	// @[generators/rocket-chip/src/main/scala/rocket/CSR.scala:491:19]
  assign io_bp_0_control_w = reg_bp_0_control_w;	// @[generators/rocket-chip/src/main/scala/rocket/CSR.scala:491:19]
  assign io_bp_0_control_r = reg_bp_0_control_r;	// @[generators/rocket-chip/src/main/scala/rocket/CSR.scala:491:19]
  assign io_bp_0_address = reg_bp_0_address;	// @[generators/rocket-chip/src/main/scala/rocket/CSR.scala:491:19]
  assign io_inhibit_cycle = reg_mcountinhibit[0];	// @[generators/rocket-chip/src/main/scala/rocket/CSR.scala:583:34, :584:40]
  assign io_trace_0_valid = io_retire | io_trace_0_exception_0;	// @[generators/rocket-chip/src/main/scala/rocket/CSR.scala:1012:43, :1607:32]
  assign io_trace_0_iaddr = io_pc;
  assign io_trace_0_insn = io_inst_0;
  assign io_trace_0_exception = io_trace_0_exception_0;	// @[generators/rocket-chip/src/main/scala/rocket/CSR.scala:1012:43]
  assign io_customCSRs_0_value = reg_custom_0;	// @[generators/rocket-chip/src/main/scala/rocket/CSR.scala:791:43]
endmodule

