// Generated by CIRCT unknown git version
// Standard header to adapt well known macros for register randomization.
`ifndef RANDOMIZE
  `ifdef RANDOMIZE_MEM_INIT
    `define RANDOMIZE
  `endif // RANDOMIZE_MEM_INIT
`endif // not def RANDOMIZE
`ifndef RANDOMIZE
  `ifdef RANDOMIZE_REG_INIT
    `define RANDOMIZE
  `endif // RANDOMIZE_REG_INIT
`endif // not def RANDOMIZE

// RANDOM may be set to an expression that produces a 32-bit random unsigned value.
`ifndef RANDOM
  `define RANDOM $random
`endif // not def RANDOM

// Users can define INIT_RANDOM as general code that gets injected into the
// initializer block for modules with registers.
`ifndef INIT_RANDOM
  `define INIT_RANDOM
`endif // not def INIT_RANDOM

// If using random initialization, you can also define RANDOMIZE_DELAY to
// customize the delay used, otherwise 0.002 is used.
`ifndef RANDOMIZE_DELAY
  `define RANDOMIZE_DELAY 0.002
`endif // not def RANDOMIZE_DELAY

// Define INIT_RANDOM_PROLOG_ for use in our modules below.
`ifndef INIT_RANDOM_PROLOG_
  `ifdef RANDOMIZE
    `ifdef VERILATOR
      `define INIT_RANDOM_PROLOG_ `INIT_RANDOM
    `else  // VERILATOR
      `define INIT_RANDOM_PROLOG_ `INIT_RANDOM #`RANDOMIZE_DELAY begin end
    `endif // VERILATOR
  `else  // RANDOMIZE
    `define INIT_RANDOM_PROLOG_
  `endif // RANDOMIZE
`endif // not def INIT_RANDOM_PROLOG_

// Include register initializers in init blocks unless synthesis is set
`ifndef SYNTHESIS
  `ifndef ENABLE_INITIAL_REG_
    `define ENABLE_INITIAL_REG_
  `endif // not def ENABLE_INITIAL_REG_
`endif // not def SYNTHESIS

// Include rmemory initializers in init blocks unless synthesis is set
`ifndef SYNTHESIS
  `ifndef ENABLE_INITIAL_MEM_
    `define ENABLE_INITIAL_MEM_
  `endif // not def ENABLE_INITIAL_MEM_
`endif // not def SYNTHESIS

// Standard header to adapt well known macros for prints and assertions.

// Users can define 'PRINTF_COND' to add an extra gate to prints.
`ifndef PRINTF_COND_
  `ifdef PRINTF_COND
    `define PRINTF_COND_ (`PRINTF_COND)
  `else  // PRINTF_COND
    `define PRINTF_COND_ 1
  `endif // PRINTF_COND
`endif // not def PRINTF_COND_

// Users can define 'ASSERT_VERBOSE_COND' to add an extra gate to assert error printing.
`ifndef ASSERT_VERBOSE_COND_
  `ifdef ASSERT_VERBOSE_COND
    `define ASSERT_VERBOSE_COND_ (`ASSERT_VERBOSE_COND)
  `else  // ASSERT_VERBOSE_COND
    `define ASSERT_VERBOSE_COND_ 1
  `endif // ASSERT_VERBOSE_COND
`endif // not def ASSERT_VERBOSE_COND_

// Users can define 'STOP_COND' to add an extra gate to stop conditions.
`ifndef STOP_COND_
  `ifdef STOP_COND
    `define STOP_COND_ (`STOP_COND)
  `else  // STOP_COND
    `define STOP_COND_ 1
  `endif // STOP_COND
`endif // not def STOP_COND_

module DMAPacketDisassembler(
  input         clock,
                reset,
  output        io_dmaIn_ready,	// @[generators/dma/src/main/scala/dma/DMA.scala:67:14]
  input         io_dmaIn_valid,	// @[generators/dma/src/main/scala/dma/DMA.scala:67:14]
  input  [31:0] io_dmaIn_bits,	// @[generators/dma/src/main/scala/dma/DMA.scala:67:14]
  input         io_consumer_data_ready,	// @[generators/dma/src/main/scala/dma/DMA.scala:67:14]
  output        io_consumer_data_valid,	// @[generators/dma/src/main/scala/dma/DMA.scala:67:14]
  output [7:0]  io_consumer_data_bits,	// @[generators/dma/src/main/scala/dma/DMA.scala:67:14]
  input         io_consumer_done	// @[generators/dma/src/main/scala/dma/DMA.scala:67:14]
);

  reg  [2:0]  counter;	// @[generators/dma/src/main/scala/dma/DMA.scala:75:24]
  reg  [31:0] wideData;	// @[generators/dma/src/main/scala/dma/DMA.scala:76:25]
  wire        io_dmaIn_ready_0 = counter == 3'h0 & io_consumer_data_ready;	// @[generators/dma/src/main/scala/dma/DMA.scala:75:24, :93:{29,37}]
  always @(posedge clock) begin
    if (reset) begin
      counter <= 3'h0;	// @[generators/dma/src/main/scala/dma/DMA.scala:75:24]
      wideData <= 32'h0;	// @[generators/dma/src/main/scala/dma/DMA.scala:76:25]
    end
    else if (io_consumer_done) begin	// @[generators/dma/src/main/scala/dma/DMA.scala:67:14]
      counter <= 3'h0;	// @[generators/dma/src/main/scala/dma/DMA.scala:75:24]
      wideData <= 32'h0;	// @[generators/dma/src/main/scala/dma/DMA.scala:76:25]
    end
    else if (io_consumer_data_ready & (|counter)) begin	// @[generators/dma/src/main/scala/dma/DMA.scala:75:24, :94:37, src/main/scala/chisel3/util/Decoupled.scala:52:35]
      counter <= counter - 3'h1;	// @[generators/dma/src/main/scala/dma/DMA.scala:75:24, :85:24]
      wideData <= {8'h0, wideData[31:8]};	// @[generators/dma/src/main/scala/dma/DMA.scala:76:25, :84:{14,26}]
    end
    else if (io_dmaIn_ready_0 & io_dmaIn_valid) begin	// @[generators/dma/src/main/scala/dma/DMA.scala:93:37, src/main/scala/chisel3/util/Decoupled.scala:52:35]
      counter <= 3'h4;	// @[generators/dma/src/main/scala/dma/DMA.scala:75:24, :80:13]
      wideData <= io_dmaIn_bits;	// @[generators/dma/src/main/scala/dma/DMA.scala:76:25]
    end
  end // always @(posedge)
  `ifdef ENABLE_INITIAL_REG_
    `ifdef FIRRTL_BEFORE_INITIAL
      `FIRRTL_BEFORE_INITIAL
    `endif // FIRRTL_BEFORE_INITIAL
    logic [31:0] _RANDOM[0:1];
    initial begin
      `ifdef INIT_RANDOM_PROLOG_
        `INIT_RANDOM_PROLOG_
      `endif // INIT_RANDOM_PROLOG_
      `ifdef RANDOMIZE_REG_INIT
        for (logic [1:0] i = 2'h0; i < 2'h2; i += 2'h1) begin
          _RANDOM[i[0]] = `RANDOM;
        end
        counter = _RANDOM[1'h0][2:0];	// @[generators/dma/src/main/scala/dma/DMA.scala:75:24]
        wideData = {_RANDOM[1'h0][31:3], _RANDOM[1'h1][2:0]};	// @[generators/dma/src/main/scala/dma/DMA.scala:75:24, :76:25]
      `endif // RANDOMIZE_REG_INIT
    end // initial
    `ifdef FIRRTL_AFTER_INITIAL
      `FIRRTL_AFTER_INITIAL
    `endif // FIRRTL_AFTER_INITIAL
  `endif // ENABLE_INITIAL_REG_
  assign io_dmaIn_ready = io_dmaIn_ready_0;	// @[generators/dma/src/main/scala/dma/DMA.scala:93:37]
  assign io_consumer_data_valid = |counter;	// @[generators/dma/src/main/scala/dma/DMA.scala:75:24, :94:37]
  assign io_consumer_data_bits = wideData[7:0];	// @[generators/dma/src/main/scala/dma/DMA.scala:76:25, :95:36]
endmodule

