// Generated by CIRCT unknown git version
// Standard header to adapt well known macros for register randomization.
`ifndef RANDOMIZE
  `ifdef RANDOMIZE_MEM_INIT
    `define RANDOMIZE
  `endif // RANDOMIZE_MEM_INIT
`endif // not def RANDOMIZE
`ifndef RANDOMIZE
  `ifdef RANDOMIZE_REG_INIT
    `define RANDOMIZE
  `endif // RANDOMIZE_REG_INIT
`endif // not def RANDOMIZE

// RANDOM may be set to an expression that produces a 32-bit random unsigned value.
`ifndef RANDOM
  `define RANDOM $random
`endif // not def RANDOM

// Users can define INIT_RANDOM as general code that gets injected into the
// initializer block for modules with registers.
`ifndef INIT_RANDOM
  `define INIT_RANDOM
`endif // not def INIT_RANDOM

// If using random initialization, you can also define RANDOMIZE_DELAY to
// customize the delay used, otherwise 0.002 is used.
`ifndef RANDOMIZE_DELAY
  `define RANDOMIZE_DELAY 0.002
`endif // not def RANDOMIZE_DELAY

// Define INIT_RANDOM_PROLOG_ for use in our modules below.
`ifndef INIT_RANDOM_PROLOG_
  `ifdef RANDOMIZE
    `ifdef VERILATOR
      `define INIT_RANDOM_PROLOG_ `INIT_RANDOM
    `else  // VERILATOR
      `define INIT_RANDOM_PROLOG_ `INIT_RANDOM #`RANDOMIZE_DELAY begin end
    `endif // VERILATOR
  `else  // RANDOMIZE
    `define INIT_RANDOM_PROLOG_
  `endif // RANDOMIZE
`endif // not def INIT_RANDOM_PROLOG_

// Include register initializers in init blocks unless synthesis is set
`ifndef SYNTHESIS
  `ifndef ENABLE_INITIAL_REG_
    `define ENABLE_INITIAL_REG_
  `endif // not def ENABLE_INITIAL_REG_
`endif // not def SYNTHESIS

// Include rmemory initializers in init blocks unless synthesis is set
`ifndef SYNTHESIS
  `ifndef ENABLE_INITIAL_MEM_
    `define ENABLE_INITIAL_MEM_
  `endif // not def ENABLE_INITIAL_MEM_
`endif // not def SYNTHESIS

// Standard header to adapt well known macros for prints and assertions.

// Users can define 'PRINTF_COND' to add an extra gate to prints.
`ifndef PRINTF_COND_
  `ifdef PRINTF_COND
    `define PRINTF_COND_ (`PRINTF_COND)
  `else  // PRINTF_COND
    `define PRINTF_COND_ 1
  `endif // PRINTF_COND
`endif // not def PRINTF_COND_

// Users can define 'ASSERT_VERBOSE_COND' to add an extra gate to assert error printing.
`ifndef ASSERT_VERBOSE_COND_
  `ifdef ASSERT_VERBOSE_COND
    `define ASSERT_VERBOSE_COND_ (`ASSERT_VERBOSE_COND)
  `else  // ASSERT_VERBOSE_COND
    `define ASSERT_VERBOSE_COND_ 1
  `endif // ASSERT_VERBOSE_COND
`endif // not def ASSERT_VERBOSE_COND_

// Users can define 'STOP_COND' to add an extra gate to stop conditions.
`ifndef STOP_COND_
  `ifdef STOP_COND
    `define STOP_COND_ (`STOP_COND)
  `else  // STOP_COND
    `define STOP_COND_ 1
  `endif // STOP_COND
`endif // not def STOP_COND_

module CRCBytes(
  input         clock,
                reset,
                io_in_valid,	// @[generators/baseband/src/main/scala/baseband/CRC.scala:57:14]
  input  [7:0]  io_in_bits,	// @[generators/baseband/src/main/scala/baseband/CRC.scala:57:14]
  output        io_out_valid,	// @[generators/baseband/src/main/scala/baseband/CRC.scala:57:14]
  output [23:0] io_out_bits,	// @[generators/baseband/src/main/scala/baseband/CRC.scala:57:14]
  input         io_seed_valid,	// @[generators/baseband/src/main/scala/baseband/CRC.scala:57:14]
  input  [23:0] io_seed_bits	// @[generators/baseband/src/main/scala/baseband/CRC.scala:57:14]
);

  reg        state;	// @[generators/baseband/src/main/scala/baseband/CRC.scala:67:24]
  reg  [2:0] counter;	// @[generators/baseband/src/main/scala/baseband/CRC.scala:68:20]
  reg  [7:0] inreg;	// @[generators/baseband/src/main/scala/baseband/CRC.scala:69:20]
  wire       _GEN = ~state & io_in_valid;	// @[generators/baseband/src/main/scala/baseband/CRC.scala:67:24, :84:17, src/main/scala/chisel3/util/Decoupled.scala:52:35]
  always @(posedge clock) begin
    if (reset)
      state <= 1'h0;	// @[generators/baseband/src/main/scala/baseband/CRC.scala:67:24]
    else if (state)	// @[generators/baseband/src/main/scala/baseband/CRC.scala:67:24]
      state <= ~(state & counter == 3'h0) & state;	// @[generators/baseband/src/main/scala/baseband/CRC.scala:67:24, :68:20, :78:22, :84:17, :99:{20,29}, :100:15]
    else	// @[generators/baseband/src/main/scala/baseband/CRC.scala:67:24]
      state <= _GEN | state;	// @[generators/baseband/src/main/scala/baseband/CRC.scala:67:24, :89:26, :90:17, src/main/scala/chisel3/util/Decoupled.scala:52:35]
    if (~state & _GEN) begin	// @[generators/baseband/src/main/scala/baseband/CRC.scala:67:24, :78:11, :84:17, :89:26, :91:17, src/main/scala/chisel3/util/Decoupled.scala:52:35]
      counter <= 3'h1;	// @[generators/baseband/src/main/scala/baseband/CRC.scala:68:20, :91:17]
      inreg <= io_in_bits;	// @[generators/baseband/src/main/scala/baseband/CRC.scala:69:20]
    end
    else begin	// @[generators/baseband/src/main/scala/baseband/CRC.scala:78:11, :84:17, :89:26, :91:17]
      counter <= counter + 3'h1;	// @[generators/baseband/src/main/scala/baseband/CRC.scala:68:20, :78:22, :91:17]
      inreg <= {1'h0, inreg[7:1]};	// @[generators/baseband/src/main/scala/baseband/CRC.scala:69:20, :79:{11,20}]
    end
  end // always @(posedge)
  `ifdef ENABLE_INITIAL_REG_
    `ifdef FIRRTL_BEFORE_INITIAL
      `FIRRTL_BEFORE_INITIAL
    `endif // FIRRTL_BEFORE_INITIAL
    logic [31:0] _RANDOM[0:0];
    initial begin
      `ifdef INIT_RANDOM_PROLOG_
        `INIT_RANDOM_PROLOG_
      `endif // INIT_RANDOM_PROLOG_
      `ifdef RANDOMIZE_REG_INIT
        _RANDOM[/*Zero width*/ 1'b0] = `RANDOM;
        state = _RANDOM[/*Zero width*/ 1'b0][0];	// @[generators/baseband/src/main/scala/baseband/CRC.scala:67:24]
        counter = _RANDOM[/*Zero width*/ 1'b0][3:1];	// @[generators/baseband/src/main/scala/baseband/CRC.scala:67:24, :68:20]
        inreg = _RANDOM[/*Zero width*/ 1'b0][11:4];	// @[generators/baseband/src/main/scala/baseband/CRC.scala:67:24, :69:20]
      `endif // RANDOMIZE_REG_INIT
    end // initial
    `ifdef FIRRTL_AFTER_INITIAL
      `FIRRTL_AFTER_INITIAL
    `endif // FIRRTL_AFTER_INITIAL
  `endif // ENABLE_INITIAL_REG_
  CRC crc (	// @[generators/baseband/src/main/scala/baseband/CRC.scala:71:19]
    .clock         (clock),
    .reset         (reset),
    .io_in_valid   (state),	// @[generators/baseband/src/main/scala/baseband/CRC.scala:67:24]
    .io_in_bits    (inreg[0]),	// @[generators/baseband/src/main/scala/baseband/CRC.scala:69:20, :73:26]
    .io_out        (io_out_bits),
    .io_seed_valid (io_seed_valid),
    .io_seed_bits  (io_seed_bits)
  );
  assign io_out_valid = ~state;	// @[generators/baseband/src/main/scala/baseband/CRC.scala:67:24, :84:17]
endmodule

