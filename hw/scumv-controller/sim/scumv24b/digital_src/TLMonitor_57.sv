// Generated by CIRCT unknown git version
// Standard header to adapt well known macros for register randomization.
`ifndef RANDOMIZE
  `ifdef RANDOMIZE_MEM_INIT
    `define RANDOMIZE
  `endif // RANDOMIZE_MEM_INIT
`endif // not def RANDOMIZE
`ifndef RANDOMIZE
  `ifdef RANDOMIZE_REG_INIT
    `define RANDOMIZE
  `endif // RANDOMIZE_REG_INIT
`endif // not def RANDOMIZE

// RANDOM may be set to an expression that produces a 32-bit random unsigned value.
`ifndef RANDOM
  `define RANDOM $random
`endif // not def RANDOM

// Users can define INIT_RANDOM as general code that gets injected into the
// initializer block for modules with registers.
`ifndef INIT_RANDOM
  `define INIT_RANDOM
`endif // not def INIT_RANDOM

// If using random initialization, you can also define RANDOMIZE_DELAY to
// customize the delay used, otherwise 0.002 is used.
`ifndef RANDOMIZE_DELAY
  `define RANDOMIZE_DELAY 0.002
`endif // not def RANDOMIZE_DELAY

// Define INIT_RANDOM_PROLOG_ for use in our modules below.
`ifndef INIT_RANDOM_PROLOG_
  `ifdef RANDOMIZE
    `ifdef VERILATOR
      `define INIT_RANDOM_PROLOG_ `INIT_RANDOM
    `else  // VERILATOR
      `define INIT_RANDOM_PROLOG_ `INIT_RANDOM #`RANDOMIZE_DELAY begin end
    `endif // VERILATOR
  `else  // RANDOMIZE
    `define INIT_RANDOM_PROLOG_
  `endif // RANDOMIZE
`endif // not def INIT_RANDOM_PROLOG_

// Include register initializers in init blocks unless synthesis is set
`ifndef SYNTHESIS
  `ifndef ENABLE_INITIAL_REG_
    `define ENABLE_INITIAL_REG_
  `endif // not def ENABLE_INITIAL_REG_
`endif // not def SYNTHESIS

// Include rmemory initializers in init blocks unless synthesis is set
`ifndef SYNTHESIS
  `ifndef ENABLE_INITIAL_MEM_
    `define ENABLE_INITIAL_MEM_
  `endif // not def ENABLE_INITIAL_MEM_
`endif // not def SYNTHESIS

// Standard header to adapt well known macros for prints and assertions.

// Users can define 'PRINTF_COND' to add an extra gate to prints.
`ifndef PRINTF_COND_
  `ifdef PRINTF_COND
    `define PRINTF_COND_ (`PRINTF_COND)
  `else  // PRINTF_COND
    `define PRINTF_COND_ 1
  `endif // PRINTF_COND
`endif // not def PRINTF_COND_

// Users can define 'ASSERT_VERBOSE_COND' to add an extra gate to assert error printing.
`ifndef ASSERT_VERBOSE_COND_
  `ifdef ASSERT_VERBOSE_COND
    `define ASSERT_VERBOSE_COND_ (`ASSERT_VERBOSE_COND)
  `else  // ASSERT_VERBOSE_COND
    `define ASSERT_VERBOSE_COND_ 1
  `endif // ASSERT_VERBOSE_COND
`endif // not def ASSERT_VERBOSE_COND_

// Users can define 'STOP_COND' to add an extra gate to stop conditions.
`ifndef STOP_COND_
  `ifdef STOP_COND
    `define STOP_COND_ (`STOP_COND)
  `else  // STOP_COND
    `define STOP_COND_ 1
  `endif // STOP_COND
`endif // not def STOP_COND_

module TLMonitor_57(
  input        clock,
               reset,
               io_in_a_ready,	// @[generators/rocket-chip/src/main/scala/tilelink/Monitor.scala:17:14]
               io_in_a_valid,	// @[generators/rocket-chip/src/main/scala/tilelink/Monitor.scala:17:14]
  input [2:0]  io_in_a_bits_opcode,	// @[generators/rocket-chip/src/main/scala/tilelink/Monitor.scala:17:14]
               io_in_a_bits_param,	// @[generators/rocket-chip/src/main/scala/tilelink/Monitor.scala:17:14]
  input        io_in_a_bits_size,	// @[generators/rocket-chip/src/main/scala/tilelink/Monitor.scala:17:14]
  input [17:0] io_in_a_bits_source,	// @[generators/rocket-chip/src/main/scala/tilelink/Monitor.scala:17:14]
  input [29:0] io_in_a_bits_address,	// @[generators/rocket-chip/src/main/scala/tilelink/Monitor.scala:17:14]
  input        io_in_a_bits_mask,	// @[generators/rocket-chip/src/main/scala/tilelink/Monitor.scala:17:14]
               io_in_a_bits_corrupt,	// @[generators/rocket-chip/src/main/scala/tilelink/Monitor.scala:17:14]
               io_in_d_ready,	// @[generators/rocket-chip/src/main/scala/tilelink/Monitor.scala:17:14]
               io_in_d_valid,	// @[generators/rocket-chip/src/main/scala/tilelink/Monitor.scala:17:14]
               io_in_d_bits_size,	// @[generators/rocket-chip/src/main/scala/tilelink/Monitor.scala:17:14]
  input [17:0] io_in_d_bits_source	// @[generators/rocket-chip/src/main/scala/tilelink/Monitor.scala:17:14]
);

  reg         a_first_counter;	// @[generators/rocket-chip/src/main/scala/tilelink/Edges.scala:229:27]
  reg  [2:0]  opcode;	// @[generators/rocket-chip/src/main/scala/tilelink/Monitor.scala:384:22]
  reg  [2:0]  param;	// @[generators/rocket-chip/src/main/scala/tilelink/Monitor.scala:385:22]
  reg         size;	// @[generators/rocket-chip/src/main/scala/tilelink/Monitor.scala:386:22]
  reg  [17:0] source;	// @[generators/rocket-chip/src/main/scala/tilelink/Monitor.scala:387:22]
  reg  [29:0] address;	// @[generators/rocket-chip/src/main/scala/tilelink/Monitor.scala:388:22]
  reg         d_first_counter;	// @[generators/rocket-chip/src/main/scala/tilelink/Edges.scala:229:27]
  reg         size_1;	// @[generators/rocket-chip/src/main/scala/tilelink/Monitor.scala:537:22]
  reg  [17:0] source_1;	// @[generators/rocket-chip/src/main/scala/tilelink/Monitor.scala:538:22]
  `ifndef SYNTHESIS	// @[generators/rocket-chip/src/main/scala/tilelink/Monitor.scala:42:11]
    wire _GEN = io_in_a_valid & io_in_a_bits_opcode == 3'h6 & ~reset;	// @[generators/rocket-chip/src/main/scala/tilelink/Monitor.scala:42:11, :81:25]
    wire _GEN_0 = io_in_a_bits_source > 18'h2007F;	// @[generators/rocket-chip/src/main/scala/diplomacy/Parameters.scala:57:20]
    wire _GEN_1 = io_in_a_bits_param > 3'h2;	// @[generators/rocket-chip/src/main/scala/tilelink/Bundles.scala:111:27]
    wire _GEN_2 = io_in_a_valid & (&io_in_a_bits_opcode) & ~reset;	// @[generators/rocket-chip/src/main/scala/tilelink/Monitor.scala:42:11, :92:25]
    wire _GEN_3 = io_in_a_valid & io_in_a_bits_opcode == 3'h4 & ~reset;	// @[generators/rocket-chip/src/main/scala/tilelink/Monitor.scala:42:11, :104:25]
    wire _GEN_4 = _GEN_3 & _GEN_0;	// @[generators/rocket-chip/src/main/scala/diplomacy/Parameters.scala:57:20, generators/rocket-chip/src/main/scala/tilelink/Monitor.scala:42:11]
    wire _GEN_5 = io_in_a_valid & io_in_a_bits_opcode == 3'h0 & ~reset;	// @[generators/rocket-chip/src/main/scala/tilelink/Monitor.scala:42:11, :99:31, :114:25]
    wire _GEN_6 = io_in_a_valid & io_in_a_bits_opcode == 3'h1 & ~reset;	// @[generators/rocket-chip/src/main/scala/tilelink/Monitor.scala:42:11, :122:25]
    wire _GEN_7 = io_in_a_valid & io_in_a_bits_opcode == 3'h2 & ~reset;	// @[generators/rocket-chip/src/main/scala/tilelink/Bundles.scala:111:27, generators/rocket-chip/src/main/scala/tilelink/Monitor.scala:42:11, :130:25]
    wire _GEN_8 = io_in_a_valid & io_in_a_bits_opcode == 3'h3 & ~reset;	// @[generators/rocket-chip/src/main/scala/tilelink/Bundles.scala:148:30, generators/rocket-chip/src/main/scala/tilelink/Monitor.scala:42:11, :138:25]
    wire _GEN_9 = io_in_a_valid & io_in_a_bits_opcode == 3'h5 & ~reset;	// @[generators/rocket-chip/src/main/scala/tilelink/Monitor.scala:42:11, :146:25]
    wire _GEN_10 = io_in_a_valid & a_first_counter & ~reset;	// @[generators/rocket-chip/src/main/scala/tilelink/Edges.scala:229:27, generators/rocket-chip/src/main/scala/tilelink/Monitor.scala:42:11]
    wire _GEN_11 = io_in_d_valid & d_first_counter & ~reset;	// @[generators/rocket-chip/src/main/scala/tilelink/Edges.scala:229:27, generators/rocket-chip/src/main/scala/tilelink/Monitor.scala:42:11, :49:11]
    always @(posedge clock) begin	// @[generators/rocket-chip/src/main/scala/tilelink/Monitor.scala:42:11]
      if (_GEN) begin	// @[generators/rocket-chip/src/main/scala/tilelink/Monitor.scala:42:11]
        if (`ASSERT_VERBOSE_COND_)	// @[generators/rocket-chip/src/main/scala/tilelink/Monitor.scala:42:11]
          $error("Assertion failed: 'A' channel carries AcquireBlock type which is unexpected using diplomatic parameters (connected at generators/rocket-chip/src/main/scala/tilelink/CrossingHelper.scala:30:14)\n    at Monitor.scala:42 assert(cond, message)\n");	// @[generators/rocket-chip/src/main/scala/tilelink/Monitor.scala:42:11]
        if (`STOP_COND_)	// @[generators/rocket-chip/src/main/scala/tilelink/Monitor.scala:42:11]
          $fatal;	// @[generators/rocket-chip/src/main/scala/tilelink/Monitor.scala:42:11]
        if (`ASSERT_VERBOSE_COND_)	// @[generators/rocket-chip/src/main/scala/tilelink/Monitor.scala:42:11]
          $error("Assertion failed: 'A' channel carries AcquireBlock from a client which does not support Probe (connected at generators/rocket-chip/src/main/scala/tilelink/CrossingHelper.scala:30:14)\n    at Monitor.scala:42 assert(cond, message)\n");	// @[generators/rocket-chip/src/main/scala/tilelink/Monitor.scala:42:11]
        if (`STOP_COND_)	// @[generators/rocket-chip/src/main/scala/tilelink/Monitor.scala:42:11]
          $fatal;	// @[generators/rocket-chip/src/main/scala/tilelink/Monitor.scala:42:11]
      end
      if (_GEN & _GEN_0) begin	// @[generators/rocket-chip/src/main/scala/diplomacy/Parameters.scala:57:20, generators/rocket-chip/src/main/scala/tilelink/Monitor.scala:42:11]
        if (`ASSERT_VERBOSE_COND_)	// @[generators/rocket-chip/src/main/scala/tilelink/Monitor.scala:42:11]
          $error("Assertion failed: 'A' channel AcquireBlock carries invalid source ID (connected at generators/rocket-chip/src/main/scala/tilelink/CrossingHelper.scala:30:14)\n    at Monitor.scala:42 assert(cond, message)\n");	// @[generators/rocket-chip/src/main/scala/tilelink/Monitor.scala:42:11]
        if (`STOP_COND_)	// @[generators/rocket-chip/src/main/scala/tilelink/Monitor.scala:42:11]
          $fatal;	// @[generators/rocket-chip/src/main/scala/tilelink/Monitor.scala:42:11]
      end
      if (_GEN & _GEN_1) begin	// @[generators/rocket-chip/src/main/scala/tilelink/Bundles.scala:111:27, generators/rocket-chip/src/main/scala/tilelink/Monitor.scala:42:11]
        if (`ASSERT_VERBOSE_COND_)	// @[generators/rocket-chip/src/main/scala/tilelink/Monitor.scala:42:11]
          $error("Assertion failed: 'A' channel AcquireBlock carries invalid grow param (connected at generators/rocket-chip/src/main/scala/tilelink/CrossingHelper.scala:30:14)\n    at Monitor.scala:42 assert(cond, message)\n");	// @[generators/rocket-chip/src/main/scala/tilelink/Monitor.scala:42:11]
        if (`STOP_COND_)	// @[generators/rocket-chip/src/main/scala/tilelink/Monitor.scala:42:11]
          $fatal;	// @[generators/rocket-chip/src/main/scala/tilelink/Monitor.scala:42:11]
      end
      if (_GEN & ~io_in_a_bits_mask) begin	// @[generators/rocket-chip/src/main/scala/tilelink/Monitor.scala:42:11]
        if (`ASSERT_VERBOSE_COND_)	// @[generators/rocket-chip/src/main/scala/tilelink/Monitor.scala:42:11]
          $error("Assertion failed: 'A' channel AcquireBlock contains invalid mask (connected at generators/rocket-chip/src/main/scala/tilelink/CrossingHelper.scala:30:14)\n    at Monitor.scala:42 assert(cond, message)\n");	// @[generators/rocket-chip/src/main/scala/tilelink/Monitor.scala:42:11]
        if (`STOP_COND_)	// @[generators/rocket-chip/src/main/scala/tilelink/Monitor.scala:42:11]
          $fatal;	// @[generators/rocket-chip/src/main/scala/tilelink/Monitor.scala:42:11]
      end
      if (_GEN & io_in_a_bits_corrupt) begin	// @[generators/rocket-chip/src/main/scala/tilelink/Monitor.scala:42:11]
        if (`ASSERT_VERBOSE_COND_)	// @[generators/rocket-chip/src/main/scala/tilelink/Monitor.scala:42:11]
          $error("Assertion failed: 'A' channel AcquireBlock is corrupt (connected at generators/rocket-chip/src/main/scala/tilelink/CrossingHelper.scala:30:14)\n    at Monitor.scala:42 assert(cond, message)\n");	// @[generators/rocket-chip/src/main/scala/tilelink/Monitor.scala:42:11]
        if (`STOP_COND_)	// @[generators/rocket-chip/src/main/scala/tilelink/Monitor.scala:42:11]
          $fatal;	// @[generators/rocket-chip/src/main/scala/tilelink/Monitor.scala:42:11]
      end
      if (_GEN_2) begin	// @[generators/rocket-chip/src/main/scala/tilelink/Monitor.scala:42:11]
        if (`ASSERT_VERBOSE_COND_)	// @[generators/rocket-chip/src/main/scala/tilelink/Monitor.scala:42:11]
          $error("Assertion failed: 'A' channel carries AcquirePerm type which is unexpected using diplomatic parameters (connected at generators/rocket-chip/src/main/scala/tilelink/CrossingHelper.scala:30:14)\n    at Monitor.scala:42 assert(cond, message)\n");	// @[generators/rocket-chip/src/main/scala/tilelink/Monitor.scala:42:11]
        if (`STOP_COND_)	// @[generators/rocket-chip/src/main/scala/tilelink/Monitor.scala:42:11]
          $fatal;	// @[generators/rocket-chip/src/main/scala/tilelink/Monitor.scala:42:11]
        if (`ASSERT_VERBOSE_COND_)	// @[generators/rocket-chip/src/main/scala/tilelink/Monitor.scala:42:11]
          $error("Assertion failed: 'A' channel carries AcquirePerm from a client which does not support Probe (connected at generators/rocket-chip/src/main/scala/tilelink/CrossingHelper.scala:30:14)\n    at Monitor.scala:42 assert(cond, message)\n");	// @[generators/rocket-chip/src/main/scala/tilelink/Monitor.scala:42:11]
        if (`STOP_COND_)	// @[generators/rocket-chip/src/main/scala/tilelink/Monitor.scala:42:11]
          $fatal;	// @[generators/rocket-chip/src/main/scala/tilelink/Monitor.scala:42:11]
      end
      if (_GEN_2 & _GEN_0) begin	// @[generators/rocket-chip/src/main/scala/diplomacy/Parameters.scala:57:20, generators/rocket-chip/src/main/scala/tilelink/Monitor.scala:42:11]
        if (`ASSERT_VERBOSE_COND_)	// @[generators/rocket-chip/src/main/scala/tilelink/Monitor.scala:42:11]
          $error("Assertion failed: 'A' channel AcquirePerm carries invalid source ID (connected at generators/rocket-chip/src/main/scala/tilelink/CrossingHelper.scala:30:14)\n    at Monitor.scala:42 assert(cond, message)\n");	// @[generators/rocket-chip/src/main/scala/tilelink/Monitor.scala:42:11]
        if (`STOP_COND_)	// @[generators/rocket-chip/src/main/scala/tilelink/Monitor.scala:42:11]
          $fatal;	// @[generators/rocket-chip/src/main/scala/tilelink/Monitor.scala:42:11]
      end
      if (_GEN_2 & _GEN_1) begin	// @[generators/rocket-chip/src/main/scala/tilelink/Bundles.scala:111:27, generators/rocket-chip/src/main/scala/tilelink/Monitor.scala:42:11]
        if (`ASSERT_VERBOSE_COND_)	// @[generators/rocket-chip/src/main/scala/tilelink/Monitor.scala:42:11]
          $error("Assertion failed: 'A' channel AcquirePerm carries invalid grow param (connected at generators/rocket-chip/src/main/scala/tilelink/CrossingHelper.scala:30:14)\n    at Monitor.scala:42 assert(cond, message)\n");	// @[generators/rocket-chip/src/main/scala/tilelink/Monitor.scala:42:11]
        if (`STOP_COND_)	// @[generators/rocket-chip/src/main/scala/tilelink/Monitor.scala:42:11]
          $fatal;	// @[generators/rocket-chip/src/main/scala/tilelink/Monitor.scala:42:11]
      end
      if (_GEN_2 & ~(|io_in_a_bits_param)) begin	// @[generators/rocket-chip/src/main/scala/tilelink/Monitor.scala:42:11, :99:31]
        if (`ASSERT_VERBOSE_COND_)	// @[generators/rocket-chip/src/main/scala/tilelink/Monitor.scala:42:11]
          $error("Assertion failed: 'A' channel AcquirePerm requests NtoB (connected at generators/rocket-chip/src/main/scala/tilelink/CrossingHelper.scala:30:14)\n    at Monitor.scala:42 assert(cond, message)\n");	// @[generators/rocket-chip/src/main/scala/tilelink/Monitor.scala:42:11]
        if (`STOP_COND_)	// @[generators/rocket-chip/src/main/scala/tilelink/Monitor.scala:42:11]
          $fatal;	// @[generators/rocket-chip/src/main/scala/tilelink/Monitor.scala:42:11]
      end
      if (_GEN_2 & ~io_in_a_bits_mask) begin	// @[generators/rocket-chip/src/main/scala/tilelink/Monitor.scala:42:11]
        if (`ASSERT_VERBOSE_COND_)	// @[generators/rocket-chip/src/main/scala/tilelink/Monitor.scala:42:11]
          $error("Assertion failed: 'A' channel AcquirePerm contains invalid mask (connected at generators/rocket-chip/src/main/scala/tilelink/CrossingHelper.scala:30:14)\n    at Monitor.scala:42 assert(cond, message)\n");	// @[generators/rocket-chip/src/main/scala/tilelink/Monitor.scala:42:11]
        if (`STOP_COND_)	// @[generators/rocket-chip/src/main/scala/tilelink/Monitor.scala:42:11]
          $fatal;	// @[generators/rocket-chip/src/main/scala/tilelink/Monitor.scala:42:11]
      end
      if (_GEN_2 & io_in_a_bits_corrupt) begin	// @[generators/rocket-chip/src/main/scala/tilelink/Monitor.scala:42:11]
        if (`ASSERT_VERBOSE_COND_)	// @[generators/rocket-chip/src/main/scala/tilelink/Monitor.scala:42:11]
          $error("Assertion failed: 'A' channel AcquirePerm is corrupt (connected at generators/rocket-chip/src/main/scala/tilelink/CrossingHelper.scala:30:14)\n    at Monitor.scala:42 assert(cond, message)\n");	// @[generators/rocket-chip/src/main/scala/tilelink/Monitor.scala:42:11]
        if (`STOP_COND_)	// @[generators/rocket-chip/src/main/scala/tilelink/Monitor.scala:42:11]
          $fatal;	// @[generators/rocket-chip/src/main/scala/tilelink/Monitor.scala:42:11]
      end
      if (_GEN_4) begin	// @[generators/rocket-chip/src/main/scala/tilelink/Monitor.scala:42:11]
        if (`ASSERT_VERBOSE_COND_)	// @[generators/rocket-chip/src/main/scala/tilelink/Monitor.scala:42:11]
          $error("Assertion failed: 'A' channel carries Get type which master claims it can't emit (connected at generators/rocket-chip/src/main/scala/tilelink/CrossingHelper.scala:30:14)\n    at Monitor.scala:42 assert(cond, message)\n");	// @[generators/rocket-chip/src/main/scala/tilelink/Monitor.scala:42:11]
        if (`STOP_COND_)	// @[generators/rocket-chip/src/main/scala/tilelink/Monitor.scala:42:11]
          $fatal;	// @[generators/rocket-chip/src/main/scala/tilelink/Monitor.scala:42:11]
      end
      if (_GEN_3 & ~(~io_in_a_bits_size & io_in_a_bits_address[29:28] == 2'h2)) begin	// @[generators/rocket-chip/src/main/scala/diplomacy/Parameters.scala:91:44, :137:{41,46,59}, generators/rocket-chip/src/main/scala/tilelink/Monitor.scala:17:14, :42:11, generators/rocket-chip/src/main/scala/tilelink/Parameters.scala:671:54]
        if (`ASSERT_VERBOSE_COND_)	// @[generators/rocket-chip/src/main/scala/tilelink/Monitor.scala:42:11]
          $error("Assertion failed: 'A' channel carries Get type which slave claims it can't support (connected at generators/rocket-chip/src/main/scala/tilelink/CrossingHelper.scala:30:14)\n    at Monitor.scala:42 assert(cond, message)\n");	// @[generators/rocket-chip/src/main/scala/tilelink/Monitor.scala:42:11]
        if (`STOP_COND_)	// @[generators/rocket-chip/src/main/scala/tilelink/Monitor.scala:42:11]
          $fatal;	// @[generators/rocket-chip/src/main/scala/tilelink/Monitor.scala:42:11]
      end
      if (_GEN_4) begin	// @[generators/rocket-chip/src/main/scala/tilelink/Monitor.scala:42:11]
        if (`ASSERT_VERBOSE_COND_)	// @[generators/rocket-chip/src/main/scala/tilelink/Monitor.scala:42:11]
          $error("Assertion failed: 'A' channel Get carries invalid source ID (connected at generators/rocket-chip/src/main/scala/tilelink/CrossingHelper.scala:30:14)\n    at Monitor.scala:42 assert(cond, message)\n");	// @[generators/rocket-chip/src/main/scala/tilelink/Monitor.scala:42:11]
        if (`STOP_COND_)	// @[generators/rocket-chip/src/main/scala/tilelink/Monitor.scala:42:11]
          $fatal;	// @[generators/rocket-chip/src/main/scala/tilelink/Monitor.scala:42:11]
      end
      if (_GEN_3 & (|io_in_a_bits_param)) begin	// @[generators/rocket-chip/src/main/scala/tilelink/Monitor.scala:42:11, :99:31]
        if (`ASSERT_VERBOSE_COND_)	// @[generators/rocket-chip/src/main/scala/tilelink/Monitor.scala:42:11]
          $error("Assertion failed: 'A' channel Get carries invalid param (connected at generators/rocket-chip/src/main/scala/tilelink/CrossingHelper.scala:30:14)\n    at Monitor.scala:42 assert(cond, message)\n");	// @[generators/rocket-chip/src/main/scala/tilelink/Monitor.scala:42:11]
        if (`STOP_COND_)	// @[generators/rocket-chip/src/main/scala/tilelink/Monitor.scala:42:11]
          $fatal;	// @[generators/rocket-chip/src/main/scala/tilelink/Monitor.scala:42:11]
      end
      if (_GEN_3 & ~io_in_a_bits_mask) begin	// @[generators/rocket-chip/src/main/scala/tilelink/Monitor.scala:42:11]
        if (`ASSERT_VERBOSE_COND_)	// @[generators/rocket-chip/src/main/scala/tilelink/Monitor.scala:42:11]
          $error("Assertion failed: 'A' channel Get contains invalid mask (connected at generators/rocket-chip/src/main/scala/tilelink/CrossingHelper.scala:30:14)\n    at Monitor.scala:42 assert(cond, message)\n");	// @[generators/rocket-chip/src/main/scala/tilelink/Monitor.scala:42:11]
        if (`STOP_COND_)	// @[generators/rocket-chip/src/main/scala/tilelink/Monitor.scala:42:11]
          $fatal;	// @[generators/rocket-chip/src/main/scala/tilelink/Monitor.scala:42:11]
      end
      if (_GEN_3 & io_in_a_bits_corrupt) begin	// @[generators/rocket-chip/src/main/scala/tilelink/Monitor.scala:42:11]
        if (`ASSERT_VERBOSE_COND_)	// @[generators/rocket-chip/src/main/scala/tilelink/Monitor.scala:42:11]
          $error("Assertion failed: 'A' channel Get is corrupt (connected at generators/rocket-chip/src/main/scala/tilelink/CrossingHelper.scala:30:14)\n    at Monitor.scala:42 assert(cond, message)\n");	// @[generators/rocket-chip/src/main/scala/tilelink/Monitor.scala:42:11]
        if (`STOP_COND_)	// @[generators/rocket-chip/src/main/scala/tilelink/Monitor.scala:42:11]
          $fatal;	// @[generators/rocket-chip/src/main/scala/tilelink/Monitor.scala:42:11]
      end
      if (_GEN_5) begin	// @[generators/rocket-chip/src/main/scala/tilelink/Monitor.scala:42:11]
        if (`ASSERT_VERBOSE_COND_)	// @[generators/rocket-chip/src/main/scala/tilelink/Monitor.scala:42:11]
          $error("Assertion failed: 'A' channel carries PutFull type which is unexpected using diplomatic parameters (connected at generators/rocket-chip/src/main/scala/tilelink/CrossingHelper.scala:30:14)\n    at Monitor.scala:42 assert(cond, message)\n");	// @[generators/rocket-chip/src/main/scala/tilelink/Monitor.scala:42:11]
        if (`STOP_COND_)	// @[generators/rocket-chip/src/main/scala/tilelink/Monitor.scala:42:11]
          $fatal;	// @[generators/rocket-chip/src/main/scala/tilelink/Monitor.scala:42:11]
      end
      if (_GEN_5 & _GEN_0) begin	// @[generators/rocket-chip/src/main/scala/diplomacy/Parameters.scala:57:20, generators/rocket-chip/src/main/scala/tilelink/Monitor.scala:42:11]
        if (`ASSERT_VERBOSE_COND_)	// @[generators/rocket-chip/src/main/scala/tilelink/Monitor.scala:42:11]
          $error("Assertion failed: 'A' channel PutFull carries invalid source ID (connected at generators/rocket-chip/src/main/scala/tilelink/CrossingHelper.scala:30:14)\n    at Monitor.scala:42 assert(cond, message)\n");	// @[generators/rocket-chip/src/main/scala/tilelink/Monitor.scala:42:11]
        if (`STOP_COND_)	// @[generators/rocket-chip/src/main/scala/tilelink/Monitor.scala:42:11]
          $fatal;	// @[generators/rocket-chip/src/main/scala/tilelink/Monitor.scala:42:11]
      end
      if (_GEN_5 & (|io_in_a_bits_param)) begin	// @[generators/rocket-chip/src/main/scala/tilelink/Monitor.scala:42:11, :99:31]
        if (`ASSERT_VERBOSE_COND_)	// @[generators/rocket-chip/src/main/scala/tilelink/Monitor.scala:42:11]
          $error("Assertion failed: 'A' channel PutFull carries invalid param (connected at generators/rocket-chip/src/main/scala/tilelink/CrossingHelper.scala:30:14)\n    at Monitor.scala:42 assert(cond, message)\n");	// @[generators/rocket-chip/src/main/scala/tilelink/Monitor.scala:42:11]
        if (`STOP_COND_)	// @[generators/rocket-chip/src/main/scala/tilelink/Monitor.scala:42:11]
          $fatal;	// @[generators/rocket-chip/src/main/scala/tilelink/Monitor.scala:42:11]
      end
      if (_GEN_5 & ~io_in_a_bits_mask) begin	// @[generators/rocket-chip/src/main/scala/tilelink/Monitor.scala:42:11]
        if (`ASSERT_VERBOSE_COND_)	// @[generators/rocket-chip/src/main/scala/tilelink/Monitor.scala:42:11]
          $error("Assertion failed: 'A' channel PutFull contains invalid mask (connected at generators/rocket-chip/src/main/scala/tilelink/CrossingHelper.scala:30:14)\n    at Monitor.scala:42 assert(cond, message)\n");	// @[generators/rocket-chip/src/main/scala/tilelink/Monitor.scala:42:11]
        if (`STOP_COND_)	// @[generators/rocket-chip/src/main/scala/tilelink/Monitor.scala:42:11]
          $fatal;	// @[generators/rocket-chip/src/main/scala/tilelink/Monitor.scala:42:11]
      end
      if (_GEN_6) begin	// @[generators/rocket-chip/src/main/scala/tilelink/Monitor.scala:42:11]
        if (`ASSERT_VERBOSE_COND_)	// @[generators/rocket-chip/src/main/scala/tilelink/Monitor.scala:42:11]
          $error("Assertion failed: 'A' channel carries PutPartial type which is unexpected using diplomatic parameters (connected at generators/rocket-chip/src/main/scala/tilelink/CrossingHelper.scala:30:14)\n    at Monitor.scala:42 assert(cond, message)\n");	// @[generators/rocket-chip/src/main/scala/tilelink/Monitor.scala:42:11]
        if (`STOP_COND_)	// @[generators/rocket-chip/src/main/scala/tilelink/Monitor.scala:42:11]
          $fatal;	// @[generators/rocket-chip/src/main/scala/tilelink/Monitor.scala:42:11]
      end
      if (_GEN_6 & _GEN_0) begin	// @[generators/rocket-chip/src/main/scala/diplomacy/Parameters.scala:57:20, generators/rocket-chip/src/main/scala/tilelink/Monitor.scala:42:11]
        if (`ASSERT_VERBOSE_COND_)	// @[generators/rocket-chip/src/main/scala/tilelink/Monitor.scala:42:11]
          $error("Assertion failed: 'A' channel PutPartial carries invalid source ID (connected at generators/rocket-chip/src/main/scala/tilelink/CrossingHelper.scala:30:14)\n    at Monitor.scala:42 assert(cond, message)\n");	// @[generators/rocket-chip/src/main/scala/tilelink/Monitor.scala:42:11]
        if (`STOP_COND_)	// @[generators/rocket-chip/src/main/scala/tilelink/Monitor.scala:42:11]
          $fatal;	// @[generators/rocket-chip/src/main/scala/tilelink/Monitor.scala:42:11]
      end
      if (_GEN_6 & (|io_in_a_bits_param)) begin	// @[generators/rocket-chip/src/main/scala/tilelink/Monitor.scala:42:11, :99:31]
        if (`ASSERT_VERBOSE_COND_)	// @[generators/rocket-chip/src/main/scala/tilelink/Monitor.scala:42:11]
          $error("Assertion failed: 'A' channel PutPartial carries invalid param (connected at generators/rocket-chip/src/main/scala/tilelink/CrossingHelper.scala:30:14)\n    at Monitor.scala:42 assert(cond, message)\n");	// @[generators/rocket-chip/src/main/scala/tilelink/Monitor.scala:42:11]
        if (`STOP_COND_)	// @[generators/rocket-chip/src/main/scala/tilelink/Monitor.scala:42:11]
          $fatal;	// @[generators/rocket-chip/src/main/scala/tilelink/Monitor.scala:42:11]
      end
      if (_GEN_7) begin	// @[generators/rocket-chip/src/main/scala/tilelink/Monitor.scala:42:11]
        if (`ASSERT_VERBOSE_COND_)	// @[generators/rocket-chip/src/main/scala/tilelink/Monitor.scala:42:11]
          $error("Assertion failed: 'A' channel carries Arithmetic type which is unexpected using diplomatic parameters (connected at generators/rocket-chip/src/main/scala/tilelink/CrossingHelper.scala:30:14)\n    at Monitor.scala:42 assert(cond, message)\n");	// @[generators/rocket-chip/src/main/scala/tilelink/Monitor.scala:42:11]
        if (`STOP_COND_)	// @[generators/rocket-chip/src/main/scala/tilelink/Monitor.scala:42:11]
          $fatal;	// @[generators/rocket-chip/src/main/scala/tilelink/Monitor.scala:42:11]
      end
      if (_GEN_7 & _GEN_0) begin	// @[generators/rocket-chip/src/main/scala/diplomacy/Parameters.scala:57:20, generators/rocket-chip/src/main/scala/tilelink/Monitor.scala:42:11]
        if (`ASSERT_VERBOSE_COND_)	// @[generators/rocket-chip/src/main/scala/tilelink/Monitor.scala:42:11]
          $error("Assertion failed: 'A' channel Arithmetic carries invalid source ID (connected at generators/rocket-chip/src/main/scala/tilelink/CrossingHelper.scala:30:14)\n    at Monitor.scala:42 assert(cond, message)\n");	// @[generators/rocket-chip/src/main/scala/tilelink/Monitor.scala:42:11]
        if (`STOP_COND_)	// @[generators/rocket-chip/src/main/scala/tilelink/Monitor.scala:42:11]
          $fatal;	// @[generators/rocket-chip/src/main/scala/tilelink/Monitor.scala:42:11]
      end
      if (_GEN_7 & io_in_a_bits_param > 3'h4) begin	// @[generators/rocket-chip/src/main/scala/tilelink/Bundles.scala:141:33, generators/rocket-chip/src/main/scala/tilelink/Monitor.scala:42:11, :104:25]
        if (`ASSERT_VERBOSE_COND_)	// @[generators/rocket-chip/src/main/scala/tilelink/Monitor.scala:42:11]
          $error("Assertion failed: 'A' channel Arithmetic carries invalid opcode param (connected at generators/rocket-chip/src/main/scala/tilelink/CrossingHelper.scala:30:14)\n    at Monitor.scala:42 assert(cond, message)\n");	// @[generators/rocket-chip/src/main/scala/tilelink/Monitor.scala:42:11]
        if (`STOP_COND_)	// @[generators/rocket-chip/src/main/scala/tilelink/Monitor.scala:42:11]
          $fatal;	// @[generators/rocket-chip/src/main/scala/tilelink/Monitor.scala:42:11]
      end
      if (_GEN_7 & ~io_in_a_bits_mask) begin	// @[generators/rocket-chip/src/main/scala/tilelink/Monitor.scala:42:11]
        if (`ASSERT_VERBOSE_COND_)	// @[generators/rocket-chip/src/main/scala/tilelink/Monitor.scala:42:11]
          $error("Assertion failed: 'A' channel Arithmetic contains invalid mask (connected at generators/rocket-chip/src/main/scala/tilelink/CrossingHelper.scala:30:14)\n    at Monitor.scala:42 assert(cond, message)\n");	// @[generators/rocket-chip/src/main/scala/tilelink/Monitor.scala:42:11]
        if (`STOP_COND_)	// @[generators/rocket-chip/src/main/scala/tilelink/Monitor.scala:42:11]
          $fatal;	// @[generators/rocket-chip/src/main/scala/tilelink/Monitor.scala:42:11]
      end
      if (_GEN_8) begin	// @[generators/rocket-chip/src/main/scala/tilelink/Monitor.scala:42:11]
        if (`ASSERT_VERBOSE_COND_)	// @[generators/rocket-chip/src/main/scala/tilelink/Monitor.scala:42:11]
          $error("Assertion failed: 'A' channel carries Logical type which is unexpected using diplomatic parameters (connected at generators/rocket-chip/src/main/scala/tilelink/CrossingHelper.scala:30:14)\n    at Monitor.scala:42 assert(cond, message)\n");	// @[generators/rocket-chip/src/main/scala/tilelink/Monitor.scala:42:11]
        if (`STOP_COND_)	// @[generators/rocket-chip/src/main/scala/tilelink/Monitor.scala:42:11]
          $fatal;	// @[generators/rocket-chip/src/main/scala/tilelink/Monitor.scala:42:11]
      end
      if (_GEN_8 & _GEN_0) begin	// @[generators/rocket-chip/src/main/scala/diplomacy/Parameters.scala:57:20, generators/rocket-chip/src/main/scala/tilelink/Monitor.scala:42:11]
        if (`ASSERT_VERBOSE_COND_)	// @[generators/rocket-chip/src/main/scala/tilelink/Monitor.scala:42:11]
          $error("Assertion failed: 'A' channel Logical carries invalid source ID (connected at generators/rocket-chip/src/main/scala/tilelink/CrossingHelper.scala:30:14)\n    at Monitor.scala:42 assert(cond, message)\n");	// @[generators/rocket-chip/src/main/scala/tilelink/Monitor.scala:42:11]
        if (`STOP_COND_)	// @[generators/rocket-chip/src/main/scala/tilelink/Monitor.scala:42:11]
          $fatal;	// @[generators/rocket-chip/src/main/scala/tilelink/Monitor.scala:42:11]
      end
      if (_GEN_8 & io_in_a_bits_param[2]) begin	// @[generators/rocket-chip/src/main/scala/tilelink/Bundles.scala:148:30, generators/rocket-chip/src/main/scala/tilelink/Monitor.scala:42:11]
        if (`ASSERT_VERBOSE_COND_)	// @[generators/rocket-chip/src/main/scala/tilelink/Monitor.scala:42:11]
          $error("Assertion failed: 'A' channel Logical carries invalid opcode param (connected at generators/rocket-chip/src/main/scala/tilelink/CrossingHelper.scala:30:14)\n    at Monitor.scala:42 assert(cond, message)\n");	// @[generators/rocket-chip/src/main/scala/tilelink/Monitor.scala:42:11]
        if (`STOP_COND_)	// @[generators/rocket-chip/src/main/scala/tilelink/Monitor.scala:42:11]
          $fatal;	// @[generators/rocket-chip/src/main/scala/tilelink/Monitor.scala:42:11]
      end
      if (_GEN_8 & ~io_in_a_bits_mask) begin	// @[generators/rocket-chip/src/main/scala/tilelink/Monitor.scala:42:11]
        if (`ASSERT_VERBOSE_COND_)	// @[generators/rocket-chip/src/main/scala/tilelink/Monitor.scala:42:11]
          $error("Assertion failed: 'A' channel Logical contains invalid mask (connected at generators/rocket-chip/src/main/scala/tilelink/CrossingHelper.scala:30:14)\n    at Monitor.scala:42 assert(cond, message)\n");	// @[generators/rocket-chip/src/main/scala/tilelink/Monitor.scala:42:11]
        if (`STOP_COND_)	// @[generators/rocket-chip/src/main/scala/tilelink/Monitor.scala:42:11]
          $fatal;	// @[generators/rocket-chip/src/main/scala/tilelink/Monitor.scala:42:11]
      end
      if (_GEN_9) begin	// @[generators/rocket-chip/src/main/scala/tilelink/Monitor.scala:42:11]
        if (`ASSERT_VERBOSE_COND_)	// @[generators/rocket-chip/src/main/scala/tilelink/Monitor.scala:42:11]
          $error("Assertion failed: 'A' channel carries Hint type which is unexpected using diplomatic parameters (connected at generators/rocket-chip/src/main/scala/tilelink/CrossingHelper.scala:30:14)\n    at Monitor.scala:42 assert(cond, message)\n");	// @[generators/rocket-chip/src/main/scala/tilelink/Monitor.scala:42:11]
        if (`STOP_COND_)	// @[generators/rocket-chip/src/main/scala/tilelink/Monitor.scala:42:11]
          $fatal;	// @[generators/rocket-chip/src/main/scala/tilelink/Monitor.scala:42:11]
      end
      if (_GEN_9 & _GEN_0) begin	// @[generators/rocket-chip/src/main/scala/diplomacy/Parameters.scala:57:20, generators/rocket-chip/src/main/scala/tilelink/Monitor.scala:42:11]
        if (`ASSERT_VERBOSE_COND_)	// @[generators/rocket-chip/src/main/scala/tilelink/Monitor.scala:42:11]
          $error("Assertion failed: 'A' channel Hint carries invalid source ID (connected at generators/rocket-chip/src/main/scala/tilelink/CrossingHelper.scala:30:14)\n    at Monitor.scala:42 assert(cond, message)\n");	// @[generators/rocket-chip/src/main/scala/tilelink/Monitor.scala:42:11]
        if (`STOP_COND_)	// @[generators/rocket-chip/src/main/scala/tilelink/Monitor.scala:42:11]
          $fatal;	// @[generators/rocket-chip/src/main/scala/tilelink/Monitor.scala:42:11]
      end
      if (_GEN_9 & (|(io_in_a_bits_param[2:1]))) begin	// @[generators/rocket-chip/src/main/scala/tilelink/Bundles.scala:161:28, generators/rocket-chip/src/main/scala/tilelink/Monitor.scala:42:11]
        if (`ASSERT_VERBOSE_COND_)	// @[generators/rocket-chip/src/main/scala/tilelink/Monitor.scala:42:11]
          $error("Assertion failed: 'A' channel Hint carries invalid opcode param (connected at generators/rocket-chip/src/main/scala/tilelink/CrossingHelper.scala:30:14)\n    at Monitor.scala:42 assert(cond, message)\n");	// @[generators/rocket-chip/src/main/scala/tilelink/Monitor.scala:42:11]
        if (`STOP_COND_)	// @[generators/rocket-chip/src/main/scala/tilelink/Monitor.scala:42:11]
          $fatal;	// @[generators/rocket-chip/src/main/scala/tilelink/Monitor.scala:42:11]
      end
      if (_GEN_9 & ~io_in_a_bits_mask) begin	// @[generators/rocket-chip/src/main/scala/tilelink/Monitor.scala:42:11]
        if (`ASSERT_VERBOSE_COND_)	// @[generators/rocket-chip/src/main/scala/tilelink/Monitor.scala:42:11]
          $error("Assertion failed: 'A' channel Hint contains invalid mask (connected at generators/rocket-chip/src/main/scala/tilelink/CrossingHelper.scala:30:14)\n    at Monitor.scala:42 assert(cond, message)\n");	// @[generators/rocket-chip/src/main/scala/tilelink/Monitor.scala:42:11]
        if (`STOP_COND_)	// @[generators/rocket-chip/src/main/scala/tilelink/Monitor.scala:42:11]
          $fatal;	// @[generators/rocket-chip/src/main/scala/tilelink/Monitor.scala:42:11]
      end
      if (_GEN_9 & io_in_a_bits_corrupt) begin	// @[generators/rocket-chip/src/main/scala/tilelink/Monitor.scala:42:11]
        if (`ASSERT_VERBOSE_COND_)	// @[generators/rocket-chip/src/main/scala/tilelink/Monitor.scala:42:11]
          $error("Assertion failed: 'A' channel Hint is corrupt (connected at generators/rocket-chip/src/main/scala/tilelink/CrossingHelper.scala:30:14)\n    at Monitor.scala:42 assert(cond, message)\n");	// @[generators/rocket-chip/src/main/scala/tilelink/Monitor.scala:42:11]
        if (`STOP_COND_)	// @[generators/rocket-chip/src/main/scala/tilelink/Monitor.scala:42:11]
          $fatal;	// @[generators/rocket-chip/src/main/scala/tilelink/Monitor.scala:42:11]
      end
      if (io_in_d_valid & ~reset & io_in_d_bits_source > 18'h2007F) begin	// @[generators/rocket-chip/src/main/scala/diplomacy/Parameters.scala:57:20, generators/rocket-chip/src/main/scala/tilelink/Monitor.scala:42:11, :49:11]
        if (`ASSERT_VERBOSE_COND_)	// @[generators/rocket-chip/src/main/scala/tilelink/Monitor.scala:49:11]
          $error("Assertion failed: 'D' channel AccessAckData carries invalid source ID (connected at generators/rocket-chip/src/main/scala/tilelink/CrossingHelper.scala:30:14)\n    at Monitor.scala:49 assert(cond, message)\n");	// @[generators/rocket-chip/src/main/scala/tilelink/Monitor.scala:49:11]
        if (`STOP_COND_)	// @[generators/rocket-chip/src/main/scala/tilelink/Monitor.scala:49:11]
          $fatal;	// @[generators/rocket-chip/src/main/scala/tilelink/Monitor.scala:49:11]
      end
      if (_GEN_10 & io_in_a_bits_opcode != opcode) begin	// @[generators/rocket-chip/src/main/scala/tilelink/Monitor.scala:42:11, :384:22, :390:32]
        if (`ASSERT_VERBOSE_COND_)	// @[generators/rocket-chip/src/main/scala/tilelink/Monitor.scala:42:11]
          $error("Assertion failed: 'A' channel opcode changed within multibeat operation (connected at generators/rocket-chip/src/main/scala/tilelink/CrossingHelper.scala:30:14)\n    at Monitor.scala:42 assert(cond, message)\n");	// @[generators/rocket-chip/src/main/scala/tilelink/Monitor.scala:42:11]
        if (`STOP_COND_)	// @[generators/rocket-chip/src/main/scala/tilelink/Monitor.scala:42:11]
          $fatal;	// @[generators/rocket-chip/src/main/scala/tilelink/Monitor.scala:42:11]
      end
      if (_GEN_10 & io_in_a_bits_param != param) begin	// @[generators/rocket-chip/src/main/scala/tilelink/Monitor.scala:42:11, :385:22, :391:32]
        if (`ASSERT_VERBOSE_COND_)	// @[generators/rocket-chip/src/main/scala/tilelink/Monitor.scala:42:11]
          $error("Assertion failed: 'A' channel param changed within multibeat operation (connected at generators/rocket-chip/src/main/scala/tilelink/CrossingHelper.scala:30:14)\n    at Monitor.scala:42 assert(cond, message)\n");	// @[generators/rocket-chip/src/main/scala/tilelink/Monitor.scala:42:11]
        if (`STOP_COND_)	// @[generators/rocket-chip/src/main/scala/tilelink/Monitor.scala:42:11]
          $fatal;	// @[generators/rocket-chip/src/main/scala/tilelink/Monitor.scala:42:11]
      end
      if (_GEN_10 & io_in_a_bits_size != size) begin	// @[generators/rocket-chip/src/main/scala/tilelink/Monitor.scala:42:11, :386:22, :392:32]
        if (`ASSERT_VERBOSE_COND_)	// @[generators/rocket-chip/src/main/scala/tilelink/Monitor.scala:42:11]
          $error("Assertion failed: 'A' channel size changed within multibeat operation (connected at generators/rocket-chip/src/main/scala/tilelink/CrossingHelper.scala:30:14)\n    at Monitor.scala:42 assert(cond, message)\n");	// @[generators/rocket-chip/src/main/scala/tilelink/Monitor.scala:42:11]
        if (`STOP_COND_)	// @[generators/rocket-chip/src/main/scala/tilelink/Monitor.scala:42:11]
          $fatal;	// @[generators/rocket-chip/src/main/scala/tilelink/Monitor.scala:42:11]
      end
      if (_GEN_10 & io_in_a_bits_source != source) begin	// @[generators/rocket-chip/src/main/scala/tilelink/Monitor.scala:42:11, :387:22, :393:32]
        if (`ASSERT_VERBOSE_COND_)	// @[generators/rocket-chip/src/main/scala/tilelink/Monitor.scala:42:11]
          $error("Assertion failed: 'A' channel source changed within multibeat operation (connected at generators/rocket-chip/src/main/scala/tilelink/CrossingHelper.scala:30:14)\n    at Monitor.scala:42 assert(cond, message)\n");	// @[generators/rocket-chip/src/main/scala/tilelink/Monitor.scala:42:11]
        if (`STOP_COND_)	// @[generators/rocket-chip/src/main/scala/tilelink/Monitor.scala:42:11]
          $fatal;	// @[generators/rocket-chip/src/main/scala/tilelink/Monitor.scala:42:11]
      end
      if (_GEN_10 & io_in_a_bits_address != address) begin	// @[generators/rocket-chip/src/main/scala/tilelink/Monitor.scala:42:11, :388:22, :394:32]
        if (`ASSERT_VERBOSE_COND_)	// @[generators/rocket-chip/src/main/scala/tilelink/Monitor.scala:42:11]
          $error("Assertion failed: 'A' channel address changed with multibeat operation (connected at generators/rocket-chip/src/main/scala/tilelink/CrossingHelper.scala:30:14)\n    at Monitor.scala:42 assert(cond, message)\n");	// @[generators/rocket-chip/src/main/scala/tilelink/Monitor.scala:42:11]
        if (`STOP_COND_)	// @[generators/rocket-chip/src/main/scala/tilelink/Monitor.scala:42:11]
          $fatal;	// @[generators/rocket-chip/src/main/scala/tilelink/Monitor.scala:42:11]
      end
      if (_GEN_11 & io_in_d_bits_size != size_1) begin	// @[generators/rocket-chip/src/main/scala/tilelink/Monitor.scala:49:11, :537:22, :544:29]
        if (`ASSERT_VERBOSE_COND_)	// @[generators/rocket-chip/src/main/scala/tilelink/Monitor.scala:49:11]
          $error("Assertion failed: 'D' channel size changed within multibeat operation (connected at generators/rocket-chip/src/main/scala/tilelink/CrossingHelper.scala:30:14)\n    at Monitor.scala:49 assert(cond, message)\n");	// @[generators/rocket-chip/src/main/scala/tilelink/Monitor.scala:49:11]
        if (`STOP_COND_)	// @[generators/rocket-chip/src/main/scala/tilelink/Monitor.scala:49:11]
          $fatal;	// @[generators/rocket-chip/src/main/scala/tilelink/Monitor.scala:49:11]
      end
      if (_GEN_11 & io_in_d_bits_source != source_1) begin	// @[generators/rocket-chip/src/main/scala/tilelink/Monitor.scala:49:11, :538:22, :545:29]
        if (`ASSERT_VERBOSE_COND_)	// @[generators/rocket-chip/src/main/scala/tilelink/Monitor.scala:49:11]
          $error("Assertion failed: 'D' channel source changed within multibeat operation (connected at generators/rocket-chip/src/main/scala/tilelink/CrossingHelper.scala:30:14)\n    at Monitor.scala:49 assert(cond, message)\n");	// @[generators/rocket-chip/src/main/scala/tilelink/Monitor.scala:49:11]
        if (`STOP_COND_)	// @[generators/rocket-chip/src/main/scala/tilelink/Monitor.scala:49:11]
          $fatal;	// @[generators/rocket-chip/src/main/scala/tilelink/Monitor.scala:49:11]
      end
    end // always @(posedge)
  `endif // not def SYNTHESIS
  wire        a_first_done = io_in_a_ready & io_in_a_valid;	// @[src/main/scala/chisel3/util/Decoupled.scala:52:35]
  wire        d_first_done = io_in_d_ready & io_in_d_valid;	// @[src/main/scala/chisel3/util/Decoupled.scala:52:35]
  always @(posedge clock) begin
    if (reset) begin
      a_first_counter <= 1'h0;	// @[generators/rocket-chip/src/main/scala/tilelink/Edges.scala:229:27, generators/rocket-chip/src/main/scala/tilelink/Monitor.scala:17:14, :49:11]
      d_first_counter <= 1'h0;	// @[generators/rocket-chip/src/main/scala/tilelink/Edges.scala:229:27, generators/rocket-chip/src/main/scala/tilelink/Monitor.scala:17:14, :49:11]
    end
    else begin
      a_first_counter <= (~a_first_done | a_first_counter - 1'h1) & a_first_counter;	// @[generators/rocket-chip/src/main/scala/tilelink/Edges.scala:229:27, :230:28, :235:17, :236:15, src/main/scala/chisel3/util/Decoupled.scala:52:35]
      d_first_counter <= (~d_first_done | d_first_counter - 1'h1) & d_first_counter;	// @[generators/rocket-chip/src/main/scala/tilelink/Edges.scala:229:27, :230:28, :235:17, :236:15, src/main/scala/chisel3/util/Decoupled.scala:52:35]
    end
    if (a_first_done & ~a_first_counter) begin	// @[generators/rocket-chip/src/main/scala/tilelink/Edges.scala:229:27, :231:25, generators/rocket-chip/src/main/scala/tilelink/Monitor.scala:396:18, src/main/scala/chisel3/util/Decoupled.scala:52:35]
      opcode <= io_in_a_bits_opcode;	// @[generators/rocket-chip/src/main/scala/tilelink/Monitor.scala:384:22]
      param <= io_in_a_bits_param;	// @[generators/rocket-chip/src/main/scala/tilelink/Monitor.scala:385:22]
      size <= io_in_a_bits_size;	// @[generators/rocket-chip/src/main/scala/tilelink/Monitor.scala:386:22]
      source <= io_in_a_bits_source;	// @[generators/rocket-chip/src/main/scala/tilelink/Monitor.scala:387:22]
      address <= io_in_a_bits_address;	// @[generators/rocket-chip/src/main/scala/tilelink/Monitor.scala:388:22]
    end
    if (d_first_done & ~d_first_counter) begin	// @[generators/rocket-chip/src/main/scala/tilelink/Edges.scala:229:27, :231:25, generators/rocket-chip/src/main/scala/tilelink/Monitor.scala:549:18, src/main/scala/chisel3/util/Decoupled.scala:52:35]
      size_1 <= io_in_d_bits_size;	// @[generators/rocket-chip/src/main/scala/tilelink/Monitor.scala:537:22]
      source_1 <= io_in_d_bits_source;	// @[generators/rocket-chip/src/main/scala/tilelink/Monitor.scala:538:22]
    end
  end // always @(posedge)
  `ifdef ENABLE_INITIAL_REG_
    `ifdef FIRRTL_BEFORE_INITIAL
      `FIRRTL_BEFORE_INITIAL
    `endif // FIRRTL_BEFORE_INITIAL
    logic [31:0] _RANDOM[0:2];
    initial begin
      `ifdef INIT_RANDOM_PROLOG_
        `INIT_RANDOM_PROLOG_
      `endif // INIT_RANDOM_PROLOG_
      `ifdef RANDOMIZE_REG_INIT
        for (logic [1:0] i = 2'h0; i < 2'h3; i += 2'h1) begin
          _RANDOM[i] = `RANDOM;
        end
        a_first_counter = _RANDOM[2'h0][0];	// @[generators/rocket-chip/src/main/scala/tilelink/Edges.scala:229:27]
        opcode = _RANDOM[2'h0][3:1];	// @[generators/rocket-chip/src/main/scala/tilelink/Edges.scala:229:27, generators/rocket-chip/src/main/scala/tilelink/Monitor.scala:384:22]
        param = _RANDOM[2'h0][6:4];	// @[generators/rocket-chip/src/main/scala/tilelink/Edges.scala:229:27, generators/rocket-chip/src/main/scala/tilelink/Monitor.scala:385:22]
        size = _RANDOM[2'h0][7];	// @[generators/rocket-chip/src/main/scala/tilelink/Edges.scala:229:27, generators/rocket-chip/src/main/scala/tilelink/Monitor.scala:386:22]
        source = _RANDOM[2'h0][25:8];	// @[generators/rocket-chip/src/main/scala/tilelink/Edges.scala:229:27, generators/rocket-chip/src/main/scala/tilelink/Monitor.scala:387:22]
        address = {_RANDOM[2'h0][31:26], _RANDOM[2'h1][23:0]};	// @[generators/rocket-chip/src/main/scala/tilelink/Edges.scala:229:27, generators/rocket-chip/src/main/scala/tilelink/Monitor.scala:388:22]
        d_first_counter = _RANDOM[2'h1][24];	// @[generators/rocket-chip/src/main/scala/tilelink/Edges.scala:229:27, generators/rocket-chip/src/main/scala/tilelink/Monitor.scala:388:22]
        size_1 = _RANDOM[2'h1][30];	// @[generators/rocket-chip/src/main/scala/tilelink/Monitor.scala:388:22, :537:22]
        source_1 = {_RANDOM[2'h1][31], _RANDOM[2'h2][16:0]};	// @[generators/rocket-chip/src/main/scala/tilelink/Monitor.scala:388:22, :538:22]
      `endif // RANDOMIZE_REG_INIT
    end // initial
    `ifdef FIRRTL_AFTER_INITIAL
      `FIRRTL_AFTER_INITIAL
    `endif // FIRRTL_AFTER_INITIAL
  `endif // ENABLE_INITIAL_REG_
endmodule

