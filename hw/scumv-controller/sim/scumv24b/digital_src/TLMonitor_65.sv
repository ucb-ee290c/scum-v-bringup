// Generated by CIRCT unknown git version
// Standard header to adapt well known macros for register randomization.
`ifndef RANDOMIZE
  `ifdef RANDOMIZE_MEM_INIT
    `define RANDOMIZE
  `endif // RANDOMIZE_MEM_INIT
`endif // not def RANDOMIZE
`ifndef RANDOMIZE
  `ifdef RANDOMIZE_REG_INIT
    `define RANDOMIZE
  `endif // RANDOMIZE_REG_INIT
`endif // not def RANDOMIZE

// RANDOM may be set to an expression that produces a 32-bit random unsigned value.
`ifndef RANDOM
  `define RANDOM $random
`endif // not def RANDOM

// Users can define INIT_RANDOM as general code that gets injected into the
// initializer block for modules with registers.
`ifndef INIT_RANDOM
  `define INIT_RANDOM
`endif // not def INIT_RANDOM

// If using random initialization, you can also define RANDOMIZE_DELAY to
// customize the delay used, otherwise 0.002 is used.
`ifndef RANDOMIZE_DELAY
  `define RANDOMIZE_DELAY 0.002
`endif // not def RANDOMIZE_DELAY

// Define INIT_RANDOM_PROLOG_ for use in our modules below.
`ifndef INIT_RANDOM_PROLOG_
  `ifdef RANDOMIZE
    `ifdef VERILATOR
      `define INIT_RANDOM_PROLOG_ `INIT_RANDOM
    `else  // VERILATOR
      `define INIT_RANDOM_PROLOG_ `INIT_RANDOM #`RANDOMIZE_DELAY begin end
    `endif // VERILATOR
  `else  // RANDOMIZE
    `define INIT_RANDOM_PROLOG_
  `endif // RANDOMIZE
`endif // not def INIT_RANDOM_PROLOG_

// Include register initializers in init blocks unless synthesis is set
`ifndef SYNTHESIS
  `ifndef ENABLE_INITIAL_REG_
    `define ENABLE_INITIAL_REG_
  `endif // not def ENABLE_INITIAL_REG_
`endif // not def SYNTHESIS

// Include rmemory initializers in init blocks unless synthesis is set
`ifndef SYNTHESIS
  `ifndef ENABLE_INITIAL_MEM_
    `define ENABLE_INITIAL_MEM_
  `endif // not def ENABLE_INITIAL_MEM_
`endif // not def SYNTHESIS

// Standard header to adapt well known macros for prints and assertions.

// Users can define 'PRINTF_COND' to add an extra gate to prints.
`ifndef PRINTF_COND_
  `ifdef PRINTF_COND
    `define PRINTF_COND_ (`PRINTF_COND)
  `else  // PRINTF_COND
    `define PRINTF_COND_ 1
  `endif // PRINTF_COND
`endif // not def PRINTF_COND_

// Users can define 'ASSERT_VERBOSE_COND' to add an extra gate to assert error printing.
`ifndef ASSERT_VERBOSE_COND_
  `ifdef ASSERT_VERBOSE_COND
    `define ASSERT_VERBOSE_COND_ (`ASSERT_VERBOSE_COND)
  `else  // ASSERT_VERBOSE_COND
    `define ASSERT_VERBOSE_COND_ 1
  `endif // ASSERT_VERBOSE_COND
`endif // not def ASSERT_VERBOSE_COND_

// Users can define 'STOP_COND' to add an extra gate to stop conditions.
`ifndef STOP_COND_
  `ifdef STOP_COND
    `define STOP_COND_ (`STOP_COND)
  `else  // STOP_COND
    `define STOP_COND_ 1
  `endif // STOP_COND
`endif // not def STOP_COND_

module TLMonitor_65(
  input        clock,
               reset,
               io_in_a_ready,	// @[generators/rocket-chip/src/main/scala/tilelink/Monitor.scala:17:14]
               io_in_a_valid,	// @[generators/rocket-chip/src/main/scala/tilelink/Monitor.scala:17:14]
  input [31:0] io_in_a_bits_address,	// @[generators/rocket-chip/src/main/scala/tilelink/Monitor.scala:17:14]
  input        io_in_d_valid,	// @[generators/rocket-chip/src/main/scala/tilelink/Monitor.scala:17:14]
  input [2:0]  io_in_d_bits_opcode,	// @[generators/rocket-chip/src/main/scala/tilelink/Monitor.scala:17:14]
  input [1:0]  io_in_d_bits_param,	// @[generators/rocket-chip/src/main/scala/tilelink/Monitor.scala:17:14]
  input [2:0]  io_in_d_bits_size,	// @[generators/rocket-chip/src/main/scala/tilelink/Monitor.scala:17:14]
  input        io_in_d_bits_source,	// @[generators/rocket-chip/src/main/scala/tilelink/Monitor.scala:17:14]
  input [1:0]  io_in_d_bits_sink,	// @[generators/rocket-chip/src/main/scala/tilelink/Monitor.scala:17:14]
  input        io_in_d_bits_denied,	// @[generators/rocket-chip/src/main/scala/tilelink/Monitor.scala:17:14]
               io_in_d_bits_corrupt	// @[generators/rocket-chip/src/main/scala/tilelink/Monitor.scala:17:14]
);

  wire [31:0] _plusarg_reader_1_out;	// @[generators/rocket-chip/src/main/scala/util/PlusArg.scala:80:11]
  wire [31:0] _plusarg_reader_out;	// @[generators/rocket-chip/src/main/scala/util/PlusArg.scala:80:11]
  wire        _a_first_T_1 = io_in_a_ready & io_in_a_valid;	// @[src/main/scala/chisel3/util/Decoupled.scala:52:35]
  reg  [3:0]  a_first_counter;	// @[generators/rocket-chip/src/main/scala/tilelink/Edges.scala:229:27]
  reg  [31:0] address;	// @[generators/rocket-chip/src/main/scala/tilelink/Monitor.scala:388:22]
  reg  [3:0]  d_first_counter;	// @[generators/rocket-chip/src/main/scala/tilelink/Edges.scala:229:27]
  reg  [2:0]  opcode_1;	// @[generators/rocket-chip/src/main/scala/tilelink/Monitor.scala:535:22]
  reg  [1:0]  param_1;	// @[generators/rocket-chip/src/main/scala/tilelink/Monitor.scala:536:22]
  reg  [2:0]  size_1;	// @[generators/rocket-chip/src/main/scala/tilelink/Monitor.scala:537:22]
  reg         source_1;	// @[generators/rocket-chip/src/main/scala/tilelink/Monitor.scala:538:22]
  reg  [1:0]  sink;	// @[generators/rocket-chip/src/main/scala/tilelink/Monitor.scala:539:22]
  reg         denied;	// @[generators/rocket-chip/src/main/scala/tilelink/Monitor.scala:540:22]
  reg  [1:0]  inflight;	// @[generators/rocket-chip/src/main/scala/tilelink/Monitor.scala:611:27]
  reg  [7:0]  inflight_opcodes;	// @[generators/rocket-chip/src/main/scala/tilelink/Monitor.scala:613:35]
  reg  [7:0]  inflight_sizes;	// @[generators/rocket-chip/src/main/scala/tilelink/Monitor.scala:615:33]
  reg  [3:0]  a_first_counter_1;	// @[generators/rocket-chip/src/main/scala/tilelink/Edges.scala:229:27]
  wire        a_first_1 = a_first_counter_1 == 4'h0;	// @[generators/rocket-chip/src/main/scala/tilelink/Edges.scala:221:14, :229:27, :231:25]
  reg  [3:0]  d_first_counter_1;	// @[generators/rocket-chip/src/main/scala/tilelink/Edges.scala:229:27]
  wire        d_first_1 = d_first_counter_1 == 4'h0;	// @[generators/rocket-chip/src/main/scala/tilelink/Edges.scala:221:14, :229:27, :231:25]
  wire        _GEN = _a_first_T_1 & a_first_1;	// @[generators/rocket-chip/src/main/scala/tilelink/Edges.scala:231:25, generators/rocket-chip/src/main/scala/tilelink/Monitor.scala:652:25, src/main/scala/chisel3/util/Decoupled.scala:52:35]
  wire        d_release_ack = io_in_d_bits_opcode == 3'h6;	// @[generators/rocket-chip/src/main/scala/tilelink/Monitor.scala:670:46]
  wire        _GEN_0 = io_in_d_valid & d_first_1;	// @[generators/rocket-chip/src/main/scala/tilelink/Edges.scala:231:25, generators/rocket-chip/src/main/scala/tilelink/Monitor.scala:671:26]
  wire        _GEN_1 = _GEN_0 & ~d_release_ack;	// @[generators/rocket-chip/src/main/scala/tilelink/Monitor.scala:670:46, :671:{26,71,74}]
  wire [1:0]  _GEN_2 = {1'h0, io_in_d_bits_source};	// @[generators/rocket-chip/src/main/scala/tilelink/Monitor.scala:312:27, src/main/scala/chisel3/util/OneHot.scala:58:35]
  reg  [31:0] watchdog;	// @[generators/rocket-chip/src/main/scala/tilelink/Monitor.scala:706:27]
  reg  [1:0]  inflight_1;	// @[generators/rocket-chip/src/main/scala/tilelink/Monitor.scala:723:35]
  reg  [7:0]  inflight_sizes_1;	// @[generators/rocket-chip/src/main/scala/tilelink/Monitor.scala:725:35]
  reg  [3:0]  d_first_counter_2;	// @[generators/rocket-chip/src/main/scala/tilelink/Edges.scala:229:27]
  wire        d_first_2 = d_first_counter_2 == 4'h0;	// @[generators/rocket-chip/src/main/scala/tilelink/Edges.scala:221:14, :229:27, :231:25]
  wire        _GEN_3 = io_in_d_valid & d_first_2 & d_release_ack;	// @[generators/rocket-chip/src/main/scala/tilelink/Edges.scala:231:25, generators/rocket-chip/src/main/scala/tilelink/Monitor.scala:670:46, :785:70]
  reg  [31:0] watchdog_1;	// @[generators/rocket-chip/src/main/scala/tilelink/Monitor.scala:815:27]
  `ifndef SYNTHESIS	// @[generators/rocket-chip/src/main/scala/tilelink/Monitor.scala:42:11]
    wire [7:0][2:0] _GEN_4 = '{3'h4, 3'h5, 3'h2, 3'h1, 3'h1, 3'h1, 3'h0, 3'h0};	// @[generators/rocket-chip/src/main/scala/tilelink/Monitor.scala:690:38]
    wire [7:0][2:0] _GEN_5 = '{3'h4, 3'h4, 3'h2, 3'h1, 3'h1, 3'h1, 3'h0, 3'h0};	// @[generators/rocket-chip/src/main/scala/tilelink/Monitor.scala:689:38]
    wire            _GEN_6 = io_in_a_valid & ~reset;	// @[generators/rocket-chip/src/main/scala/tilelink/Monitor.scala:42:11]
    wire            _GEN_7 = io_in_d_valid & io_in_d_bits_opcode == 3'h6 & ~reset;	// @[generators/rocket-chip/src/main/scala/tilelink/Monitor.scala:42:11, :49:11, :310:25]
    wire            _GEN_8 = io_in_d_bits_size[2:1] == 2'h0;	// @[generators/rocket-chip/src/main/scala/tilelink/Monitor.scala:312:27, generators/rocket-chip/src/main/scala/util/Misc.scala:202:34]
    wire            _GEN_9 = io_in_d_valid & io_in_d_bits_opcode == 3'h4 & ~reset;	// @[generators/rocket-chip/src/main/scala/tilelink/Monitor.scala:42:11, :49:11, :318:25]
    wire            _GEN_10 = io_in_d_bits_param == 2'h2;	// @[generators/rocket-chip/src/main/scala/tilelink/Monitor.scala:323:28, src/main/scala/chisel3/util/OneHot.scala:58:35]
    wire            _GEN_11 = io_in_d_valid & io_in_d_bits_opcode == 3'h5 & ~reset;	// @[generators/rocket-chip/src/main/scala/tilelink/Monitor.scala:42:11, :49:11, :328:25]
    wire            _GEN_12 = ~io_in_d_bits_denied | io_in_d_bits_corrupt;	// @[generators/rocket-chip/src/main/scala/tilelink/Monitor.scala:334:{15,30}]
    wire            _GEN_13 = io_in_d_valid & io_in_d_bits_opcode == 3'h0 & ~reset;	// @[generators/rocket-chip/src/main/scala/tilelink/Monitor.scala:42:11, :49:11, :338:25]
    wire            _GEN_14 = io_in_d_bits_opcode == 3'h1;	// @[generators/rocket-chip/src/main/scala/tilelink/Monitor.scala:346:25]
    wire            _GEN_15 = io_in_d_valid & _GEN_14 & ~reset;	// @[generators/rocket-chip/src/main/scala/tilelink/Monitor.scala:42:11, :49:11, :346:25]
    wire            _GEN_16 = io_in_d_valid & io_in_d_bits_opcode == 3'h2 & ~reset;	// @[generators/rocket-chip/src/main/scala/tilelink/Monitor.scala:42:11, :49:11, :354:25]
    wire            _GEN_17 = io_in_d_valid & (|d_first_counter) & ~reset;	// @[generators/rocket-chip/src/main/scala/tilelink/Edges.scala:229:27, :231:25, generators/rocket-chip/src/main/scala/tilelink/Monitor.scala:42:11, :49:11]
    wire [7:0]      _GEN_18 = {5'h0, io_in_d_bits_source, 2'h0};	// @[generators/rocket-chip/src/main/scala/tilelink/Monitor.scala:634:44, generators/rocket-chip/src/main/scala/util/Misc.scala:202:34]
    wire [7:0]      _a_opcode_lookup_T_1 = inflight_opcodes >> _GEN_18;	// @[generators/rocket-chip/src/main/scala/tilelink/Monitor.scala:613:35, :634:44]
    wire            _same_cycle_resp_T_1 = io_in_a_valid & a_first_1;	// @[generators/rocket-chip/src/main/scala/tilelink/Edges.scala:231:25, generators/rocket-chip/src/main/scala/tilelink/Monitor.scala:648:26]
    wire            same_cycle_resp = _same_cycle_resp_T_1 & io_in_d_bits_source;	// @[generators/rocket-chip/src/main/scala/tilelink/Monitor.scala:648:26, :681:88]
    wire            _GEN_19 = _GEN_1 & same_cycle_resp & ~reset;	// @[generators/rocket-chip/src/main/scala/tilelink/Monitor.scala:42:11, :49:11, :671:71, :681:88]
    wire            _GEN_20 = _GEN_1 & ~same_cycle_resp & ~reset;	// @[generators/rocket-chip/src/main/scala/tilelink/Monitor.scala:42:11, :49:11, :671:71, :681:88, :684:30]
    wire            _GEN_21 = _GEN_3 & ~reset;	// @[generators/rocket-chip/src/main/scala/tilelink/Monitor.scala:42:11, :49:11, :785:70]
    wire [1:0]      _GEN_22 = inflight >> _GEN_2;	// @[generators/rocket-chip/src/main/scala/tilelink/Monitor.scala:611:27, :682:25, src/main/scala/chisel3/util/OneHot.scala:58:35]
    wire [7:0]      _a_size_lookup_T_1 = inflight_sizes >> _GEN_18;	// @[generators/rocket-chip/src/main/scala/tilelink/Monitor.scala:615:33, :634:44, :638:40]
    wire [1:0]      _GEN_23 = inflight_1 >> _GEN_2;	// @[generators/rocket-chip/src/main/scala/tilelink/Monitor.scala:723:35, :793:25, src/main/scala/chisel3/util/OneHot.scala:58:35]
    wire [7:0]      _c_size_lookup_T_1 = inflight_sizes_1 >> _GEN_18;	// @[generators/rocket-chip/src/main/scala/tilelink/Monitor.scala:634:44, :725:35, :747:42]
    always @(posedge clock) begin	// @[generators/rocket-chip/src/main/scala/tilelink/Monitor.scala:42:11]
      if (_GEN_6 & ~(io_in_a_bits_address[31:13] == 19'h0 | {io_in_a_bits_address[31:15], io_in_a_bits_address[14:12] ^ 3'h5} == 20'h0 | {io_in_a_bits_address[31:15], io_in_a_bits_address[14:12] ^ 3'h6} == 20'h0 | {io_in_a_bits_address[31:16], io_in_a_bits_address[15:12] ^ 4'h8} == 20'h0 | {io_in_a_bits_address[31:16], io_in_a_bits_address[15:13] ^ 3'h5} == 19'h0 | {io_in_a_bits_address[31:17], ~(io_in_a_bits_address[16])} == 16'h0 | {io_in_a_bits_address[31:21], io_in_a_bits_address[20:17] ^ 4'h8, io_in_a_bits_address[15:12]} == 19'h0 | {io_in_a_bits_address[31:26], io_in_a_bits_address[25:16] ^ 10'h200} == 16'h0 | {io_in_a_bits_address[31:28], ~(io_in_a_bits_address[27:26])} == 6'h0 | {io_in_a_bits_address[31:29], io_in_a_bits_address[28:12] ^ 17'h10010} == 20'h0 | {io_in_a_bits_address[31:29], io_in_a_bits_address[28:17] ^ 12'h801, io_in_a_bits_address[15:12]} == 19'h0 | {io_in_a_bits_address[31:30], io_in_a_bits_address[29:28] ^ 2'h2} == 4'h0 | io_in_a_bits_address[31:18] == 14'h2000)) begin	// @[generators/rocket-chip/src/main/scala/diplomacy/Parameters.scala:137:{31,41,46,59}, generators/rocket-chip/src/main/scala/tilelink/Bundles.scala:259:74, generators/rocket-chip/src/main/scala/tilelink/Edges.scala:221:14, generators/rocket-chip/src/main/scala/tilelink/Monitor.scala:17:14, :42:11, generators/rocket-chip/src/main/scala/tilelink/Parameters.scala:672:42, src/main/scala/chisel3/util/OneHot.scala:58:35]
        if (`ASSERT_VERBOSE_COND_)	// @[generators/rocket-chip/src/main/scala/tilelink/Monitor.scala:42:11]
          $error("Assertion failed: 'A' channel carries Get type which slave claims it can't support (connected at generators/dma/src/main/scala/dma/DMA.scala:120:13)\n    at Monitor.scala:42 assert(cond, message)\n");	// @[generators/rocket-chip/src/main/scala/tilelink/Monitor.scala:42:11]
        if (`STOP_COND_)	// @[generators/rocket-chip/src/main/scala/tilelink/Monitor.scala:42:11]
          $fatal;	// @[generators/rocket-chip/src/main/scala/tilelink/Monitor.scala:42:11]
      end
      if (_GEN_6 & (|(io_in_a_bits_address[1:0]))) begin	// @[generators/rocket-chip/src/main/scala/tilelink/Edges.scala:21:{16,24}, generators/rocket-chip/src/main/scala/tilelink/Monitor.scala:42:11]
        if (`ASSERT_VERBOSE_COND_)	// @[generators/rocket-chip/src/main/scala/tilelink/Monitor.scala:42:11]
          $error("Assertion failed: 'A' channel Get address not aligned to size (connected at generators/dma/src/main/scala/dma/DMA.scala:120:13)\n    at Monitor.scala:42 assert(cond, message)\n");	// @[generators/rocket-chip/src/main/scala/tilelink/Monitor.scala:42:11]
        if (`STOP_COND_)	// @[generators/rocket-chip/src/main/scala/tilelink/Monitor.scala:42:11]
          $fatal;	// @[generators/rocket-chip/src/main/scala/tilelink/Monitor.scala:42:11]
      end
      if (io_in_d_valid & ~reset & (&io_in_d_bits_opcode)) begin	// @[generators/rocket-chip/src/main/scala/tilelink/Bundles.scala:45:24, generators/rocket-chip/src/main/scala/tilelink/Monitor.scala:42:11, :49:11]
        if (`ASSERT_VERBOSE_COND_)	// @[generators/rocket-chip/src/main/scala/tilelink/Monitor.scala:49:11]
          $error("Assertion failed: 'D' channel has invalid opcode (connected at generators/dma/src/main/scala/dma/DMA.scala:120:13)\n    at Monitor.scala:49 assert(cond, message)\n");	// @[generators/rocket-chip/src/main/scala/tilelink/Monitor.scala:49:11]
        if (`STOP_COND_)	// @[generators/rocket-chip/src/main/scala/tilelink/Monitor.scala:49:11]
          $fatal;	// @[generators/rocket-chip/src/main/scala/tilelink/Monitor.scala:49:11]
      end
      if (_GEN_7 & ~io_in_d_bits_source) begin	// @[generators/rocket-chip/src/main/scala/tilelink/Monitor.scala:49:11]
        if (`ASSERT_VERBOSE_COND_)	// @[generators/rocket-chip/src/main/scala/tilelink/Monitor.scala:49:11]
          $error("Assertion failed: 'D' channel ReleaseAck carries invalid source ID (connected at generators/dma/src/main/scala/dma/DMA.scala:120:13)\n    at Monitor.scala:49 assert(cond, message)\n");	// @[generators/rocket-chip/src/main/scala/tilelink/Monitor.scala:49:11]
        if (`STOP_COND_)	// @[generators/rocket-chip/src/main/scala/tilelink/Monitor.scala:49:11]
          $fatal;	// @[generators/rocket-chip/src/main/scala/tilelink/Monitor.scala:49:11]
      end
      if (_GEN_7 & _GEN_8) begin	// @[generators/rocket-chip/src/main/scala/tilelink/Monitor.scala:49:11, :312:27]
        if (`ASSERT_VERBOSE_COND_)	// @[generators/rocket-chip/src/main/scala/tilelink/Monitor.scala:49:11]
          $error("Assertion failed: 'D' channel ReleaseAck smaller than a beat (connected at generators/dma/src/main/scala/dma/DMA.scala:120:13)\n    at Monitor.scala:49 assert(cond, message)\n");	// @[generators/rocket-chip/src/main/scala/tilelink/Monitor.scala:49:11]
        if (`STOP_COND_)	// @[generators/rocket-chip/src/main/scala/tilelink/Monitor.scala:49:11]
          $fatal;	// @[generators/rocket-chip/src/main/scala/tilelink/Monitor.scala:49:11]
      end
      if (_GEN_7 & (|io_in_d_bits_param)) begin	// @[generators/rocket-chip/src/main/scala/tilelink/Monitor.scala:49:11, :313:28]
        if (`ASSERT_VERBOSE_COND_)	// @[generators/rocket-chip/src/main/scala/tilelink/Monitor.scala:49:11]
          $error("Assertion failed: 'D' channel ReleaseeAck carries invalid param (connected at generators/dma/src/main/scala/dma/DMA.scala:120:13)\n    at Monitor.scala:49 assert(cond, message)\n");	// @[generators/rocket-chip/src/main/scala/tilelink/Monitor.scala:49:11]
        if (`STOP_COND_)	// @[generators/rocket-chip/src/main/scala/tilelink/Monitor.scala:49:11]
          $fatal;	// @[generators/rocket-chip/src/main/scala/tilelink/Monitor.scala:49:11]
      end
      if (_GEN_7 & io_in_d_bits_corrupt) begin	// @[generators/rocket-chip/src/main/scala/tilelink/Monitor.scala:49:11]
        if (`ASSERT_VERBOSE_COND_)	// @[generators/rocket-chip/src/main/scala/tilelink/Monitor.scala:49:11]
          $error("Assertion failed: 'D' channel ReleaseAck is corrupt (connected at generators/dma/src/main/scala/dma/DMA.scala:120:13)\n    at Monitor.scala:49 assert(cond, message)\n");	// @[generators/rocket-chip/src/main/scala/tilelink/Monitor.scala:49:11]
        if (`STOP_COND_)	// @[generators/rocket-chip/src/main/scala/tilelink/Monitor.scala:49:11]
          $fatal;	// @[generators/rocket-chip/src/main/scala/tilelink/Monitor.scala:49:11]
      end
      if (_GEN_7 & io_in_d_bits_denied) begin	// @[generators/rocket-chip/src/main/scala/tilelink/Monitor.scala:49:11]
        if (`ASSERT_VERBOSE_COND_)	// @[generators/rocket-chip/src/main/scala/tilelink/Monitor.scala:49:11]
          $error("Assertion failed: 'D' channel ReleaseAck is denied (connected at generators/dma/src/main/scala/dma/DMA.scala:120:13)\n    at Monitor.scala:49 assert(cond, message)\n");	// @[generators/rocket-chip/src/main/scala/tilelink/Monitor.scala:49:11]
        if (`STOP_COND_)	// @[generators/rocket-chip/src/main/scala/tilelink/Monitor.scala:49:11]
          $fatal;	// @[generators/rocket-chip/src/main/scala/tilelink/Monitor.scala:49:11]
      end
      if (_GEN_9 & ~io_in_d_bits_source) begin	// @[generators/rocket-chip/src/main/scala/tilelink/Monitor.scala:49:11]
        if (`ASSERT_VERBOSE_COND_)	// @[generators/rocket-chip/src/main/scala/tilelink/Monitor.scala:49:11]
          $error("Assertion failed: 'D' channel Grant carries invalid source ID (connected at generators/dma/src/main/scala/dma/DMA.scala:120:13)\n    at Monitor.scala:49 assert(cond, message)\n");	// @[generators/rocket-chip/src/main/scala/tilelink/Monitor.scala:49:11]
        if (`STOP_COND_)	// @[generators/rocket-chip/src/main/scala/tilelink/Monitor.scala:49:11]
          $fatal;	// @[generators/rocket-chip/src/main/scala/tilelink/Monitor.scala:49:11]
      end
      if (_GEN_9 & _GEN_8) begin	// @[generators/rocket-chip/src/main/scala/tilelink/Monitor.scala:49:11, :312:27]
        if (`ASSERT_VERBOSE_COND_)	// @[generators/rocket-chip/src/main/scala/tilelink/Monitor.scala:49:11]
          $error("Assertion failed: 'D' channel Grant smaller than a beat (connected at generators/dma/src/main/scala/dma/DMA.scala:120:13)\n    at Monitor.scala:49 assert(cond, message)\n");	// @[generators/rocket-chip/src/main/scala/tilelink/Monitor.scala:49:11]
        if (`STOP_COND_)	// @[generators/rocket-chip/src/main/scala/tilelink/Monitor.scala:49:11]
          $fatal;	// @[generators/rocket-chip/src/main/scala/tilelink/Monitor.scala:49:11]
      end
      if (_GEN_9 & (&io_in_d_bits_param)) begin	// @[generators/rocket-chip/src/main/scala/tilelink/Bundles.scala:105:26, generators/rocket-chip/src/main/scala/tilelink/Monitor.scala:49:11]
        if (`ASSERT_VERBOSE_COND_)	// @[generators/rocket-chip/src/main/scala/tilelink/Monitor.scala:49:11]
          $error("Assertion failed: 'D' channel Grant carries invalid cap param (connected at generators/dma/src/main/scala/dma/DMA.scala:120:13)\n    at Monitor.scala:49 assert(cond, message)\n");	// @[generators/rocket-chip/src/main/scala/tilelink/Monitor.scala:49:11]
        if (`STOP_COND_)	// @[generators/rocket-chip/src/main/scala/tilelink/Monitor.scala:49:11]
          $fatal;	// @[generators/rocket-chip/src/main/scala/tilelink/Monitor.scala:49:11]
      end
      if (_GEN_9 & _GEN_10) begin	// @[generators/rocket-chip/src/main/scala/tilelink/Monitor.scala:49:11, :323:28]
        if (`ASSERT_VERBOSE_COND_)	// @[generators/rocket-chip/src/main/scala/tilelink/Monitor.scala:49:11]
          $error("Assertion failed: 'D' channel Grant carries toN param (connected at generators/dma/src/main/scala/dma/DMA.scala:120:13)\n    at Monitor.scala:49 assert(cond, message)\n");	// @[generators/rocket-chip/src/main/scala/tilelink/Monitor.scala:49:11]
        if (`STOP_COND_)	// @[generators/rocket-chip/src/main/scala/tilelink/Monitor.scala:49:11]
          $fatal;	// @[generators/rocket-chip/src/main/scala/tilelink/Monitor.scala:49:11]
      end
      if (_GEN_9 & io_in_d_bits_corrupt) begin	// @[generators/rocket-chip/src/main/scala/tilelink/Monitor.scala:49:11]
        if (`ASSERT_VERBOSE_COND_)	// @[generators/rocket-chip/src/main/scala/tilelink/Monitor.scala:49:11]
          $error("Assertion failed: 'D' channel Grant is corrupt (connected at generators/dma/src/main/scala/dma/DMA.scala:120:13)\n    at Monitor.scala:49 assert(cond, message)\n");	// @[generators/rocket-chip/src/main/scala/tilelink/Monitor.scala:49:11]
        if (`STOP_COND_)	// @[generators/rocket-chip/src/main/scala/tilelink/Monitor.scala:49:11]
          $fatal;	// @[generators/rocket-chip/src/main/scala/tilelink/Monitor.scala:49:11]
      end
      if (_GEN_9 & io_in_d_bits_denied) begin	// @[generators/rocket-chip/src/main/scala/tilelink/Monitor.scala:49:11]
        if (`ASSERT_VERBOSE_COND_)	// @[generators/rocket-chip/src/main/scala/tilelink/Monitor.scala:49:11]
          $error("Assertion failed: 'D' channel Grant is denied (connected at generators/dma/src/main/scala/dma/DMA.scala:120:13)\n    at Monitor.scala:49 assert(cond, message)\n");	// @[generators/rocket-chip/src/main/scala/tilelink/Monitor.scala:49:11]
        if (`STOP_COND_)	// @[generators/rocket-chip/src/main/scala/tilelink/Monitor.scala:49:11]
          $fatal;	// @[generators/rocket-chip/src/main/scala/tilelink/Monitor.scala:49:11]
      end
      if (_GEN_11 & ~io_in_d_bits_source) begin	// @[generators/rocket-chip/src/main/scala/tilelink/Monitor.scala:49:11]
        if (`ASSERT_VERBOSE_COND_)	// @[generators/rocket-chip/src/main/scala/tilelink/Monitor.scala:49:11]
          $error("Assertion failed: 'D' channel GrantData carries invalid source ID (connected at generators/dma/src/main/scala/dma/DMA.scala:120:13)\n    at Monitor.scala:49 assert(cond, message)\n");	// @[generators/rocket-chip/src/main/scala/tilelink/Monitor.scala:49:11]
        if (`STOP_COND_)	// @[generators/rocket-chip/src/main/scala/tilelink/Monitor.scala:49:11]
          $fatal;	// @[generators/rocket-chip/src/main/scala/tilelink/Monitor.scala:49:11]
      end
      if (_GEN_11 & _GEN_8) begin	// @[generators/rocket-chip/src/main/scala/tilelink/Monitor.scala:49:11, :312:27]
        if (`ASSERT_VERBOSE_COND_)	// @[generators/rocket-chip/src/main/scala/tilelink/Monitor.scala:49:11]
          $error("Assertion failed: 'D' channel GrantData smaller than a beat (connected at generators/dma/src/main/scala/dma/DMA.scala:120:13)\n    at Monitor.scala:49 assert(cond, message)\n");	// @[generators/rocket-chip/src/main/scala/tilelink/Monitor.scala:49:11]
        if (`STOP_COND_)	// @[generators/rocket-chip/src/main/scala/tilelink/Monitor.scala:49:11]
          $fatal;	// @[generators/rocket-chip/src/main/scala/tilelink/Monitor.scala:49:11]
      end
      if (_GEN_11 & (&io_in_d_bits_param)) begin	// @[generators/rocket-chip/src/main/scala/tilelink/Bundles.scala:105:26, generators/rocket-chip/src/main/scala/tilelink/Monitor.scala:49:11]
        if (`ASSERT_VERBOSE_COND_)	// @[generators/rocket-chip/src/main/scala/tilelink/Monitor.scala:49:11]
          $error("Assertion failed: 'D' channel GrantData carries invalid cap param (connected at generators/dma/src/main/scala/dma/DMA.scala:120:13)\n    at Monitor.scala:49 assert(cond, message)\n");	// @[generators/rocket-chip/src/main/scala/tilelink/Monitor.scala:49:11]
        if (`STOP_COND_)	// @[generators/rocket-chip/src/main/scala/tilelink/Monitor.scala:49:11]
          $fatal;	// @[generators/rocket-chip/src/main/scala/tilelink/Monitor.scala:49:11]
      end
      if (_GEN_11 & _GEN_10) begin	// @[generators/rocket-chip/src/main/scala/tilelink/Monitor.scala:49:11, :323:28]
        if (`ASSERT_VERBOSE_COND_)	// @[generators/rocket-chip/src/main/scala/tilelink/Monitor.scala:49:11]
          $error("Assertion failed: 'D' channel GrantData carries toN param (connected at generators/dma/src/main/scala/dma/DMA.scala:120:13)\n    at Monitor.scala:49 assert(cond, message)\n");	// @[generators/rocket-chip/src/main/scala/tilelink/Monitor.scala:49:11]
        if (`STOP_COND_)	// @[generators/rocket-chip/src/main/scala/tilelink/Monitor.scala:49:11]
          $fatal;	// @[generators/rocket-chip/src/main/scala/tilelink/Monitor.scala:49:11]
      end
      if (_GEN_11 & ~_GEN_12) begin	// @[generators/rocket-chip/src/main/scala/tilelink/Monitor.scala:49:11, :334:30]
        if (`ASSERT_VERBOSE_COND_)	// @[generators/rocket-chip/src/main/scala/tilelink/Monitor.scala:49:11]
          $error("Assertion failed: 'D' channel GrantData is denied but not corrupt (connected at generators/dma/src/main/scala/dma/DMA.scala:120:13)\n    at Monitor.scala:49 assert(cond, message)\n");	// @[generators/rocket-chip/src/main/scala/tilelink/Monitor.scala:49:11]
        if (`STOP_COND_)	// @[generators/rocket-chip/src/main/scala/tilelink/Monitor.scala:49:11]
          $fatal;	// @[generators/rocket-chip/src/main/scala/tilelink/Monitor.scala:49:11]
      end
      if (_GEN_11 & io_in_d_bits_denied) begin	// @[generators/rocket-chip/src/main/scala/tilelink/Monitor.scala:49:11]
        if (`ASSERT_VERBOSE_COND_)	// @[generators/rocket-chip/src/main/scala/tilelink/Monitor.scala:49:11]
          $error("Assertion failed: 'D' channel GrantData is denied (connected at generators/dma/src/main/scala/dma/DMA.scala:120:13)\n    at Monitor.scala:49 assert(cond, message)\n");	// @[generators/rocket-chip/src/main/scala/tilelink/Monitor.scala:49:11]
        if (`STOP_COND_)	// @[generators/rocket-chip/src/main/scala/tilelink/Monitor.scala:49:11]
          $fatal;	// @[generators/rocket-chip/src/main/scala/tilelink/Monitor.scala:49:11]
      end
      if (_GEN_13 & ~io_in_d_bits_source) begin	// @[generators/rocket-chip/src/main/scala/tilelink/Monitor.scala:49:11]
        if (`ASSERT_VERBOSE_COND_)	// @[generators/rocket-chip/src/main/scala/tilelink/Monitor.scala:49:11]
          $error("Assertion failed: 'D' channel AccessAck carries invalid source ID (connected at generators/dma/src/main/scala/dma/DMA.scala:120:13)\n    at Monitor.scala:49 assert(cond, message)\n");	// @[generators/rocket-chip/src/main/scala/tilelink/Monitor.scala:49:11]
        if (`STOP_COND_)	// @[generators/rocket-chip/src/main/scala/tilelink/Monitor.scala:49:11]
          $fatal;	// @[generators/rocket-chip/src/main/scala/tilelink/Monitor.scala:49:11]
      end
      if (_GEN_13 & (|io_in_d_bits_param)) begin	// @[generators/rocket-chip/src/main/scala/tilelink/Monitor.scala:49:11, :313:28]
        if (`ASSERT_VERBOSE_COND_)	// @[generators/rocket-chip/src/main/scala/tilelink/Monitor.scala:49:11]
          $error("Assertion failed: 'D' channel AccessAck carries invalid param (connected at generators/dma/src/main/scala/dma/DMA.scala:120:13)\n    at Monitor.scala:49 assert(cond, message)\n");	// @[generators/rocket-chip/src/main/scala/tilelink/Monitor.scala:49:11]
        if (`STOP_COND_)	// @[generators/rocket-chip/src/main/scala/tilelink/Monitor.scala:49:11]
          $fatal;	// @[generators/rocket-chip/src/main/scala/tilelink/Monitor.scala:49:11]
      end
      if (_GEN_13 & io_in_d_bits_corrupt) begin	// @[generators/rocket-chip/src/main/scala/tilelink/Monitor.scala:49:11]
        if (`ASSERT_VERBOSE_COND_)	// @[generators/rocket-chip/src/main/scala/tilelink/Monitor.scala:49:11]
          $error("Assertion failed: 'D' channel AccessAck is corrupt (connected at generators/dma/src/main/scala/dma/DMA.scala:120:13)\n    at Monitor.scala:49 assert(cond, message)\n");	// @[generators/rocket-chip/src/main/scala/tilelink/Monitor.scala:49:11]
        if (`STOP_COND_)	// @[generators/rocket-chip/src/main/scala/tilelink/Monitor.scala:49:11]
          $fatal;	// @[generators/rocket-chip/src/main/scala/tilelink/Monitor.scala:49:11]
      end
      if (_GEN_13 & io_in_d_bits_denied) begin	// @[generators/rocket-chip/src/main/scala/tilelink/Monitor.scala:49:11]
        if (`ASSERT_VERBOSE_COND_)	// @[generators/rocket-chip/src/main/scala/tilelink/Monitor.scala:49:11]
          $error("Assertion failed: 'D' channel AccessAck is denied (connected at generators/dma/src/main/scala/dma/DMA.scala:120:13)\n    at Monitor.scala:49 assert(cond, message)\n");	// @[generators/rocket-chip/src/main/scala/tilelink/Monitor.scala:49:11]
        if (`STOP_COND_)	// @[generators/rocket-chip/src/main/scala/tilelink/Monitor.scala:49:11]
          $fatal;	// @[generators/rocket-chip/src/main/scala/tilelink/Monitor.scala:49:11]
      end
      if (_GEN_15 & ~io_in_d_bits_source) begin	// @[generators/rocket-chip/src/main/scala/tilelink/Monitor.scala:49:11]
        if (`ASSERT_VERBOSE_COND_)	// @[generators/rocket-chip/src/main/scala/tilelink/Monitor.scala:49:11]
          $error("Assertion failed: 'D' channel AccessAckData carries invalid source ID (connected at generators/dma/src/main/scala/dma/DMA.scala:120:13)\n    at Monitor.scala:49 assert(cond, message)\n");	// @[generators/rocket-chip/src/main/scala/tilelink/Monitor.scala:49:11]
        if (`STOP_COND_)	// @[generators/rocket-chip/src/main/scala/tilelink/Monitor.scala:49:11]
          $fatal;	// @[generators/rocket-chip/src/main/scala/tilelink/Monitor.scala:49:11]
      end
      if (_GEN_15 & (|io_in_d_bits_param)) begin	// @[generators/rocket-chip/src/main/scala/tilelink/Monitor.scala:49:11, :313:28]
        if (`ASSERT_VERBOSE_COND_)	// @[generators/rocket-chip/src/main/scala/tilelink/Monitor.scala:49:11]
          $error("Assertion failed: 'D' channel AccessAckData carries invalid param (connected at generators/dma/src/main/scala/dma/DMA.scala:120:13)\n    at Monitor.scala:49 assert(cond, message)\n");	// @[generators/rocket-chip/src/main/scala/tilelink/Monitor.scala:49:11]
        if (`STOP_COND_)	// @[generators/rocket-chip/src/main/scala/tilelink/Monitor.scala:49:11]
          $fatal;	// @[generators/rocket-chip/src/main/scala/tilelink/Monitor.scala:49:11]
      end
      if (_GEN_15 & ~_GEN_12) begin	// @[generators/rocket-chip/src/main/scala/tilelink/Monitor.scala:49:11, :334:30]
        if (`ASSERT_VERBOSE_COND_)	// @[generators/rocket-chip/src/main/scala/tilelink/Monitor.scala:49:11]
          $error("Assertion failed: 'D' channel AccessAckData is denied but not corrupt (connected at generators/dma/src/main/scala/dma/DMA.scala:120:13)\n    at Monitor.scala:49 assert(cond, message)\n");	// @[generators/rocket-chip/src/main/scala/tilelink/Monitor.scala:49:11]
        if (`STOP_COND_)	// @[generators/rocket-chip/src/main/scala/tilelink/Monitor.scala:49:11]
          $fatal;	// @[generators/rocket-chip/src/main/scala/tilelink/Monitor.scala:49:11]
      end
      if (_GEN_15 & io_in_d_bits_denied) begin	// @[generators/rocket-chip/src/main/scala/tilelink/Monitor.scala:49:11]
        if (`ASSERT_VERBOSE_COND_)	// @[generators/rocket-chip/src/main/scala/tilelink/Monitor.scala:49:11]
          $error("Assertion failed: 'D' channel AccessAckData is denied (connected at generators/dma/src/main/scala/dma/DMA.scala:120:13)\n    at Monitor.scala:49 assert(cond, message)\n");	// @[generators/rocket-chip/src/main/scala/tilelink/Monitor.scala:49:11]
        if (`STOP_COND_)	// @[generators/rocket-chip/src/main/scala/tilelink/Monitor.scala:49:11]
          $fatal;	// @[generators/rocket-chip/src/main/scala/tilelink/Monitor.scala:49:11]
      end
      if (_GEN_16 & ~io_in_d_bits_source) begin	// @[generators/rocket-chip/src/main/scala/tilelink/Monitor.scala:49:11]
        if (`ASSERT_VERBOSE_COND_)	// @[generators/rocket-chip/src/main/scala/tilelink/Monitor.scala:49:11]
          $error("Assertion failed: 'D' channel HintAck carries invalid source ID (connected at generators/dma/src/main/scala/dma/DMA.scala:120:13)\n    at Monitor.scala:49 assert(cond, message)\n");	// @[generators/rocket-chip/src/main/scala/tilelink/Monitor.scala:49:11]
        if (`STOP_COND_)	// @[generators/rocket-chip/src/main/scala/tilelink/Monitor.scala:49:11]
          $fatal;	// @[generators/rocket-chip/src/main/scala/tilelink/Monitor.scala:49:11]
      end
      if (_GEN_16 & (|io_in_d_bits_param)) begin	// @[generators/rocket-chip/src/main/scala/tilelink/Monitor.scala:49:11, :313:28]
        if (`ASSERT_VERBOSE_COND_)	// @[generators/rocket-chip/src/main/scala/tilelink/Monitor.scala:49:11]
          $error("Assertion failed: 'D' channel HintAck carries invalid param (connected at generators/dma/src/main/scala/dma/DMA.scala:120:13)\n    at Monitor.scala:49 assert(cond, message)\n");	// @[generators/rocket-chip/src/main/scala/tilelink/Monitor.scala:49:11]
        if (`STOP_COND_)	// @[generators/rocket-chip/src/main/scala/tilelink/Monitor.scala:49:11]
          $fatal;	// @[generators/rocket-chip/src/main/scala/tilelink/Monitor.scala:49:11]
      end
      if (_GEN_16 & io_in_d_bits_corrupt) begin	// @[generators/rocket-chip/src/main/scala/tilelink/Monitor.scala:49:11]
        if (`ASSERT_VERBOSE_COND_)	// @[generators/rocket-chip/src/main/scala/tilelink/Monitor.scala:49:11]
          $error("Assertion failed: 'D' channel HintAck is corrupt (connected at generators/dma/src/main/scala/dma/DMA.scala:120:13)\n    at Monitor.scala:49 assert(cond, message)\n");	// @[generators/rocket-chip/src/main/scala/tilelink/Monitor.scala:49:11]
        if (`STOP_COND_)	// @[generators/rocket-chip/src/main/scala/tilelink/Monitor.scala:49:11]
          $fatal;	// @[generators/rocket-chip/src/main/scala/tilelink/Monitor.scala:49:11]
      end
      if (_GEN_16 & io_in_d_bits_denied) begin	// @[generators/rocket-chip/src/main/scala/tilelink/Monitor.scala:49:11]
        if (`ASSERT_VERBOSE_COND_)	// @[generators/rocket-chip/src/main/scala/tilelink/Monitor.scala:49:11]
          $error("Assertion failed: 'D' channel HintAck is denied (connected at generators/dma/src/main/scala/dma/DMA.scala:120:13)\n    at Monitor.scala:49 assert(cond, message)\n");	// @[generators/rocket-chip/src/main/scala/tilelink/Monitor.scala:49:11]
        if (`STOP_COND_)	// @[generators/rocket-chip/src/main/scala/tilelink/Monitor.scala:49:11]
          $fatal;	// @[generators/rocket-chip/src/main/scala/tilelink/Monitor.scala:49:11]
      end
      if (io_in_a_valid & (|a_first_counter) & ~reset & io_in_a_bits_address != address) begin	// @[generators/rocket-chip/src/main/scala/tilelink/Edges.scala:229:27, :231:25, generators/rocket-chip/src/main/scala/tilelink/Monitor.scala:42:11, :388:22, :394:32]
        if (`ASSERT_VERBOSE_COND_)	// @[generators/rocket-chip/src/main/scala/tilelink/Monitor.scala:42:11]
          $error("Assertion failed: 'A' channel address changed with multibeat operation (connected at generators/dma/src/main/scala/dma/DMA.scala:120:13)\n    at Monitor.scala:42 assert(cond, message)\n");	// @[generators/rocket-chip/src/main/scala/tilelink/Monitor.scala:42:11]
        if (`STOP_COND_)	// @[generators/rocket-chip/src/main/scala/tilelink/Monitor.scala:42:11]
          $fatal;	// @[generators/rocket-chip/src/main/scala/tilelink/Monitor.scala:42:11]
      end
      if (_GEN_17 & io_in_d_bits_opcode != opcode_1) begin	// @[generators/rocket-chip/src/main/scala/tilelink/Monitor.scala:49:11, :535:22, :542:29]
        if (`ASSERT_VERBOSE_COND_)	// @[generators/rocket-chip/src/main/scala/tilelink/Monitor.scala:49:11]
          $error("Assertion failed: 'D' channel opcode changed within multibeat operation (connected at generators/dma/src/main/scala/dma/DMA.scala:120:13)\n    at Monitor.scala:49 assert(cond, message)\n");	// @[generators/rocket-chip/src/main/scala/tilelink/Monitor.scala:49:11]
        if (`STOP_COND_)	// @[generators/rocket-chip/src/main/scala/tilelink/Monitor.scala:49:11]
          $fatal;	// @[generators/rocket-chip/src/main/scala/tilelink/Monitor.scala:49:11]
      end
      if (_GEN_17 & io_in_d_bits_param != param_1) begin	// @[generators/rocket-chip/src/main/scala/tilelink/Monitor.scala:49:11, :536:22, :543:29]
        if (`ASSERT_VERBOSE_COND_)	// @[generators/rocket-chip/src/main/scala/tilelink/Monitor.scala:49:11]
          $error("Assertion failed: 'D' channel param changed within multibeat operation (connected at generators/dma/src/main/scala/dma/DMA.scala:120:13)\n    at Monitor.scala:49 assert(cond, message)\n");	// @[generators/rocket-chip/src/main/scala/tilelink/Monitor.scala:49:11]
        if (`STOP_COND_)	// @[generators/rocket-chip/src/main/scala/tilelink/Monitor.scala:49:11]
          $fatal;	// @[generators/rocket-chip/src/main/scala/tilelink/Monitor.scala:49:11]
      end
      if (_GEN_17 & io_in_d_bits_size != size_1) begin	// @[generators/rocket-chip/src/main/scala/tilelink/Monitor.scala:49:11, :537:22, :544:29]
        if (`ASSERT_VERBOSE_COND_)	// @[generators/rocket-chip/src/main/scala/tilelink/Monitor.scala:49:11]
          $error("Assertion failed: 'D' channel size changed within multibeat operation (connected at generators/dma/src/main/scala/dma/DMA.scala:120:13)\n    at Monitor.scala:49 assert(cond, message)\n");	// @[generators/rocket-chip/src/main/scala/tilelink/Monitor.scala:49:11]
        if (`STOP_COND_)	// @[generators/rocket-chip/src/main/scala/tilelink/Monitor.scala:49:11]
          $fatal;	// @[generators/rocket-chip/src/main/scala/tilelink/Monitor.scala:49:11]
      end
      if (_GEN_17 & io_in_d_bits_source != source_1) begin	// @[generators/rocket-chip/src/main/scala/tilelink/Monitor.scala:49:11, :538:22, :545:29]
        if (`ASSERT_VERBOSE_COND_)	// @[generators/rocket-chip/src/main/scala/tilelink/Monitor.scala:49:11]
          $error("Assertion failed: 'D' channel source changed within multibeat operation (connected at generators/dma/src/main/scala/dma/DMA.scala:120:13)\n    at Monitor.scala:49 assert(cond, message)\n");	// @[generators/rocket-chip/src/main/scala/tilelink/Monitor.scala:49:11]
        if (`STOP_COND_)	// @[generators/rocket-chip/src/main/scala/tilelink/Monitor.scala:49:11]
          $fatal;	// @[generators/rocket-chip/src/main/scala/tilelink/Monitor.scala:49:11]
      end
      if (_GEN_17 & io_in_d_bits_sink != sink) begin	// @[generators/rocket-chip/src/main/scala/tilelink/Monitor.scala:49:11, :539:22, :546:29]
        if (`ASSERT_VERBOSE_COND_)	// @[generators/rocket-chip/src/main/scala/tilelink/Monitor.scala:49:11]
          $error("Assertion failed: 'D' channel sink changed with multibeat operation (connected at generators/dma/src/main/scala/dma/DMA.scala:120:13)\n    at Monitor.scala:49 assert(cond, message)\n");	// @[generators/rocket-chip/src/main/scala/tilelink/Monitor.scala:49:11]
        if (`STOP_COND_)	// @[generators/rocket-chip/src/main/scala/tilelink/Monitor.scala:49:11]
          $fatal;	// @[generators/rocket-chip/src/main/scala/tilelink/Monitor.scala:49:11]
      end
      if (_GEN_17 & io_in_d_bits_denied != denied) begin	// @[generators/rocket-chip/src/main/scala/tilelink/Monitor.scala:49:11, :540:22, :547:29]
        if (`ASSERT_VERBOSE_COND_)	// @[generators/rocket-chip/src/main/scala/tilelink/Monitor.scala:49:11]
          $error("Assertion failed: 'D' channel denied changed with multibeat operation (connected at generators/dma/src/main/scala/dma/DMA.scala:120:13)\n    at Monitor.scala:49 assert(cond, message)\n");	// @[generators/rocket-chip/src/main/scala/tilelink/Monitor.scala:49:11]
        if (`STOP_COND_)	// @[generators/rocket-chip/src/main/scala/tilelink/Monitor.scala:49:11]
          $fatal;	// @[generators/rocket-chip/src/main/scala/tilelink/Monitor.scala:49:11]
      end
      if (_GEN & ~reset & inflight[1]) begin	// @[generators/rocket-chip/src/main/scala/diplomacy/Parameters.scala:92:38, generators/rocket-chip/src/main/scala/tilelink/Bundles.scala:111:27, :141:33, :148:30, :161:28, generators/rocket-chip/src/main/scala/tilelink/Monitor.scala:17:14, :42:11, :104:25, :110:30, :119:30, :135:30, :143:30, :151:30, :611:27, :652:25, :658:26, generators/rocket-chip/src/main/scala/util/Misc.scala:206:21]
        if (`ASSERT_VERBOSE_COND_)	// @[generators/rocket-chip/src/main/scala/tilelink/Monitor.scala:42:11]
          $error("Assertion failed: 'A' channel re-used a source ID (connected at generators/dma/src/main/scala/dma/DMA.scala:120:13)\n    at Monitor.scala:42 assert(cond, message)\n");	// @[generators/rocket-chip/src/main/scala/tilelink/Monitor.scala:42:11]
        if (`STOP_COND_)	// @[generators/rocket-chip/src/main/scala/tilelink/Monitor.scala:42:11]
          $fatal;	// @[generators/rocket-chip/src/main/scala/tilelink/Monitor.scala:42:11]
      end
      if (_GEN_1 & ~reset & ~(_GEN_22[0] | same_cycle_resp)) begin	// @[generators/rocket-chip/src/main/scala/tilelink/Monitor.scala:42:11, :49:11, :671:71, :681:88, :682:{25,49}]
        if (`ASSERT_VERBOSE_COND_)	// @[generators/rocket-chip/src/main/scala/tilelink/Monitor.scala:49:11]
          $error("Assertion failed: 'D' channel acknowledged for nothing inflight (connected at generators/dma/src/main/scala/dma/DMA.scala:120:13)\n    at Monitor.scala:49 assert(cond, message)\n");	// @[generators/rocket-chip/src/main/scala/tilelink/Monitor.scala:49:11]
        if (`STOP_COND_)	// @[generators/rocket-chip/src/main/scala/tilelink/Monitor.scala:49:11]
          $fatal;	// @[generators/rocket-chip/src/main/scala/tilelink/Monitor.scala:49:11]
      end
      if (_GEN_19 & ~_GEN_14) begin	// @[generators/rocket-chip/src/main/scala/tilelink/Monitor.scala:49:11, :346:25]
        if (`ASSERT_VERBOSE_COND_)	// @[generators/rocket-chip/src/main/scala/tilelink/Monitor.scala:49:11]
          $error("Assertion failed: 'D' channel contains improper opcode response (connected at generators/dma/src/main/scala/dma/DMA.scala:120:13)\n    at Monitor.scala:49 assert(cond, message)\n");	// @[generators/rocket-chip/src/main/scala/tilelink/Monitor.scala:49:11]
        if (`STOP_COND_)	// @[generators/rocket-chip/src/main/scala/tilelink/Monitor.scala:49:11]
          $fatal;	// @[generators/rocket-chip/src/main/scala/tilelink/Monitor.scala:49:11]
      end
      if (_GEN_19 & io_in_d_bits_size != 3'h2) begin	// @[generators/rocket-chip/src/main/scala/tilelink/Monitor.scala:49:11, :687:36]
        if (`ASSERT_VERBOSE_COND_)	// @[generators/rocket-chip/src/main/scala/tilelink/Monitor.scala:49:11]
          $error("Assertion failed: 'D' channel contains improper response size (connected at generators/dma/src/main/scala/dma/DMA.scala:120:13)\n    at Monitor.scala:49 assert(cond, message)\n");	// @[generators/rocket-chip/src/main/scala/tilelink/Monitor.scala:49:11]
        if (`STOP_COND_)	// @[generators/rocket-chip/src/main/scala/tilelink/Monitor.scala:49:11]
          $fatal;	// @[generators/rocket-chip/src/main/scala/tilelink/Monitor.scala:49:11]
      end
      if (_GEN_20 & ~(io_in_d_bits_opcode == _GEN_5[_a_opcode_lookup_T_1[3:1]] | io_in_d_bits_opcode == _GEN_4[_a_opcode_lookup_T_1[3:1]])) begin	// @[generators/rocket-chip/src/main/scala/tilelink/Monitor.scala:42:11, :49:11, :634:{44,152}, :689:{38,72}, :690:38]
        if (`ASSERT_VERBOSE_COND_)	// @[generators/rocket-chip/src/main/scala/tilelink/Monitor.scala:49:11]
          $error("Assertion failed: 'D' channel contains improper opcode response (connected at generators/dma/src/main/scala/dma/DMA.scala:120:13)\n    at Monitor.scala:49 assert(cond, message)\n");	// @[generators/rocket-chip/src/main/scala/tilelink/Monitor.scala:49:11]
        if (`STOP_COND_)	// @[generators/rocket-chip/src/main/scala/tilelink/Monitor.scala:49:11]
          $fatal;	// @[generators/rocket-chip/src/main/scala/tilelink/Monitor.scala:49:11]
      end
      if (_GEN_20 & io_in_d_bits_size != _a_size_lookup_T_1[3:1]) begin	// @[generators/rocket-chip/src/main/scala/tilelink/Monitor.scala:42:11, :49:11, :638:{40,144}, :691:36]
        if (`ASSERT_VERBOSE_COND_)	// @[generators/rocket-chip/src/main/scala/tilelink/Monitor.scala:49:11]
          $error("Assertion failed: 'D' channel contains improper response size (connected at generators/dma/src/main/scala/dma/DMA.scala:120:13)\n    at Monitor.scala:49 assert(cond, message)\n");	// @[generators/rocket-chip/src/main/scala/tilelink/Monitor.scala:49:11]
        if (`STOP_COND_)	// @[generators/rocket-chip/src/main/scala/tilelink/Monitor.scala:49:11]
          $fatal;	// @[generators/rocket-chip/src/main/scala/tilelink/Monitor.scala:49:11]
      end
      if (_GEN_0 & a_first_1 & io_in_a_valid & io_in_d_bits_source & ~d_release_ack & ~reset & ~io_in_a_ready) begin	// @[generators/rocket-chip/src/main/scala/tilelink/Edges.scala:231:25, generators/rocket-chip/src/main/scala/tilelink/Monitor.scala:42:11, :49:11, :670:46, :671:{26,74}]
        if (`ASSERT_VERBOSE_COND_)	// @[generators/rocket-chip/src/main/scala/tilelink/Monitor.scala:49:11]
          $error("Assertion failed: ready check\n    at Monitor.scala:49 assert(cond, message)\n");	// @[generators/rocket-chip/src/main/scala/tilelink/Monitor.scala:49:11]
        if (`STOP_COND_)	// @[generators/rocket-chip/src/main/scala/tilelink/Monitor.scala:49:11]
          $fatal;	// @[generators/rocket-chip/src/main/scala/tilelink/Monitor.scala:49:11]
      end
      if (~reset & ~({_same_cycle_resp_T_1, 1'h0} != (_GEN_1 ? 2'h1 << _GEN_2 : 2'h0) | ~_same_cycle_resp_T_1)) begin	// @[generators/rocket-chip/src/main/scala/tilelink/Monitor.scala:42:11, :49:11, :312:27, :624:34, :648:{26,71}, :649:22, :662:34, :671:{71,90}, :672:22, :699:{29,48,51}, generators/rocket-chip/src/main/scala/util/Misc.scala:202:34, src/main/scala/chisel3/util/OneHot.scala:58:35]
        if (`ASSERT_VERBOSE_COND_)	// @[generators/rocket-chip/src/main/scala/tilelink/Monitor.scala:49:11]
          $error("Assertion failed: 'A' and 'D' concurrent, despite minlatency > 0 (connected at generators/dma/src/main/scala/dma/DMA.scala:120:13)\n    at Monitor.scala:49 assert(cond, message)\n");	// @[generators/rocket-chip/src/main/scala/tilelink/Monitor.scala:49:11]
        if (`STOP_COND_)	// @[generators/rocket-chip/src/main/scala/tilelink/Monitor.scala:49:11]
          $fatal;	// @[generators/rocket-chip/src/main/scala/tilelink/Monitor.scala:49:11]
      end
      if (~reset & ~(inflight == 2'h0 | _plusarg_reader_out == 32'h0 | watchdog < _plusarg_reader_out)) begin	// @[generators/rocket-chip/src/main/scala/tilelink/Bundles.scala:259:74, generators/rocket-chip/src/main/scala/tilelink/Monitor.scala:42:11, :611:27, :706:27, :709:{26,39,47,59}, generators/rocket-chip/src/main/scala/util/Misc.scala:202:34, generators/rocket-chip/src/main/scala/util/PlusArg.scala:80:11]
        if (`ASSERT_VERBOSE_COND_)	// @[generators/rocket-chip/src/main/scala/tilelink/Monitor.scala:42:11]
          $error("Assertion failed: TileLink timeout expired (connected at generators/dma/src/main/scala/dma/DMA.scala:120:13)\n    at Monitor.scala:42 assert(cond, message)\n");	// @[generators/rocket-chip/src/main/scala/tilelink/Monitor.scala:42:11]
        if (`STOP_COND_)	// @[generators/rocket-chip/src/main/scala/tilelink/Monitor.scala:42:11]
          $fatal;	// @[generators/rocket-chip/src/main/scala/tilelink/Monitor.scala:42:11]
      end
      if (_GEN_21 & ~(_GEN_23[0])) begin	// @[generators/rocket-chip/src/main/scala/tilelink/Monitor.scala:49:11, :793:25]
        if (`ASSERT_VERBOSE_COND_)	// @[generators/rocket-chip/src/main/scala/tilelink/Monitor.scala:49:11]
          $error("Assertion failed: 'D' channel acknowledged for nothing inflight (connected at generators/dma/src/main/scala/dma/DMA.scala:120:13)\n    at Monitor.scala:49 assert(cond, message)\n");	// @[generators/rocket-chip/src/main/scala/tilelink/Monitor.scala:49:11]
        if (`STOP_COND_)	// @[generators/rocket-chip/src/main/scala/tilelink/Monitor.scala:49:11]
          $fatal;	// @[generators/rocket-chip/src/main/scala/tilelink/Monitor.scala:49:11]
      end
      if (_GEN_21 & io_in_d_bits_size != _c_size_lookup_T_1[3:1]) begin	// @[generators/rocket-chip/src/main/scala/tilelink/Monitor.scala:42:11, :49:11, :747:{42,146}, :797:36]
        if (`ASSERT_VERBOSE_COND_)	// @[generators/rocket-chip/src/main/scala/tilelink/Monitor.scala:49:11]
          $error("Assertion failed: 'D' channel contains improper response size (connected at generators/dma/src/main/scala/dma/DMA.scala:120:13)\n    at Monitor.scala:49 assert(cond, message)\n");	// @[generators/rocket-chip/src/main/scala/tilelink/Monitor.scala:49:11]
        if (`STOP_COND_)	// @[generators/rocket-chip/src/main/scala/tilelink/Monitor.scala:49:11]
          $fatal;	// @[generators/rocket-chip/src/main/scala/tilelink/Monitor.scala:49:11]
      end
      if (~reset & ~(inflight_1 == 2'h0 | _plusarg_reader_1_out == 32'h0 | watchdog_1 < _plusarg_reader_1_out)) begin	// @[generators/rocket-chip/src/main/scala/tilelink/Bundles.scala:259:74, generators/rocket-chip/src/main/scala/tilelink/Monitor.scala:42:11, :723:35, :815:27, :818:{26,39,47,59}, generators/rocket-chip/src/main/scala/util/Misc.scala:202:34, generators/rocket-chip/src/main/scala/util/PlusArg.scala:80:11]
        if (`ASSERT_VERBOSE_COND_)	// @[generators/rocket-chip/src/main/scala/tilelink/Monitor.scala:42:11]
          $error("Assertion failed: TileLink timeout expired (connected at generators/dma/src/main/scala/dma/DMA.scala:120:13)\n    at Monitor.scala:42 assert(cond, message)\n");	// @[generators/rocket-chip/src/main/scala/tilelink/Monitor.scala:42:11]
        if (`STOP_COND_)	// @[generators/rocket-chip/src/main/scala/tilelink/Monitor.scala:42:11]
          $fatal;	// @[generators/rocket-chip/src/main/scala/tilelink/Monitor.scala:42:11]
      end
    end // always @(posedge)
  `endif // not def SYNTHESIS
  wire [12:0] _GEN_24 = {10'h0, io_in_d_bits_size};	// @[generators/rocket-chip/src/main/scala/util/package.scala:235:71]
  wire [12:0] _d_first_beats1_decode_T_1 = 13'h3F << _GEN_24;	// @[generators/rocket-chip/src/main/scala/util/package.scala:235:71]
  wire [12:0] _d_first_beats1_decode_T_5 = 13'h3F << _GEN_24;	// @[generators/rocket-chip/src/main/scala/util/package.scala:235:71]
  wire [12:0] _d_first_beats1_decode_T_9 = 13'h3F << _GEN_24;	// @[generators/rocket-chip/src/main/scala/util/package.scala:235:71]
  wire [30:0] _GEN_25 = {28'h0, io_in_d_bits_source, 2'h0};	// @[generators/rocket-chip/src/main/scala/tilelink/Monitor.scala:677:76, generators/rocket-chip/src/main/scala/util/Misc.scala:202:34]
  wire [30:0] _d_opcodes_clr_T_5 = 31'hF << _GEN_25;	// @[generators/rocket-chip/src/main/scala/tilelink/Monitor.scala:677:76]
  wire [30:0] _d_sizes_clr_T_5 = 31'hF << _GEN_25;	// @[generators/rocket-chip/src/main/scala/tilelink/Monitor.scala:677:76, :678:74]
  wire [30:0] _d_sizes_clr_T_11 = 31'hF << _GEN_25;	// @[generators/rocket-chip/src/main/scala/tilelink/Monitor.scala:677:76, :788:74]
  always @(posedge clock) begin
    if (reset) begin
      a_first_counter <= 4'h0;	// @[generators/rocket-chip/src/main/scala/tilelink/Edges.scala:221:14, :229:27]
      d_first_counter <= 4'h0;	// @[generators/rocket-chip/src/main/scala/tilelink/Edges.scala:221:14, :229:27]
      inflight <= 2'h0;	// @[generators/rocket-chip/src/main/scala/tilelink/Monitor.scala:611:27, generators/rocket-chip/src/main/scala/util/Misc.scala:202:34]
      inflight_opcodes <= 8'h0;	// @[generators/rocket-chip/src/main/scala/tilelink/Monitor.scala:613:35]
      inflight_sizes <= 8'h0;	// @[generators/rocket-chip/src/main/scala/tilelink/Monitor.scala:613:35, :615:33]
      a_first_counter_1 <= 4'h0;	// @[generators/rocket-chip/src/main/scala/tilelink/Edges.scala:221:14, :229:27]
      d_first_counter_1 <= 4'h0;	// @[generators/rocket-chip/src/main/scala/tilelink/Edges.scala:221:14, :229:27]
      watchdog <= 32'h0;	// @[generators/rocket-chip/src/main/scala/tilelink/Bundles.scala:259:74, generators/rocket-chip/src/main/scala/tilelink/Monitor.scala:706:27]
      inflight_1 <= 2'h0;	// @[generators/rocket-chip/src/main/scala/tilelink/Monitor.scala:723:35, generators/rocket-chip/src/main/scala/util/Misc.scala:202:34]
      inflight_sizes_1 <= 8'h0;	// @[generators/rocket-chip/src/main/scala/tilelink/Monitor.scala:613:35, :725:35]
      d_first_counter_2 <= 4'h0;	// @[generators/rocket-chip/src/main/scala/tilelink/Edges.scala:221:14, :229:27]
      watchdog_1 <= 32'h0;	// @[generators/rocket-chip/src/main/scala/tilelink/Bundles.scala:259:74, generators/rocket-chip/src/main/scala/tilelink/Monitor.scala:815:27]
    end
    else begin
      if (_a_first_T_1) begin	// @[src/main/scala/chisel3/util/Decoupled.scala:52:35]
        if (|a_first_counter)	// @[generators/rocket-chip/src/main/scala/tilelink/Edges.scala:229:27, :231:25]
          a_first_counter <= a_first_counter - 4'h1;	// @[generators/rocket-chip/src/main/scala/tilelink/Edges.scala:229:27, :230:28]
        else	// @[generators/rocket-chip/src/main/scala/tilelink/Edges.scala:231:25]
          a_first_counter <= 4'h0;	// @[generators/rocket-chip/src/main/scala/tilelink/Edges.scala:221:14, :229:27]
        if (a_first_1)	// @[generators/rocket-chip/src/main/scala/tilelink/Edges.scala:231:25]
          a_first_counter_1 <= 4'h0;	// @[generators/rocket-chip/src/main/scala/tilelink/Edges.scala:221:14, :229:27]
        else	// @[generators/rocket-chip/src/main/scala/tilelink/Edges.scala:231:25]
          a_first_counter_1 <= a_first_counter_1 - 4'h1;	// @[generators/rocket-chip/src/main/scala/tilelink/Edges.scala:229:27, :230:28]
      end
      if (io_in_d_valid) begin	// @[generators/rocket-chip/src/main/scala/tilelink/Monitor.scala:17:14]
        if (|d_first_counter)	// @[generators/rocket-chip/src/main/scala/tilelink/Edges.scala:229:27, :231:25]
          d_first_counter <= d_first_counter - 4'h1;	// @[generators/rocket-chip/src/main/scala/tilelink/Edges.scala:229:27, :230:28]
        else	// @[generators/rocket-chip/src/main/scala/tilelink/Edges.scala:231:25]
          d_first_counter <= io_in_d_bits_opcode[0] ? ~(_d_first_beats1_decode_T_1[5:2]) : 4'h0;	// @[generators/rocket-chip/src/main/scala/tilelink/Edges.scala:106:36, :221:14, :229:27, generators/rocket-chip/src/main/scala/util/package.scala:235:{46,71,76}]
        if (d_first_1)	// @[generators/rocket-chip/src/main/scala/tilelink/Edges.scala:231:25]
          d_first_counter_1 <= io_in_d_bits_opcode[0] ? ~(_d_first_beats1_decode_T_5[5:2]) : 4'h0;	// @[generators/rocket-chip/src/main/scala/tilelink/Edges.scala:106:36, :221:14, :229:27, generators/rocket-chip/src/main/scala/util/package.scala:235:{46,71,76}]
        else	// @[generators/rocket-chip/src/main/scala/tilelink/Edges.scala:231:25]
          d_first_counter_1 <= d_first_counter_1 - 4'h1;	// @[generators/rocket-chip/src/main/scala/tilelink/Edges.scala:229:27, :230:28]
        if (d_first_2)	// @[generators/rocket-chip/src/main/scala/tilelink/Edges.scala:231:25]
          d_first_counter_2 <= io_in_d_bits_opcode[0] ? ~(_d_first_beats1_decode_T_9[5:2]) : 4'h0;	// @[generators/rocket-chip/src/main/scala/tilelink/Edges.scala:106:36, :221:14, :229:27, generators/rocket-chip/src/main/scala/util/package.scala:235:{46,71,76}]
        else	// @[generators/rocket-chip/src/main/scala/tilelink/Edges.scala:231:25]
          d_first_counter_2 <= d_first_counter_2 - 4'h1;	// @[generators/rocket-chip/src/main/scala/tilelink/Edges.scala:229:27, :230:28]
        watchdog_1 <= 32'h0;	// @[generators/rocket-chip/src/main/scala/tilelink/Bundles.scala:259:74, generators/rocket-chip/src/main/scala/tilelink/Monitor.scala:815:27]
      end
      else	// @[generators/rocket-chip/src/main/scala/tilelink/Monitor.scala:17:14]
        watchdog_1 <= watchdog_1 + 32'h1;	// @[generators/rocket-chip/src/main/scala/tilelink/Monitor.scala:711:26, :815:27, :820:26]
      inflight <= (inflight | {_GEN, 1'h0}) & ~(_GEN_1 ? 2'h1 << _GEN_2 : 2'h0);	// @[generators/rocket-chip/src/main/scala/tilelink/Monitor.scala:312:27, :611:27, :623:34, :652:{25,70}, :653:28, :661:34, :671:71, :675:89, :676:21, :702:{27,36,38}, generators/rocket-chip/src/main/scala/util/Misc.scala:202:34, src/main/scala/chisel3/util/OneHot.scala:58:35]
      inflight_opcodes <= (inflight_opcodes | (_GEN ? {_GEN ? 4'h9 : 4'h0, 4'h0} : 8'h0)) & ~(_GEN_1 ? _d_opcodes_clr_T_5[7:0] : 8'h0);	// @[generators/rocket-chip/src/main/scala/tilelink/Edges.scala:221:14, generators/rocket-chip/src/main/scala/tilelink/Monitor.scala:613:35, :627:33, :643:40, :652:{25,70}, :654:{28,61}, :656:{28,54,79}, :665:33, :671:71, :675:89, :677:{21,76}, :703:{43,60,62}, generators/rocket-chip/src/main/scala/util/Misc.scala:206:21]
      inflight_sizes <= (inflight_sizes | (_GEN ? {_GEN ? 4'h5 : 4'h0, 4'h0} : 8'h0)) & ~(_GEN_1 ? _d_sizes_clr_T_5[7:0] : 8'h0);	// @[generators/rocket-chip/src/main/scala/tilelink/Edges.scala:221:14, generators/rocket-chip/src/main/scala/tilelink/Monitor.scala:613:35, :615:33, :629:31, :645:38, :652:{25,70}, :655:{28,59}, :656:79, :657:{28,52}, :667:31, :671:71, :675:89, :678:{21,74}, :704:{39,54,56}, generators/rocket-chip/src/main/scala/util/Misc.scala:206:21]
      if (_a_first_T_1 | io_in_d_valid)	// @[generators/rocket-chip/src/main/scala/tilelink/Monitor.scala:712:25, src/main/scala/chisel3/util/Decoupled.scala:52:35]
        watchdog <= 32'h0;	// @[generators/rocket-chip/src/main/scala/tilelink/Bundles.scala:259:74, generators/rocket-chip/src/main/scala/tilelink/Monitor.scala:706:27]
      else	// @[generators/rocket-chip/src/main/scala/tilelink/Monitor.scala:712:25]
        watchdog <= watchdog + 32'h1;	// @[generators/rocket-chip/src/main/scala/tilelink/Monitor.scala:706:27, :711:26]
      inflight_1 <= inflight_1 & ~(_GEN_3 ? 2'h1 << _GEN_2 : 2'h0);	// @[generators/rocket-chip/src/main/scala/tilelink/Monitor.scala:723:35, :771:34, :785:{70,88}, :786:21, :811:{44,46}, generators/rocket-chip/src/main/scala/util/Misc.scala:202:34, src/main/scala/chisel3/util/OneHot.scala:58:35]
      inflight_sizes_1 <= inflight_sizes_1 & ~(_GEN_3 ? _d_sizes_clr_T_11[7:0] : 8'h0);	// @[generators/rocket-chip/src/main/scala/tilelink/Monitor.scala:613:35, :725:35, :774:34, :785:{70,88}, :788:{21,74}, :813:{56,58}]
    end
    if (_a_first_T_1 & ~(|a_first_counter))	// @[generators/rocket-chip/src/main/scala/tilelink/Edges.scala:229:27, :231:25, generators/rocket-chip/src/main/scala/tilelink/Monitor.scala:396:18, src/main/scala/chisel3/util/Decoupled.scala:52:35]
      address <= io_in_a_bits_address;	// @[generators/rocket-chip/src/main/scala/tilelink/Monitor.scala:388:22]
    if (io_in_d_valid & ~(|d_first_counter)) begin	// @[generators/rocket-chip/src/main/scala/tilelink/Edges.scala:229:27, :231:25, generators/rocket-chip/src/main/scala/tilelink/Monitor.scala:549:18]
      opcode_1 <= io_in_d_bits_opcode;	// @[generators/rocket-chip/src/main/scala/tilelink/Monitor.scala:535:22]
      param_1 <= io_in_d_bits_param;	// @[generators/rocket-chip/src/main/scala/tilelink/Monitor.scala:536:22]
      size_1 <= io_in_d_bits_size;	// @[generators/rocket-chip/src/main/scala/tilelink/Monitor.scala:537:22]
      source_1 <= io_in_d_bits_source;	// @[generators/rocket-chip/src/main/scala/tilelink/Monitor.scala:538:22]
      sink <= io_in_d_bits_sink;	// @[generators/rocket-chip/src/main/scala/tilelink/Monitor.scala:539:22]
      denied <= io_in_d_bits_denied;	// @[generators/rocket-chip/src/main/scala/tilelink/Monitor.scala:540:22]
    end
  end // always @(posedge)
  `ifdef ENABLE_INITIAL_REG_
    `ifdef FIRRTL_BEFORE_INITIAL
      `FIRRTL_BEFORE_INITIAL
    `endif // FIRRTL_BEFORE_INITIAL
    logic [31:0] _RANDOM[0:5];
    initial begin
      `ifdef INIT_RANDOM_PROLOG_
        `INIT_RANDOM_PROLOG_
      `endif // INIT_RANDOM_PROLOG_
      `ifdef RANDOMIZE_REG_INIT
        for (logic [2:0] i = 3'h0; i < 3'h6; i += 3'h1) begin
          _RANDOM[i] = `RANDOM;
        end
        a_first_counter = _RANDOM[3'h0][3:0];	// @[generators/rocket-chip/src/main/scala/tilelink/Edges.scala:229:27]
        address = {_RANDOM[3'h0][31:14], _RANDOM[3'h1][13:0]};	// @[generators/rocket-chip/src/main/scala/tilelink/Edges.scala:229:27, generators/rocket-chip/src/main/scala/tilelink/Monitor.scala:388:22]
        d_first_counter = _RANDOM[3'h1][17:14];	// @[generators/rocket-chip/src/main/scala/tilelink/Edges.scala:229:27, generators/rocket-chip/src/main/scala/tilelink/Monitor.scala:388:22]
        opcode_1 = _RANDOM[3'h1][20:18];	// @[generators/rocket-chip/src/main/scala/tilelink/Monitor.scala:388:22, :535:22]
        param_1 = _RANDOM[3'h1][22:21];	// @[generators/rocket-chip/src/main/scala/tilelink/Monitor.scala:388:22, :536:22]
        size_1 = _RANDOM[3'h1][25:23];	// @[generators/rocket-chip/src/main/scala/tilelink/Monitor.scala:388:22, :537:22]
        source_1 = _RANDOM[3'h1][26];	// @[generators/rocket-chip/src/main/scala/tilelink/Monitor.scala:388:22, :538:22]
        sink = _RANDOM[3'h1][28:27];	// @[generators/rocket-chip/src/main/scala/tilelink/Monitor.scala:388:22, :539:22]
        denied = _RANDOM[3'h1][29];	// @[generators/rocket-chip/src/main/scala/tilelink/Monitor.scala:388:22, :540:22]
        inflight = _RANDOM[3'h1][31:30];	// @[generators/rocket-chip/src/main/scala/tilelink/Monitor.scala:388:22, :611:27]
        inflight_opcodes = _RANDOM[3'h2][7:0];	// @[generators/rocket-chip/src/main/scala/tilelink/Monitor.scala:613:35]
        inflight_sizes = _RANDOM[3'h2][15:8];	// @[generators/rocket-chip/src/main/scala/tilelink/Monitor.scala:613:35, :615:33]
        a_first_counter_1 = _RANDOM[3'h2][19:16];	// @[generators/rocket-chip/src/main/scala/tilelink/Edges.scala:229:27, generators/rocket-chip/src/main/scala/tilelink/Monitor.scala:613:35]
        d_first_counter_1 = _RANDOM[3'h2][23:20];	// @[generators/rocket-chip/src/main/scala/tilelink/Edges.scala:229:27, generators/rocket-chip/src/main/scala/tilelink/Monitor.scala:613:35]
        watchdog = {_RANDOM[3'h2][31:24], _RANDOM[3'h3][23:0]};	// @[generators/rocket-chip/src/main/scala/tilelink/Monitor.scala:613:35, :706:27]
        inflight_1 = _RANDOM[3'h3][25:24];	// @[generators/rocket-chip/src/main/scala/tilelink/Monitor.scala:706:27, :723:35]
        inflight_sizes_1 = _RANDOM[3'h4][9:2];	// @[generators/rocket-chip/src/main/scala/tilelink/Monitor.scala:725:35]
        d_first_counter_2 = _RANDOM[3'h4][17:14];	// @[generators/rocket-chip/src/main/scala/tilelink/Edges.scala:229:27, generators/rocket-chip/src/main/scala/tilelink/Monitor.scala:725:35]
        watchdog_1 = {_RANDOM[3'h4][31:18], _RANDOM[3'h5][17:0]};	// @[generators/rocket-chip/src/main/scala/tilelink/Monitor.scala:725:35, :815:27]
      `endif // RANDOMIZE_REG_INIT
    end // initial
    `ifdef FIRRTL_AFTER_INITIAL
      `FIRRTL_AFTER_INITIAL
    `endif // FIRRTL_AFTER_INITIAL
  `endif // ENABLE_INITIAL_REG_
  plusarg_reader #(
    .DEFAULT(0),
    .FORMAT("tilelink_timeout=%d"),
    .WIDTH(32)
  ) plusarg_reader (	// @[generators/rocket-chip/src/main/scala/util/PlusArg.scala:80:11]
    .out (_plusarg_reader_out)
  );
  plusarg_reader #(
    .DEFAULT(0),
    .FORMAT("tilelink_timeout=%d"),
    .WIDTH(32)
  ) plusarg_reader_1 (	// @[generators/rocket-chip/src/main/scala/util/PlusArg.scala:80:11]
    .out (_plusarg_reader_1_out)
  );
endmodule

