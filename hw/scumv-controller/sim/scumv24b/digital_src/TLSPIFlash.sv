// Generated by CIRCT unknown git version
// Standard header to adapt well known macros for register randomization.
`ifndef RANDOMIZE
  `ifdef RANDOMIZE_MEM_INIT
    `define RANDOMIZE
  `endif // RANDOMIZE_MEM_INIT
`endif // not def RANDOMIZE
`ifndef RANDOMIZE
  `ifdef RANDOMIZE_REG_INIT
    `define RANDOMIZE
  `endif // RANDOMIZE_REG_INIT
`endif // not def RANDOMIZE

// RANDOM may be set to an expression that produces a 32-bit random unsigned value.
`ifndef RANDOM
  `define RANDOM $random
`endif // not def RANDOM

// Users can define INIT_RANDOM as general code that gets injected into the
// initializer block for modules with registers.
`ifndef INIT_RANDOM
  `define INIT_RANDOM
`endif // not def INIT_RANDOM

// If using random initialization, you can also define RANDOMIZE_DELAY to
// customize the delay used, otherwise 0.002 is used.
`ifndef RANDOMIZE_DELAY
  `define RANDOMIZE_DELAY 0.002
`endif // not def RANDOMIZE_DELAY

// Define INIT_RANDOM_PROLOG_ for use in our modules below.
`ifndef INIT_RANDOM_PROLOG_
  `ifdef RANDOMIZE
    `ifdef VERILATOR
      `define INIT_RANDOM_PROLOG_ `INIT_RANDOM
    `else  // VERILATOR
      `define INIT_RANDOM_PROLOG_ `INIT_RANDOM #`RANDOMIZE_DELAY begin end
    `endif // VERILATOR
  `else  // RANDOMIZE
    `define INIT_RANDOM_PROLOG_
  `endif // RANDOMIZE
`endif // not def INIT_RANDOM_PROLOG_

// Include register initializers in init blocks unless synthesis is set
`ifndef SYNTHESIS
  `ifndef ENABLE_INITIAL_REG_
    `define ENABLE_INITIAL_REG_
  `endif // not def ENABLE_INITIAL_REG_
`endif // not def SYNTHESIS

// Include rmemory initializers in init blocks unless synthesis is set
`ifndef SYNTHESIS
  `ifndef ENABLE_INITIAL_MEM_
    `define ENABLE_INITIAL_MEM_
  `endif // not def ENABLE_INITIAL_MEM_
`endif // not def SYNTHESIS

// Standard header to adapt well known macros for prints and assertions.

// Users can define 'PRINTF_COND' to add an extra gate to prints.
`ifndef PRINTF_COND_
  `ifdef PRINTF_COND
    `define PRINTF_COND_ (`PRINTF_COND)
  `else  // PRINTF_COND
    `define PRINTF_COND_ 1
  `endif // PRINTF_COND
`endif // not def PRINTF_COND_

// Users can define 'ASSERT_VERBOSE_COND' to add an extra gate to assert error printing.
`ifndef ASSERT_VERBOSE_COND_
  `ifdef ASSERT_VERBOSE_COND
    `define ASSERT_VERBOSE_COND_ (`ASSERT_VERBOSE_COND)
  `else  // ASSERT_VERBOSE_COND
    `define ASSERT_VERBOSE_COND_ 1
  `endif // ASSERT_VERBOSE_COND
`endif // not def ASSERT_VERBOSE_COND_

// Users can define 'STOP_COND' to add an extra gate to stop conditions.
`ifndef STOP_COND_
  `ifdef STOP_COND
    `define STOP_COND_ (`STOP_COND)
  `else  // STOP_COND
    `define STOP_COND_ 1
  `endif // STOP_COND
`endif // not def STOP_COND_

module TLSPIFlash(
  input         clock,
                reset,
  output        auto_int_xing_out_sync_0,	// @[generators/rocket-chip/src/main/scala/diplomacy/LazyModule.scala:366:18]
                auto_mem_xing_in_a_ready,	// @[generators/rocket-chip/src/main/scala/diplomacy/LazyModule.scala:366:18]
  input         auto_mem_xing_in_a_valid,	// @[generators/rocket-chip/src/main/scala/diplomacy/LazyModule.scala:366:18]
  input  [2:0]  auto_mem_xing_in_a_bits_opcode,	// @[generators/rocket-chip/src/main/scala/diplomacy/LazyModule.scala:366:18]
                auto_mem_xing_in_a_bits_param,	// @[generators/rocket-chip/src/main/scala/diplomacy/LazyModule.scala:366:18]
  input         auto_mem_xing_in_a_bits_size,	// @[generators/rocket-chip/src/main/scala/diplomacy/LazyModule.scala:366:18]
  input  [17:0] auto_mem_xing_in_a_bits_source,	// @[generators/rocket-chip/src/main/scala/diplomacy/LazyModule.scala:366:18]
  input  [29:0] auto_mem_xing_in_a_bits_address,	// @[generators/rocket-chip/src/main/scala/diplomacy/LazyModule.scala:366:18]
  input         auto_mem_xing_in_a_bits_mask,	// @[generators/rocket-chip/src/main/scala/diplomacy/LazyModule.scala:366:18]
                auto_mem_xing_in_a_bits_corrupt,	// @[generators/rocket-chip/src/main/scala/diplomacy/LazyModule.scala:366:18]
                auto_mem_xing_in_d_ready,	// @[generators/rocket-chip/src/main/scala/diplomacy/LazyModule.scala:366:18]
  output        auto_mem_xing_in_d_valid,	// @[generators/rocket-chip/src/main/scala/diplomacy/LazyModule.scala:366:18]
                auto_mem_xing_in_d_bits_size,	// @[generators/rocket-chip/src/main/scala/diplomacy/LazyModule.scala:366:18]
  output [17:0] auto_mem_xing_in_d_bits_source,	// @[generators/rocket-chip/src/main/scala/diplomacy/LazyModule.scala:366:18]
  output [7:0]  auto_mem_xing_in_d_bits_data,	// @[generators/rocket-chip/src/main/scala/diplomacy/LazyModule.scala:366:18]
  output        auto_control_xing_in_a_ready,	// @[generators/rocket-chip/src/main/scala/diplomacy/LazyModule.scala:366:18]
  input         auto_control_xing_in_a_valid,	// @[generators/rocket-chip/src/main/scala/diplomacy/LazyModule.scala:366:18]
  input  [2:0]  auto_control_xing_in_a_bits_opcode,	// @[generators/rocket-chip/src/main/scala/diplomacy/LazyModule.scala:366:18]
                auto_control_xing_in_a_bits_param,	// @[generators/rocket-chip/src/main/scala/diplomacy/LazyModule.scala:366:18]
  input  [1:0]  auto_control_xing_in_a_bits_size,	// @[generators/rocket-chip/src/main/scala/diplomacy/LazyModule.scala:366:18]
  input  [15:0] auto_control_xing_in_a_bits_source,	// @[generators/rocket-chip/src/main/scala/diplomacy/LazyModule.scala:366:18]
  input  [28:0] auto_control_xing_in_a_bits_address,	// @[generators/rocket-chip/src/main/scala/diplomacy/LazyModule.scala:366:18]
  input  [3:0]  auto_control_xing_in_a_bits_mask,	// @[generators/rocket-chip/src/main/scala/diplomacy/LazyModule.scala:366:18]
  input  [31:0] auto_control_xing_in_a_bits_data,	// @[generators/rocket-chip/src/main/scala/diplomacy/LazyModule.scala:366:18]
  input         auto_control_xing_in_a_bits_corrupt,	// @[generators/rocket-chip/src/main/scala/diplomacy/LazyModule.scala:366:18]
                auto_control_xing_in_d_ready,	// @[generators/rocket-chip/src/main/scala/diplomacy/LazyModule.scala:366:18]
  output        auto_control_xing_in_d_valid,	// @[generators/rocket-chip/src/main/scala/diplomacy/LazyModule.scala:366:18]
  output [2:0]  auto_control_xing_in_d_bits_opcode,	// @[generators/rocket-chip/src/main/scala/diplomacy/LazyModule.scala:366:18]
  output [1:0]  auto_control_xing_in_d_bits_size,	// @[generators/rocket-chip/src/main/scala/diplomacy/LazyModule.scala:366:18]
  output [15:0] auto_control_xing_in_d_bits_source,	// @[generators/rocket-chip/src/main/scala/diplomacy/LazyModule.scala:366:18]
  output [31:0] auto_control_xing_in_d_bits_data,	// @[generators/rocket-chip/src/main/scala/diplomacy/LazyModule.scala:366:18]
  output        auto_io_out_sck,	// @[generators/rocket-chip/src/main/scala/diplomacy/LazyModule.scala:366:18]
  input         auto_io_out_dq_0_i,	// @[generators/rocket-chip/src/main/scala/diplomacy/LazyModule.scala:366:18]
  output        auto_io_out_dq_0_o,	// @[generators/rocket-chip/src/main/scala/diplomacy/LazyModule.scala:366:18]
                auto_io_out_dq_0_oe,	// @[generators/rocket-chip/src/main/scala/diplomacy/LazyModule.scala:366:18]
  input         auto_io_out_dq_1_i,	// @[generators/rocket-chip/src/main/scala/diplomacy/LazyModule.scala:366:18]
  output        auto_io_out_dq_1_o,	// @[generators/rocket-chip/src/main/scala/diplomacy/LazyModule.scala:366:18]
                auto_io_out_dq_1_oe,	// @[generators/rocket-chip/src/main/scala/diplomacy/LazyModule.scala:366:18]
  input         auto_io_out_dq_2_i,	// @[generators/rocket-chip/src/main/scala/diplomacy/LazyModule.scala:366:18]
  output        auto_io_out_dq_2_o,	// @[generators/rocket-chip/src/main/scala/diplomacy/LazyModule.scala:366:18]
                auto_io_out_dq_2_oe,	// @[generators/rocket-chip/src/main/scala/diplomacy/LazyModule.scala:366:18]
  input         auto_io_out_dq_3_i,	// @[generators/rocket-chip/src/main/scala/diplomacy/LazyModule.scala:366:18]
  output        auto_io_out_dq_3_o,	// @[generators/rocket-chip/src/main/scala/diplomacy/LazyModule.scala:366:18]
                auto_io_out_dq_3_oe,	// @[generators/rocket-chip/src/main/scala/diplomacy/LazyModule.scala:366:18]
                auto_io_out_cs_0	// @[generators/rocket-chip/src/main/scala/diplomacy/LazyModule.scala:366:18]
);

  wire              out_woready_10;	// @[generators/rocket-chip/src/main/scala/tilelink/RegisterRouter.scala:82:24]
  wire              _out_wofireMux_T;	// @[generators/rocket-chip/src/main/scala/tilelink/RegisterRouter.scala:82:24]
  wire              out_backSel_19;	// @[generators/rocket-chip/src/main/scala/tilelink/RegisterRouter.scala:82:24]
  wire              quash;	// @[generators/rocket-chip-blocks/src/main/scala/util/RegMapFIFO.scala:26:26]
  wire              _arb_io_inner_0_tx_ready;	// @[generators/rocket-chip-blocks/src/main/scala/devices/spi/TLSPIFlash.scala:58:19]
  wire              _arb_io_inner_0_rx_valid;	// @[generators/rocket-chip-blocks/src/main/scala/devices/spi/TLSPIFlash.scala:58:19]
  wire [7:0]        _arb_io_inner_0_rx_bits;	// @[generators/rocket-chip-blocks/src/main/scala/devices/spi/TLSPIFlash.scala:58:19]
  wire              _arb_io_inner_0_active;	// @[generators/rocket-chip-blocks/src/main/scala/devices/spi/TLSPIFlash.scala:58:19]
  wire              _arb_io_inner_1_tx_ready;	// @[generators/rocket-chip-blocks/src/main/scala/devices/spi/TLSPIFlash.scala:58:19]
  wire              _arb_io_inner_1_rx_valid;	// @[generators/rocket-chip-blocks/src/main/scala/devices/spi/TLSPIFlash.scala:58:19]
  wire [7:0]        _arb_io_inner_1_rx_bits;	// @[generators/rocket-chip-blocks/src/main/scala/devices/spi/TLSPIFlash.scala:58:19]
  wire              _arb_io_outer_tx_valid;	// @[generators/rocket-chip-blocks/src/main/scala/devices/spi/TLSPIFlash.scala:58:19]
  wire [7:0]        _arb_io_outer_tx_bits;	// @[generators/rocket-chip-blocks/src/main/scala/devices/spi/TLSPIFlash.scala:58:19]
  wire [7:0]        _arb_io_outer_cnt;	// @[generators/rocket-chip-blocks/src/main/scala/devices/spi/TLSPIFlash.scala:58:19]
  wire [1:0]        _arb_io_outer_fmt_proto;	// @[generators/rocket-chip-blocks/src/main/scala/devices/spi/TLSPIFlash.scala:58:19]
  wire              _arb_io_outer_fmt_endian;	// @[generators/rocket-chip-blocks/src/main/scala/devices/spi/TLSPIFlash.scala:58:19]
  wire              _arb_io_outer_fmt_iodir;	// @[generators/rocket-chip-blocks/src/main/scala/devices/spi/TLSPIFlash.scala:58:19]
  wire              _arb_io_outer_cs_set;	// @[generators/rocket-chip-blocks/src/main/scala/devices/spi/TLSPIFlash.scala:58:19]
  wire              _arb_io_outer_cs_clear;	// @[generators/rocket-chip-blocks/src/main/scala/devices/spi/TLSPIFlash.scala:58:19]
  wire              _arb_io_outer_cs_hold;	// @[generators/rocket-chip-blocks/src/main/scala/devices/spi/TLSPIFlash.scala:58:19]
  wire              _flash_io_addr_ready;	// @[generators/rocket-chip-blocks/src/main/scala/devices/spi/TLSPIFlash.scala:57:21]
  wire              _flash_io_data_valid;	// @[generators/rocket-chip-blocks/src/main/scala/devices/spi/TLSPIFlash.scala:57:21]
  wire              _flash_io_link_tx_valid;	// @[generators/rocket-chip-blocks/src/main/scala/devices/spi/TLSPIFlash.scala:57:21]
  wire [7:0]        _flash_io_link_tx_bits;	// @[generators/rocket-chip-blocks/src/main/scala/devices/spi/TLSPIFlash.scala:57:21]
  wire [7:0]        _flash_io_link_cnt;	// @[generators/rocket-chip-blocks/src/main/scala/devices/spi/TLSPIFlash.scala:57:21]
  wire [1:0]        _flash_io_link_fmt_proto;	// @[generators/rocket-chip-blocks/src/main/scala/devices/spi/TLSPIFlash.scala:57:21]
  wire              _flash_io_link_fmt_endian;	// @[generators/rocket-chip-blocks/src/main/scala/devices/spi/TLSPIFlash.scala:57:21]
  wire              _flash_io_link_fmt_iodir;	// @[generators/rocket-chip-blocks/src/main/scala/devices/spi/TLSPIFlash.scala:57:21]
  wire              _flash_io_link_cs_clear;	// @[generators/rocket-chip-blocks/src/main/scala/devices/spi/TLSPIFlash.scala:57:21]
  wire              _flash_io_link_lock;	// @[generators/rocket-chip-blocks/src/main/scala/devices/spi/TLSPIFlash.scala:57:21]
  wire              _mac_io_link_tx_ready;	// @[generators/rocket-chip-blocks/src/main/scala/devices/spi/TLSPI.scala:70:19]
  wire              _mac_io_link_rx_valid;	// @[generators/rocket-chip-blocks/src/main/scala/devices/spi/TLSPI.scala:70:19]
  wire [7:0]        _mac_io_link_rx_bits;	// @[generators/rocket-chip-blocks/src/main/scala/devices/spi/TLSPI.scala:70:19]
  wire              _mac_io_link_active;	// @[generators/rocket-chip-blocks/src/main/scala/devices/spi/TLSPI.scala:70:19]
  wire              _fifo_io_link_tx_valid;	// @[generators/rocket-chip-blocks/src/main/scala/devices/spi/TLSPI.scala:69:20]
  wire [7:0]        _fifo_io_link_tx_bits;	// @[generators/rocket-chip-blocks/src/main/scala/devices/spi/TLSPI.scala:69:20]
  wire [7:0]        _fifo_io_link_cnt;	// @[generators/rocket-chip-blocks/src/main/scala/devices/spi/TLSPI.scala:69:20]
  wire [1:0]        _fifo_io_link_fmt_proto;	// @[generators/rocket-chip-blocks/src/main/scala/devices/spi/TLSPI.scala:69:20]
  wire              _fifo_io_link_fmt_endian;	// @[generators/rocket-chip-blocks/src/main/scala/devices/spi/TLSPI.scala:69:20]
  wire              _fifo_io_link_fmt_iodir;	// @[generators/rocket-chip-blocks/src/main/scala/devices/spi/TLSPI.scala:69:20]
  wire              _fifo_io_link_cs_set;	// @[generators/rocket-chip-blocks/src/main/scala/devices/spi/TLSPI.scala:69:20]
  wire              _fifo_io_link_cs_clear;	// @[generators/rocket-chip-blocks/src/main/scala/devices/spi/TLSPI.scala:69:20]
  wire              _fifo_io_link_lock;	// @[generators/rocket-chip-blocks/src/main/scala/devices/spi/TLSPI.scala:69:20]
  wire              _fifo_io_tx_ready;	// @[generators/rocket-chip-blocks/src/main/scala/devices/spi/TLSPI.scala:69:20]
  wire              _fifo_io_rx_valid;	// @[generators/rocket-chip-blocks/src/main/scala/devices/spi/TLSPI.scala:69:20]
  wire [7:0]        _fifo_io_rx_bits;	// @[generators/rocket-chip-blocks/src/main/scala/devices/spi/TLSPI.scala:69:20]
  wire              _fifo_io_ip_txwm;	// @[generators/rocket-chip-blocks/src/main/scala/devices/spi/TLSPI.scala:69:20]
  wire              _fifo_io_ip_rxwm;	// @[generators/rocket-chip-blocks/src/main/scala/devices/spi/TLSPI.scala:69:20]
  reg  [1:0]        ctrl_fmt_proto;	// @[generators/rocket-chip-blocks/src/main/scala/devices/spi/TLSPI.scala:68:21]
  reg               ctrl_fmt_endian;	// @[generators/rocket-chip-blocks/src/main/scala/devices/spi/TLSPI.scala:68:21]
  reg               ctrl_fmt_iodir;	// @[generators/rocket-chip-blocks/src/main/scala/devices/spi/TLSPI.scala:68:21]
  reg  [3:0]        ctrl_fmt_len;	// @[generators/rocket-chip-blocks/src/main/scala/devices/spi/TLSPI.scala:68:21]
  reg  [11:0]       ctrl_sck_div;	// @[generators/rocket-chip-blocks/src/main/scala/devices/spi/TLSPI.scala:68:21]
  reg               ctrl_sck_pol;	// @[generators/rocket-chip-blocks/src/main/scala/devices/spi/TLSPI.scala:68:21]
  reg               ctrl_sck_pha;	// @[generators/rocket-chip-blocks/src/main/scala/devices/spi/TLSPI.scala:68:21]
  reg               ctrl_cs_id;	// @[generators/rocket-chip-blocks/src/main/scala/devices/spi/TLSPI.scala:68:21]
  reg               ctrl_cs_dflt_0;	// @[generators/rocket-chip-blocks/src/main/scala/devices/spi/TLSPI.scala:68:21]
  reg  [1:0]        ctrl_cs_mode;	// @[generators/rocket-chip-blocks/src/main/scala/devices/spi/TLSPI.scala:68:21]
  reg  [7:0]        ctrl_dla_cssck;	// @[generators/rocket-chip-blocks/src/main/scala/devices/spi/TLSPI.scala:68:21]
  reg  [7:0]        ctrl_dla_sckcs;	// @[generators/rocket-chip-blocks/src/main/scala/devices/spi/TLSPI.scala:68:21]
  reg  [7:0]        ctrl_dla_intercs;	// @[generators/rocket-chip-blocks/src/main/scala/devices/spi/TLSPI.scala:68:21]
  reg  [7:0]        ctrl_dla_interxfr;	// @[generators/rocket-chip-blocks/src/main/scala/devices/spi/TLSPI.scala:68:21]
  reg  [3:0]        ctrl_wm_tx;	// @[generators/rocket-chip-blocks/src/main/scala/devices/spi/TLSPI.scala:68:21]
  reg  [3:0]        ctrl_wm_rx;	// @[generators/rocket-chip-blocks/src/main/scala/devices/spi/TLSPI.scala:68:21]
  reg  [11:0]       ctrl_extradel_coarse;	// @[generators/rocket-chip-blocks/src/main/scala/devices/spi/TLSPI.scala:68:21]
  reg  [4:0]        ctrl_sampledel_sd;	// @[generators/rocket-chip-blocks/src/main/scala/devices/spi/TLSPI.scala:68:21]
  reg               ie_txwm;	// @[generators/rocket-chip-blocks/src/main/scala/devices/spi/TLSPI.scala:82:19]
  reg               ie_rxwm;	// @[generators/rocket-chip-blocks/src/main/scala/devices/spi/TLSPI.scala:82:19]
  reg               a_size;	// @[generators/rocket-chip-blocks/src/main/scala/devices/spi/TLSPIFlash.scala:66:14]
  reg  [17:0]       a_source;	// @[generators/rocket-chip-blocks/src/main/scala/devices/spi/TLSPIFlash.scala:66:14]
  reg  [29:0]       a_address;	// @[generators/rocket-chip-blocks/src/main/scala/devices/spi/TLSPIFlash.scala:66:14]
  reg  [1:0]        insn_cmd_proto;	// @[generators/rocket-chip-blocks/src/main/scala/devices/spi/TLSPIFlash.scala:82:21]
  reg  [7:0]        insn_cmd_code;	// @[generators/rocket-chip-blocks/src/main/scala/devices/spi/TLSPIFlash.scala:82:21]
  reg               insn_cmd_en;	// @[generators/rocket-chip-blocks/src/main/scala/devices/spi/TLSPIFlash.scala:82:21]
  reg  [1:0]        insn_addr_proto;	// @[generators/rocket-chip-blocks/src/main/scala/devices/spi/TLSPIFlash.scala:82:21]
  reg  [2:0]        insn_addr_len;	// @[generators/rocket-chip-blocks/src/main/scala/devices/spi/TLSPIFlash.scala:82:21]
  reg  [7:0]        insn_pad_code;	// @[generators/rocket-chip-blocks/src/main/scala/devices/spi/TLSPIFlash.scala:82:21]
  reg  [3:0]        insn_pad_cnt;	// @[generators/rocket-chip-blocks/src/main/scala/devices/spi/TLSPIFlash.scala:82:21]
  reg  [1:0]        insn_data_proto;	// @[generators/rocket-chip-blocks/src/main/scala/devices/spi/TLSPIFlash.scala:82:21]
  reg               flash_en;	// @[generators/rocket-chip-blocks/src/main/scala/devices/spi/TLSPIFlash.scala:83:25]
  wire              out_front_bits_read = auto_control_xing_in_a_bits_opcode == 3'h4;	// @[generators/rocket-chip/src/main/scala/tilelink/RegisterRouter.scala:69:36]
  wire              _out_out_bits_data_WIRE_29 = auto_control_xing_in_a_bits_address[11:7] == 5'h0;	// @[generators/rocket-chip/src/main/scala/tilelink/Edges.scala:192:34, generators/rocket-chip/src/main/scala/tilelink/RegisterRouter.scala:70:19, :82:24]
  assign quash = out_woready_10 & auto_control_xing_in_a_bits_mask[3] & auto_control_xing_in_a_bits_data[31];	// @[generators/rocket-chip-blocks/src/main/scala/util/RegMapFIFO.scala:26:26, generators/rocket-chip/src/main/scala/tilelink/RegisterRouter.scala:82:24]
  assign out_backSel_19 = auto_control_xing_in_a_bits_address[6:2] == 5'h13;	// @[generators/rocket-chip/src/main/scala/tilelink/RegisterRouter.scala:82:24, src/main/scala/chisel3/util/OneHot.scala:58:35]
  assign _out_wofireMux_T = auto_control_xing_in_a_valid & auto_control_xing_in_d_ready;	// @[generators/rocket-chip/src/main/scala/tilelink/RegisterRouter.scala:82:24]
  wire              _out_wofireMux_T_2 = _out_wofireMux_T & ~out_front_bits_read;	// @[generators/rocket-chip/src/main/scala/tilelink/RegisterRouter.scala:69:36, :82:24]
  wire              out_woready_6 = _out_wofireMux_T_2 & auto_control_xing_in_a_bits_address[6:2] == 5'h1 & _out_out_bits_data_WIRE_29;	// @[generators/rocket-chip/src/main/scala/tilelink/RegisterRouter.scala:82:24, src/main/scala/chisel3/util/OneHot.scala:58:35]
  wire              out_woready_3 = _out_wofireMux_T_2 & auto_control_xing_in_a_bits_address[6:2] == 5'hA & _out_out_bits_data_WIRE_29;	// @[generators/rocket-chip/src/main/scala/tilelink/RegisterRouter.scala:82:24, src/main/scala/chisel3/util/OneHot.scala:58:35]
  wire              out_woready_16 = _out_wofireMux_T_2 & auto_control_xing_in_a_bits_address[6:2] == 5'hB & _out_out_bits_data_WIRE_29;	// @[generators/rocket-chip/src/main/scala/tilelink/RegisterRouter.scala:82:24, src/main/scala/chisel3/util/OneHot.scala:58:35]
  wire              out_woready_14 = _out_wofireMux_T_2 & auto_control_xing_in_a_bits_address[6:2] == 5'h10 & _out_out_bits_data_WIRE_29;	// @[generators/rocket-chip/src/main/scala/tilelink/RegisterRouter.scala:82:24, src/main/scala/chisel3/util/OneHot.scala:58:35]
  assign out_woready_10 = _out_wofireMux_T_2 & auto_control_xing_in_a_bits_address[6:2] == 5'h12 & _out_out_bits_data_WIRE_29;	// @[generators/rocket-chip/src/main/scala/tilelink/RegisterRouter.scala:82:24, src/main/scala/chisel3/util/OneHot.scala:58:35]
  wire              out_woready_30 = _out_wofireMux_T_2 & auto_control_xing_in_a_bits_address[6:2] == 5'h19 & _out_out_bits_data_WIRE_29;	// @[generators/rocket-chip/src/main/scala/tilelink/RegisterRouter.scala:82:24, src/main/scala/chisel3/util/OneHot.scala:58:35]
  wire              out_woready_35 = _out_wofireMux_T_2 & auto_control_xing_in_a_bits_address[6:2] == 5'h1C & _out_out_bits_data_WIRE_29;	// @[generators/rocket-chip/src/main/scala/tilelink/RegisterRouter.scala:82:24, src/main/scala/chisel3/util/OneHot.scala:58:35]
  wire [31:0]       _GEN = {{1'h1}, {1'h1}, {_out_out_bits_data_WIRE_29}, {_out_out_bits_data_WIRE_29}, {1'h1}, {1'h1}, {_out_out_bits_data_WIRE_29}, {_out_out_bits_data_WIRE_29}, {1'h1}, {1'h1}, {_out_out_bits_data_WIRE_29}, {_out_out_bits_data_WIRE_29}, {_out_out_bits_data_WIRE_29}, {_out_out_bits_data_WIRE_29}, {1'h1}, {_out_out_bits_data_WIRE_29}, {_out_out_bits_data_WIRE_29}, {_out_out_bits_data_WIRE_29}, {1'h1}, {1'h1}, {_out_out_bits_data_WIRE_29}, {_out_out_bits_data_WIRE_29}, {1'h1}, {1'h1}, {1'h1}, {_out_out_bits_data_WIRE_29}, {_out_out_bits_data_WIRE_29}, {_out_out_bits_data_WIRE_29}, {1'h1}, {1'h1}, {_out_out_bits_data_WIRE_29}, {_out_out_bits_data_WIRE_29}};	// @[generators/rocket-chip/src/main/scala/tilelink/Buffer.scala:47:20, generators/rocket-chip/src/main/scala/tilelink/RegisterRouter.scala:82:24, generators/rocket-chip/src/main/scala/util/MuxLiteral.scala:49:10]
  wire [31:0][31:0] _GEN_0 = {{32'h0}, {32'h0}, {{30'h0, _fifo_io_ip_rxwm, _fifo_io_ip_txwm}}, {{30'h0, ie_rxwm, ie_txwm}}, {32'h0}, {32'h0}, {{insn_pad_code, insn_cmd_code, 2'h0, insn_data_proto, insn_addr_proto, insn_cmd_proto, insn_pad_cnt, insn_addr_len, insn_cmd_en}}, {{31'h0, flash_en}}, {32'h0}, {32'h0}, {{28'h0, ctrl_wm_rx}}, {{28'h0, ctrl_wm_tx}}, {{~_fifo_io_rx_valid, 23'h0, _fifo_io_rx_bits}}, {{~_fifo_io_tx_ready, 31'h0}}, {32'h0}, {{12'h0, ctrl_fmt_len, 12'h0, ctrl_fmt_iodir, ctrl_fmt_endian, ctrl_fmt_proto}}, {{27'h0, ctrl_sampledel_sd}}, {{20'h0, ctrl_extradel_coarse}}, {32'h0}, {32'h0}, {{8'h0, ctrl_dla_interxfr, 8'h0, ctrl_dla_intercs}}, {{8'h0, ctrl_dla_sckcs, 8'h0, ctrl_dla_cssck}}, {32'h0}, {32'h0}, {32'h0}, {{30'h0, ctrl_cs_mode}}, {{31'h0, ctrl_cs_dflt_0}}, {{31'h0, ctrl_cs_id}}, {32'h0}, {32'h0}, {{30'h0, ctrl_sck_pol, ctrl_sck_pha}}, {{20'h0, ctrl_sck_div}}};	// @[generators/rocket-chip-blocks/src/main/scala/devices/spi/TLSPI.scala:68:21, :69:20, :82:19, generators/rocket-chip-blocks/src/main/scala/devices/spi/TLSPIFlash.scala:82:21, :83:25, generators/rocket-chip-blocks/src/main/scala/util/RegMapFIFO.scala:24:9, :45:21, generators/rocket-chip/src/main/scala/tilelink/Bundles.scala:259:74, generators/rocket-chip/src/main/scala/tilelink/RegisterRouter.scala:82:24, generators/rocket-chip/src/main/scala/util/MuxLiteral.scala:49:{10,48}, src/main/scala/chisel3/util/OneHot.scala:58:35]
  wire [2:0]        controlXingIn_d_bits_opcode = {2'h0, out_front_bits_read};	// @[generators/rocket-chip/src/main/scala/tilelink/Bundles.scala:259:74, generators/rocket-chip/src/main/scala/tilelink/RegisterRouter.scala:69:36, :100:19]
  wire [11:0]       _out_womask_T_4 = {{4{auto_control_xing_in_a_bits_mask[1]}}, {8{auto_control_xing_in_a_bits_mask[0]}}};	// @[generators/rocket-chip/src/main/scala/tilelink/RegisterRouter.scala:82:24]
  always @(posedge clock) begin
    if (reset) begin
      ctrl_fmt_proto <= 2'h0;	// @[generators/rocket-chip-blocks/src/main/scala/devices/spi/TLSPI.scala:68:21, generators/rocket-chip/src/main/scala/tilelink/Bundles.scala:259:74]
      ctrl_fmt_endian <= 1'h0;	// @[generators/rocket-chip-blocks/src/main/scala/devices/spi/TLSPI.scala:68:21, generators/rocket-chip/src/main/scala/tilelink/Bundles.scala:259:74]
      ctrl_fmt_iodir <= 1'h0;	// @[generators/rocket-chip-blocks/src/main/scala/devices/spi/TLSPI.scala:68:21, generators/rocket-chip/src/main/scala/tilelink/Bundles.scala:259:74]
      ctrl_fmt_len <= 4'h8;	// @[generators/rocket-chip-blocks/src/main/scala/devices/spi/SPIBundle.scala:86:18, generators/rocket-chip-blocks/src/main/scala/devices/spi/TLSPI.scala:68:21]
      ctrl_sck_div <= 12'h3;	// @[generators/rocket-chip-blocks/src/main/scala/devices/spi/SPIBundle.scala:87:18, generators/rocket-chip-blocks/src/main/scala/devices/spi/TLSPI.scala:68:21]
      ctrl_sck_pol <= 1'h0;	// @[generators/rocket-chip-blocks/src/main/scala/devices/spi/TLSPI.scala:68:21, generators/rocket-chip/src/main/scala/tilelink/Bundles.scala:259:74]
      ctrl_sck_pha <= 1'h0;	// @[generators/rocket-chip-blocks/src/main/scala/devices/spi/TLSPI.scala:68:21, generators/rocket-chip/src/main/scala/tilelink/Bundles.scala:259:74]
      ctrl_cs_id <= 1'h0;	// @[generators/rocket-chip-blocks/src/main/scala/devices/spi/TLSPI.scala:68:21, generators/rocket-chip/src/main/scala/tilelink/Bundles.scala:259:74]
      ctrl_cs_dflt_0 <= 1'h1;	// @[generators/rocket-chip-blocks/src/main/scala/devices/spi/TLSPI.scala:68:21, generators/rocket-chip/src/main/scala/tilelink/Buffer.scala:47:20]
      ctrl_cs_mode <= 2'h0;	// @[generators/rocket-chip-blocks/src/main/scala/devices/spi/TLSPI.scala:68:21, generators/rocket-chip/src/main/scala/tilelink/Bundles.scala:259:74]
      ctrl_dla_cssck <= 8'h1;	// @[generators/rocket-chip-blocks/src/main/scala/devices/spi/SPIBundle.scala:93:20, generators/rocket-chip-blocks/src/main/scala/devices/spi/TLSPI.scala:68:21]
      ctrl_dla_sckcs <= 8'h1;	// @[generators/rocket-chip-blocks/src/main/scala/devices/spi/SPIBundle.scala:93:20, generators/rocket-chip-blocks/src/main/scala/devices/spi/TLSPI.scala:68:21]
      ctrl_dla_intercs <= 8'h1;	// @[generators/rocket-chip-blocks/src/main/scala/devices/spi/SPIBundle.scala:93:20, generators/rocket-chip-blocks/src/main/scala/devices/spi/TLSPI.scala:68:21]
      ctrl_dla_interxfr <= 8'h0;	// @[generators/rocket-chip-blocks/src/main/scala/devices/spi/TLSPI.scala:68:21, generators/rocket-chip/src/main/scala/tilelink/Bundles.scala:259:74]
      ctrl_wm_tx <= 4'h0;	// @[generators/rocket-chip-blocks/src/main/scala/devices/spi/TLSPI.scala:68:21, generators/rocket-chip/src/main/scala/tilelink/Bundles.scala:259:74]
      ctrl_wm_rx <= 4'h0;	// @[generators/rocket-chip-blocks/src/main/scala/devices/spi/TLSPI.scala:68:21, generators/rocket-chip/src/main/scala/tilelink/Bundles.scala:259:74]
      ctrl_extradel_coarse <= 12'h0;	// @[generators/rocket-chip-blocks/src/main/scala/devices/spi/TLSPI.scala:68:21, generators/rocket-chip/src/main/scala/tilelink/RegisterRouter.scala:82:24]
      ctrl_sampledel_sd <= 5'h3;	// @[generators/rocket-chip-blocks/src/main/scala/devices/spi/SPIBundle.scala:101:23, generators/rocket-chip-blocks/src/main/scala/devices/spi/TLSPI.scala:68:21]
      ie_txwm <= 1'h0;	// @[generators/rocket-chip-blocks/src/main/scala/devices/spi/TLSPI.scala:82:19, generators/rocket-chip/src/main/scala/tilelink/Bundles.scala:259:74]
      ie_rxwm <= 1'h0;	// @[generators/rocket-chip-blocks/src/main/scala/devices/spi/TLSPI.scala:82:19, generators/rocket-chip/src/main/scala/tilelink/Bundles.scala:259:74]
      insn_cmd_proto <= 2'h0;	// @[generators/rocket-chip-blocks/src/main/scala/devices/spi/TLSPIFlash.scala:82:21, generators/rocket-chip/src/main/scala/tilelink/Bundles.scala:259:74]
      insn_cmd_code <= 8'h3;	// @[generators/rocket-chip-blocks/src/main/scala/devices/spi/SPIFlash.scala:33:19, generators/rocket-chip-blocks/src/main/scala/devices/spi/TLSPIFlash.scala:82:21]
      insn_cmd_en <= 1'h1;	// @[generators/rocket-chip-blocks/src/main/scala/devices/spi/TLSPIFlash.scala:82:21, generators/rocket-chip/src/main/scala/tilelink/Buffer.scala:47:20]
      insn_addr_proto <= 2'h0;	// @[generators/rocket-chip-blocks/src/main/scala/devices/spi/TLSPIFlash.scala:82:21, generators/rocket-chip/src/main/scala/tilelink/Bundles.scala:259:74]
      insn_addr_len <= 3'h3;	// @[generators/rocket-chip-blocks/src/main/scala/devices/spi/TLSPIFlash.scala:82:21]
      insn_pad_code <= 8'h0;	// @[generators/rocket-chip-blocks/src/main/scala/devices/spi/TLSPIFlash.scala:82:21, generators/rocket-chip/src/main/scala/tilelink/Bundles.scala:259:74]
      insn_pad_cnt <= 4'h0;	// @[generators/rocket-chip-blocks/src/main/scala/devices/spi/TLSPIFlash.scala:82:21, generators/rocket-chip/src/main/scala/tilelink/Bundles.scala:259:74]
      insn_data_proto <= 2'h0;	// @[generators/rocket-chip-blocks/src/main/scala/devices/spi/TLSPIFlash.scala:82:21, generators/rocket-chip/src/main/scala/tilelink/Bundles.scala:259:74]
      flash_en <= 1'h1;	// @[generators/rocket-chip-blocks/src/main/scala/devices/spi/TLSPIFlash.scala:83:25, generators/rocket-chip/src/main/scala/tilelink/Buffer.scala:47:20]
    end
    else begin
      if (out_woready_14 & auto_control_xing_in_a_bits_mask[0])	// @[generators/rocket-chip/src/main/scala/tilelink/RegisterRouter.scala:82:24]
        ctrl_fmt_proto <= auto_control_xing_in_a_bits_data[1:0];	// @[generators/rocket-chip-blocks/src/main/scala/devices/spi/TLSPI.scala:68:21, generators/rocket-chip/src/main/scala/tilelink/RegisterRouter.scala:82:24]
      if (out_woready_14 & auto_control_xing_in_a_bits_mask[0])	// @[generators/rocket-chip/src/main/scala/tilelink/RegisterRouter.scala:82:24]
        ctrl_fmt_endian <= auto_control_xing_in_a_bits_data[2];	// @[generators/rocket-chip-blocks/src/main/scala/devices/spi/TLSPI.scala:68:21, generators/rocket-chip/src/main/scala/tilelink/RegisterRouter.scala:82:24]
      if (out_woready_14 & auto_control_xing_in_a_bits_mask[0])	// @[generators/rocket-chip/src/main/scala/tilelink/RegisterRouter.scala:82:24]
        ctrl_fmt_iodir <= auto_control_xing_in_a_bits_data[3];	// @[generators/rocket-chip-blocks/src/main/scala/devices/spi/TLSPI.scala:68:21, generators/rocket-chip/src/main/scala/tilelink/RegisterRouter.scala:82:24]
      if (out_woready_14 & auto_control_xing_in_a_bits_mask[2])	// @[generators/rocket-chip/src/main/scala/tilelink/RegisterRouter.scala:82:24]
        ctrl_fmt_len <= auto_control_xing_in_a_bits_data[19:16];	// @[generators/rocket-chip-blocks/src/main/scala/devices/spi/TLSPI.scala:68:21, generators/rocket-chip/src/main/scala/tilelink/RegisterRouter.scala:82:24]
      if (_out_wofireMux_T_2 & auto_control_xing_in_a_bits_address[6:2] == 5'h0 & _out_out_bits_data_WIRE_29 & (&_out_womask_T_4))	// @[generators/rocket-chip/src/main/scala/tilelink/RegisterRouter.scala:82:24]
        ctrl_sck_div <= auto_control_xing_in_a_bits_data[11:0];	// @[generators/rocket-chip-blocks/src/main/scala/devices/spi/TLSPI.scala:68:21, generators/rocket-chip/src/main/scala/tilelink/RegisterRouter.scala:82:24]
      if (out_woready_6 & auto_control_xing_in_a_bits_mask[0])	// @[generators/rocket-chip/src/main/scala/tilelink/RegisterRouter.scala:82:24]
        ctrl_sck_pol <= auto_control_xing_in_a_bits_data[1];	// @[generators/rocket-chip-blocks/src/main/scala/devices/spi/TLSPI.scala:68:21, generators/rocket-chip/src/main/scala/tilelink/RegisterRouter.scala:82:24]
      if (out_woready_6 & auto_control_xing_in_a_bits_mask[0])	// @[generators/rocket-chip/src/main/scala/tilelink/RegisterRouter.scala:82:24]
        ctrl_sck_pha <= auto_control_xing_in_a_bits_data[0];	// @[generators/rocket-chip-blocks/src/main/scala/devices/spi/TLSPI.scala:68:21, generators/rocket-chip/src/main/scala/tilelink/RegisterRouter.scala:82:24]
      if (_out_wofireMux_T_2 & auto_control_xing_in_a_bits_address[6:2] == 5'h4 & _out_out_bits_data_WIRE_29 & auto_control_xing_in_a_bits_mask[0])	// @[generators/rocket-chip/src/main/scala/tilelink/RegisterRouter.scala:82:24, src/main/scala/chisel3/util/OneHot.scala:58:35]
        ctrl_cs_id <= auto_control_xing_in_a_bits_data[0];	// @[generators/rocket-chip-blocks/src/main/scala/devices/spi/TLSPI.scala:68:21, generators/rocket-chip/src/main/scala/tilelink/RegisterRouter.scala:82:24]
      if (_out_wofireMux_T_2 & auto_control_xing_in_a_bits_address[6:2] == 5'h5 & _out_out_bits_data_WIRE_29 & auto_control_xing_in_a_bits_mask[0])	// @[generators/rocket-chip/src/main/scala/tilelink/RegisterRouter.scala:82:24, src/main/scala/chisel3/util/OneHot.scala:58:35]
        ctrl_cs_dflt_0 <= auto_control_xing_in_a_bits_data[0];	// @[generators/rocket-chip-blocks/src/main/scala/devices/spi/TLSPI.scala:68:21, generators/rocket-chip/src/main/scala/tilelink/RegisterRouter.scala:82:24]
      if (_out_wofireMux_T_2 & auto_control_xing_in_a_bits_address[6:2] == 5'h6 & _out_out_bits_data_WIRE_29 & auto_control_xing_in_a_bits_mask[0])	// @[generators/rocket-chip/src/main/scala/tilelink/RegisterRouter.scala:82:24, src/main/scala/chisel3/util/OneHot.scala:58:35]
        ctrl_cs_mode <= auto_control_xing_in_a_bits_data[1:0];	// @[generators/rocket-chip-blocks/src/main/scala/devices/spi/TLSPI.scala:68:21, generators/rocket-chip/src/main/scala/tilelink/RegisterRouter.scala:82:24]
      if (out_woready_3 & auto_control_xing_in_a_bits_mask[0])	// @[generators/rocket-chip/src/main/scala/tilelink/RegisterRouter.scala:82:24]
        ctrl_dla_cssck <= auto_control_xing_in_a_bits_data[7:0];	// @[generators/rocket-chip-blocks/src/main/scala/devices/spi/TLSPI.scala:68:21, generators/rocket-chip/src/main/scala/tilelink/RegisterRouter.scala:82:24]
      if (out_woready_3 & auto_control_xing_in_a_bits_mask[2])	// @[generators/rocket-chip/src/main/scala/tilelink/RegisterRouter.scala:82:24]
        ctrl_dla_sckcs <= auto_control_xing_in_a_bits_data[23:16];	// @[generators/rocket-chip-blocks/src/main/scala/devices/spi/TLSPI.scala:68:21, generators/rocket-chip/src/main/scala/tilelink/RegisterRouter.scala:82:24]
      if (out_woready_16 & auto_control_xing_in_a_bits_mask[0])	// @[generators/rocket-chip/src/main/scala/tilelink/RegisterRouter.scala:82:24]
        ctrl_dla_intercs <= auto_control_xing_in_a_bits_data[7:0];	// @[generators/rocket-chip-blocks/src/main/scala/devices/spi/TLSPI.scala:68:21, generators/rocket-chip/src/main/scala/tilelink/RegisterRouter.scala:82:24]
      if (out_woready_16 & auto_control_xing_in_a_bits_mask[2])	// @[generators/rocket-chip/src/main/scala/tilelink/RegisterRouter.scala:82:24]
        ctrl_dla_interxfr <= auto_control_xing_in_a_bits_data[23:16];	// @[generators/rocket-chip-blocks/src/main/scala/devices/spi/TLSPI.scala:68:21, generators/rocket-chip/src/main/scala/tilelink/RegisterRouter.scala:82:24]
      if (_out_wofireMux_T_2 & auto_control_xing_in_a_bits_address[6:2] == 5'h14 & _out_out_bits_data_WIRE_29 & auto_control_xing_in_a_bits_mask[0])	// @[generators/rocket-chip/src/main/scala/tilelink/RegisterRouter.scala:82:24, src/main/scala/chisel3/util/OneHot.scala:58:35]
        ctrl_wm_tx <= auto_control_xing_in_a_bits_data[3:0];	// @[generators/rocket-chip-blocks/src/main/scala/devices/spi/TLSPI.scala:68:21, generators/rocket-chip/src/main/scala/tilelink/RegisterRouter.scala:82:24]
      if (_out_wofireMux_T_2 & auto_control_xing_in_a_bits_address[6:2] == 5'h15 & _out_out_bits_data_WIRE_29 & auto_control_xing_in_a_bits_mask[0])	// @[generators/rocket-chip/src/main/scala/tilelink/RegisterRouter.scala:82:24, src/main/scala/chisel3/util/OneHot.scala:58:35]
        ctrl_wm_rx <= auto_control_xing_in_a_bits_data[3:0];	// @[generators/rocket-chip-blocks/src/main/scala/devices/spi/TLSPI.scala:68:21, generators/rocket-chip/src/main/scala/tilelink/RegisterRouter.scala:82:24]
      if (_out_wofireMux_T_2 & auto_control_xing_in_a_bits_address[6:2] == 5'hE & _out_out_bits_data_WIRE_29 & (&_out_womask_T_4))	// @[generators/rocket-chip/src/main/scala/tilelink/RegisterRouter.scala:82:24, src/main/scala/chisel3/util/OneHot.scala:58:35]
        ctrl_extradel_coarse <= auto_control_xing_in_a_bits_data[11:0];	// @[generators/rocket-chip-blocks/src/main/scala/devices/spi/TLSPI.scala:68:21, generators/rocket-chip/src/main/scala/tilelink/RegisterRouter.scala:82:24]
      if (_out_wofireMux_T_2 & auto_control_xing_in_a_bits_address[6:2] == 5'hF & _out_out_bits_data_WIRE_29 & auto_control_xing_in_a_bits_mask[0])	// @[generators/rocket-chip/src/main/scala/tilelink/RegisterRouter.scala:82:24, src/main/scala/chisel3/util/OneHot.scala:58:35]
        ctrl_sampledel_sd <= auto_control_xing_in_a_bits_data[4:0];	// @[generators/rocket-chip-blocks/src/main/scala/devices/spi/TLSPI.scala:68:21, generators/rocket-chip/src/main/scala/tilelink/RegisterRouter.scala:82:24]
      if (out_woready_35 & auto_control_xing_in_a_bits_mask[0])	// @[generators/rocket-chip/src/main/scala/tilelink/RegisterRouter.scala:82:24]
        ie_txwm <= auto_control_xing_in_a_bits_data[0];	// @[generators/rocket-chip-blocks/src/main/scala/devices/spi/TLSPI.scala:82:19, generators/rocket-chip/src/main/scala/tilelink/RegisterRouter.scala:82:24]
      if (out_woready_35 & auto_control_xing_in_a_bits_mask[0])	// @[generators/rocket-chip/src/main/scala/tilelink/RegisterRouter.scala:82:24]
        ie_rxwm <= auto_control_xing_in_a_bits_data[1];	// @[generators/rocket-chip-blocks/src/main/scala/devices/spi/TLSPI.scala:82:19, generators/rocket-chip/src/main/scala/tilelink/RegisterRouter.scala:82:24]
      if (out_woready_30 & auto_control_xing_in_a_bits_mask[1])	// @[generators/rocket-chip/src/main/scala/tilelink/RegisterRouter.scala:82:24]
        insn_cmd_proto <= auto_control_xing_in_a_bits_data[9:8];	// @[generators/rocket-chip-blocks/src/main/scala/devices/spi/TLSPIFlash.scala:82:21, generators/rocket-chip/src/main/scala/tilelink/RegisterRouter.scala:82:24]
      if (out_woready_30 & auto_control_xing_in_a_bits_mask[2])	// @[generators/rocket-chip/src/main/scala/tilelink/RegisterRouter.scala:82:24]
        insn_cmd_code <= auto_control_xing_in_a_bits_data[23:16];	// @[generators/rocket-chip-blocks/src/main/scala/devices/spi/TLSPIFlash.scala:82:21, generators/rocket-chip/src/main/scala/tilelink/RegisterRouter.scala:82:24]
      if (out_woready_30 & auto_control_xing_in_a_bits_mask[0])	// @[generators/rocket-chip/src/main/scala/tilelink/RegisterRouter.scala:82:24]
        insn_cmd_en <= auto_control_xing_in_a_bits_data[0];	// @[generators/rocket-chip-blocks/src/main/scala/devices/spi/TLSPIFlash.scala:82:21, generators/rocket-chip/src/main/scala/tilelink/RegisterRouter.scala:82:24]
      if (out_woready_30 & auto_control_xing_in_a_bits_mask[1])	// @[generators/rocket-chip/src/main/scala/tilelink/RegisterRouter.scala:82:24]
        insn_addr_proto <= auto_control_xing_in_a_bits_data[11:10];	// @[generators/rocket-chip-blocks/src/main/scala/devices/spi/TLSPIFlash.scala:82:21, generators/rocket-chip/src/main/scala/tilelink/RegisterRouter.scala:82:24]
      if (out_woready_30 & auto_control_xing_in_a_bits_mask[0])	// @[generators/rocket-chip/src/main/scala/tilelink/RegisterRouter.scala:82:24]
        insn_addr_len <= auto_control_xing_in_a_bits_data[3:1];	// @[generators/rocket-chip-blocks/src/main/scala/devices/spi/TLSPIFlash.scala:82:21, generators/rocket-chip/src/main/scala/tilelink/RegisterRouter.scala:82:24]
      if (out_woready_30 & auto_control_xing_in_a_bits_mask[3])	// @[generators/rocket-chip/src/main/scala/tilelink/RegisterRouter.scala:82:24]
        insn_pad_code <= auto_control_xing_in_a_bits_data[31:24];	// @[generators/rocket-chip-blocks/src/main/scala/devices/spi/TLSPIFlash.scala:82:21, generators/rocket-chip/src/main/scala/tilelink/RegisterRouter.scala:82:24]
      if (out_woready_30 & auto_control_xing_in_a_bits_mask[0])	// @[generators/rocket-chip/src/main/scala/tilelink/RegisterRouter.scala:82:24]
        insn_pad_cnt <= auto_control_xing_in_a_bits_data[7:4];	// @[generators/rocket-chip-blocks/src/main/scala/devices/spi/TLSPIFlash.scala:82:21, generators/rocket-chip/src/main/scala/tilelink/RegisterRouter.scala:82:24]
      if (out_woready_30 & auto_control_xing_in_a_bits_mask[1])	// @[generators/rocket-chip/src/main/scala/tilelink/RegisterRouter.scala:82:24]
        insn_data_proto <= auto_control_xing_in_a_bits_data[13:12];	// @[generators/rocket-chip-blocks/src/main/scala/devices/spi/TLSPIFlash.scala:82:21, generators/rocket-chip/src/main/scala/tilelink/RegisterRouter.scala:82:24]
      if (_out_wofireMux_T_2 & auto_control_xing_in_a_bits_address[6:2] == 5'h18 & _out_out_bits_data_WIRE_29 & auto_control_xing_in_a_bits_mask[0])	// @[generators/rocket-chip/src/main/scala/tilelink/RegisterRouter.scala:82:24, src/main/scala/chisel3/util/OneHot.scala:58:35]
        flash_en <= auto_control_xing_in_a_bits_data[0];	// @[generators/rocket-chip-blocks/src/main/scala/devices/spi/TLSPIFlash.scala:83:25, generators/rocket-chip/src/main/scala/tilelink/RegisterRouter.scala:82:24]
    end
    if (_flash_io_addr_ready & auto_mem_xing_in_a_valid) begin	// @[generators/rocket-chip-blocks/src/main/scala/devices/spi/TLSPIFlash.scala:57:21, src/main/scala/chisel3/util/Decoupled.scala:52:35]
      a_size <= auto_mem_xing_in_a_bits_size;	// @[generators/rocket-chip-blocks/src/main/scala/devices/spi/TLSPIFlash.scala:66:14]
      a_source <= auto_mem_xing_in_a_bits_source;	// @[generators/rocket-chip-blocks/src/main/scala/devices/spi/TLSPIFlash.scala:66:14]
      a_address <= auto_mem_xing_in_a_bits_address;	// @[generators/rocket-chip-blocks/src/main/scala/devices/spi/TLSPIFlash.scala:66:14]
    end
  end // always @(posedge)
  `ifdef ENABLE_INITIAL_REG_
    `ifdef FIRRTL_BEFORE_INITIAL
      `FIRRTL_BEFORE_INITIAL
    `endif // FIRRTL_BEFORE_INITIAL
    logic [31:0] _RANDOM[0:5];
    initial begin
      `ifdef INIT_RANDOM_PROLOG_
        `INIT_RANDOM_PROLOG_
      `endif // INIT_RANDOM_PROLOG_
      `ifdef RANDOMIZE_REG_INIT
        for (logic [2:0] i = 3'h0; i < 3'h6; i += 3'h1) begin
          _RANDOM[i] = `RANDOM;
        end
        ctrl_fmt_proto = _RANDOM[3'h0][1:0];	// @[generators/rocket-chip-blocks/src/main/scala/devices/spi/TLSPI.scala:68:21]
        ctrl_fmt_endian = _RANDOM[3'h0][2];	// @[generators/rocket-chip-blocks/src/main/scala/devices/spi/TLSPI.scala:68:21]
        ctrl_fmt_iodir = _RANDOM[3'h0][3];	// @[generators/rocket-chip-blocks/src/main/scala/devices/spi/TLSPI.scala:68:21]
        ctrl_fmt_len = _RANDOM[3'h0][7:4];	// @[generators/rocket-chip-blocks/src/main/scala/devices/spi/TLSPI.scala:68:21]
        ctrl_sck_div = _RANDOM[3'h0][19:8];	// @[generators/rocket-chip-blocks/src/main/scala/devices/spi/TLSPI.scala:68:21]
        ctrl_sck_pol = _RANDOM[3'h0][20];	// @[generators/rocket-chip-blocks/src/main/scala/devices/spi/TLSPI.scala:68:21]
        ctrl_sck_pha = _RANDOM[3'h0][21];	// @[generators/rocket-chip-blocks/src/main/scala/devices/spi/TLSPI.scala:68:21]
        ctrl_cs_id = _RANDOM[3'h0][22];	// @[generators/rocket-chip-blocks/src/main/scala/devices/spi/TLSPI.scala:68:21]
        ctrl_cs_dflt_0 = _RANDOM[3'h0][23];	// @[generators/rocket-chip-blocks/src/main/scala/devices/spi/TLSPI.scala:68:21]
        ctrl_cs_mode = _RANDOM[3'h0][25:24];	// @[generators/rocket-chip-blocks/src/main/scala/devices/spi/TLSPI.scala:68:21]
        ctrl_dla_cssck = {_RANDOM[3'h0][31:26], _RANDOM[3'h1][1:0]};	// @[generators/rocket-chip-blocks/src/main/scala/devices/spi/TLSPI.scala:68:21]
        ctrl_dla_sckcs = _RANDOM[3'h1][9:2];	// @[generators/rocket-chip-blocks/src/main/scala/devices/spi/TLSPI.scala:68:21]
        ctrl_dla_intercs = _RANDOM[3'h1][17:10];	// @[generators/rocket-chip-blocks/src/main/scala/devices/spi/TLSPI.scala:68:21]
        ctrl_dla_interxfr = _RANDOM[3'h1][25:18];	// @[generators/rocket-chip-blocks/src/main/scala/devices/spi/TLSPI.scala:68:21]
        ctrl_wm_tx = _RANDOM[3'h1][29:26];	// @[generators/rocket-chip-blocks/src/main/scala/devices/spi/TLSPI.scala:68:21]
        ctrl_wm_rx = {_RANDOM[3'h1][31:30], _RANDOM[3'h2][1:0]};	// @[generators/rocket-chip-blocks/src/main/scala/devices/spi/TLSPI.scala:68:21]
        ctrl_extradel_coarse = _RANDOM[3'h2][13:2];	// @[generators/rocket-chip-blocks/src/main/scala/devices/spi/TLSPI.scala:68:21]
        ctrl_sampledel_sd = _RANDOM[3'h2][18:14];	// @[generators/rocket-chip-blocks/src/main/scala/devices/spi/TLSPI.scala:68:21]
        ie_txwm = _RANDOM[3'h2][19];	// @[generators/rocket-chip-blocks/src/main/scala/devices/spi/TLSPI.scala:68:21, :82:19]
        ie_rxwm = _RANDOM[3'h2][20];	// @[generators/rocket-chip-blocks/src/main/scala/devices/spi/TLSPI.scala:68:21, :82:19]
        a_size = _RANDOM[3'h2][27];	// @[generators/rocket-chip-blocks/src/main/scala/devices/spi/TLSPI.scala:68:21, generators/rocket-chip-blocks/src/main/scala/devices/spi/TLSPIFlash.scala:66:14]
        a_source = {_RANDOM[3'h2][31:28], _RANDOM[3'h3][13:0]};	// @[generators/rocket-chip-blocks/src/main/scala/devices/spi/TLSPI.scala:68:21, generators/rocket-chip-blocks/src/main/scala/devices/spi/TLSPIFlash.scala:66:14]
        a_address = {_RANDOM[3'h3][31:14], _RANDOM[3'h4][11:0]};	// @[generators/rocket-chip-blocks/src/main/scala/devices/spi/TLSPIFlash.scala:66:14]
        insn_cmd_proto = _RANDOM[3'h4][23:22];	// @[generators/rocket-chip-blocks/src/main/scala/devices/spi/TLSPIFlash.scala:66:14, :82:21]
        insn_cmd_code = _RANDOM[3'h4][31:24];	// @[generators/rocket-chip-blocks/src/main/scala/devices/spi/TLSPIFlash.scala:66:14, :82:21]
        insn_cmd_en = _RANDOM[3'h5][0];	// @[generators/rocket-chip-blocks/src/main/scala/devices/spi/TLSPIFlash.scala:82:21]
        insn_addr_proto = _RANDOM[3'h5][2:1];	// @[generators/rocket-chip-blocks/src/main/scala/devices/spi/TLSPIFlash.scala:82:21]
        insn_addr_len = _RANDOM[3'h5][5:3];	// @[generators/rocket-chip-blocks/src/main/scala/devices/spi/TLSPIFlash.scala:82:21]
        insn_pad_code = _RANDOM[3'h5][13:6];	// @[generators/rocket-chip-blocks/src/main/scala/devices/spi/TLSPIFlash.scala:82:21]
        insn_pad_cnt = _RANDOM[3'h5][17:14];	// @[generators/rocket-chip-blocks/src/main/scala/devices/spi/TLSPIFlash.scala:82:21]
        insn_data_proto = _RANDOM[3'h5][19:18];	// @[generators/rocket-chip-blocks/src/main/scala/devices/spi/TLSPIFlash.scala:82:21]
        flash_en = _RANDOM[3'h5][20];	// @[generators/rocket-chip-blocks/src/main/scala/devices/spi/TLSPIFlash.scala:82:21, :83:25]
      `endif // RANDOMIZE_REG_INIT
    end // initial
    `ifdef FIRRTL_AFTER_INITIAL
      `FIRRTL_AFTER_INITIAL
    `endif // FIRRTL_AFTER_INITIAL
  `endif // ENABLE_INITIAL_REG_
  IntSyncCrossingSource intsource (	// @[generators/rocket-chip/src/main/scala/interrupts/Crossing.scala:28:31]
    .clock           (clock),
    .reset           (reset),
    .auto_in_0       (_fifo_io_ip_txwm & ie_txwm | _fifo_io_ip_rxwm & ie_rxwm),	// @[generators/rocket-chip-blocks/src/main/scala/devices/spi/TLSPI.scala:69:20, :82:19, :84:{35,47,59}]
    .auto_out_sync_0 (auto_int_xing_out_sync_0)
  );
  TLMonitor_57 monitor (	// @[generators/rocket-chip/src/main/scala/tilelink/Nodes.scala:24:25]
    .clock                (clock),
    .reset                (reset),
    .io_in_a_ready        (_flash_io_addr_ready),	// @[generators/rocket-chip-blocks/src/main/scala/devices/spi/TLSPIFlash.scala:57:21]
    .io_in_a_valid        (auto_mem_xing_in_a_valid),
    .io_in_a_bits_opcode  (auto_mem_xing_in_a_bits_opcode),
    .io_in_a_bits_param   (auto_mem_xing_in_a_bits_param),
    .io_in_a_bits_size    (auto_mem_xing_in_a_bits_size),
    .io_in_a_bits_source  (auto_mem_xing_in_a_bits_source),
    .io_in_a_bits_address (auto_mem_xing_in_a_bits_address),
    .io_in_a_bits_mask    (auto_mem_xing_in_a_bits_mask),
    .io_in_a_bits_corrupt (auto_mem_xing_in_a_bits_corrupt),
    .io_in_d_ready        (auto_mem_xing_in_d_ready),
    .io_in_d_valid        (_flash_io_data_valid),	// @[generators/rocket-chip-blocks/src/main/scala/devices/spi/TLSPIFlash.scala:57:21]
    .io_in_d_bits_size    (a_size),	// @[generators/rocket-chip-blocks/src/main/scala/devices/spi/TLSPIFlash.scala:66:14]
    .io_in_d_bits_source  (a_source)	// @[generators/rocket-chip-blocks/src/main/scala/devices/spi/TLSPIFlash.scala:66:14]
  );
  TLMonitor_58 monitor_1 (	// @[generators/rocket-chip/src/main/scala/tilelink/Nodes.scala:24:25]
    .clock                (clock),
    .reset                (reset),
    .io_in_a_ready        (auto_control_xing_in_d_ready),
    .io_in_a_valid        (auto_control_xing_in_a_valid),
    .io_in_a_bits_opcode  (auto_control_xing_in_a_bits_opcode),
    .io_in_a_bits_param   (auto_control_xing_in_a_bits_param),
    .io_in_a_bits_size    (auto_control_xing_in_a_bits_size),
    .io_in_a_bits_source  (auto_control_xing_in_a_bits_source),
    .io_in_a_bits_address (auto_control_xing_in_a_bits_address),
    .io_in_a_bits_mask    (auto_control_xing_in_a_bits_mask),
    .io_in_a_bits_corrupt (auto_control_xing_in_a_bits_corrupt),
    .io_in_d_ready        (auto_control_xing_in_d_ready),
    .io_in_d_valid        (auto_control_xing_in_a_valid),
    .io_in_d_bits_opcode  (controlXingIn_d_bits_opcode),	// @[generators/rocket-chip/src/main/scala/tilelink/RegisterRouter.scala:100:19]
    .io_in_d_bits_size    (auto_control_xing_in_a_bits_size),
    .io_in_d_bits_source  (auto_control_xing_in_a_bits_source)
  );
  SPIFIFO fifo (	// @[generators/rocket-chip-blocks/src/main/scala/devices/spi/TLSPI.scala:69:20]
    .clock              (clock),
    .reset              (reset),
    .io_ctrl_fmt_proto  (ctrl_fmt_proto),	// @[generators/rocket-chip-blocks/src/main/scala/devices/spi/TLSPI.scala:68:21]
    .io_ctrl_fmt_endian (ctrl_fmt_endian),	// @[generators/rocket-chip-blocks/src/main/scala/devices/spi/TLSPI.scala:68:21]
    .io_ctrl_fmt_iodir  (ctrl_fmt_iodir),	// @[generators/rocket-chip-blocks/src/main/scala/devices/spi/TLSPI.scala:68:21]
    .io_ctrl_fmt_len    (ctrl_fmt_len),	// @[generators/rocket-chip-blocks/src/main/scala/devices/spi/TLSPI.scala:68:21]
    .io_ctrl_cs_mode    (ctrl_cs_mode),	// @[generators/rocket-chip-blocks/src/main/scala/devices/spi/TLSPI.scala:68:21]
    .io_ctrl_wm_tx      (ctrl_wm_tx),	// @[generators/rocket-chip-blocks/src/main/scala/devices/spi/TLSPI.scala:68:21]
    .io_ctrl_wm_rx      (ctrl_wm_rx),	// @[generators/rocket-chip-blocks/src/main/scala/devices/spi/TLSPI.scala:68:21]
    .io_link_tx_ready   (_arb_io_inner_1_tx_ready),	// @[generators/rocket-chip-blocks/src/main/scala/devices/spi/TLSPIFlash.scala:58:19]
    .io_link_tx_valid   (_fifo_io_link_tx_valid),
    .io_link_tx_bits    (_fifo_io_link_tx_bits),
    .io_link_rx_valid   (_arb_io_inner_1_rx_valid),	// @[generators/rocket-chip-blocks/src/main/scala/devices/spi/TLSPIFlash.scala:58:19]
    .io_link_rx_bits    (_arb_io_inner_1_rx_bits),	// @[generators/rocket-chip-blocks/src/main/scala/devices/spi/TLSPIFlash.scala:58:19]
    .io_link_cnt        (_fifo_io_link_cnt),
    .io_link_fmt_proto  (_fifo_io_link_fmt_proto),
    .io_link_fmt_endian (_fifo_io_link_fmt_endian),
    .io_link_fmt_iodir  (_fifo_io_link_fmt_iodir),
    .io_link_cs_set     (_fifo_io_link_cs_set),
    .io_link_cs_clear   (_fifo_io_link_cs_clear),
    .io_link_lock       (_fifo_io_link_lock),
    .io_tx_ready        (_fifo_io_tx_ready),
    .io_tx_valid        (out_woready_10 & auto_control_xing_in_a_bits_mask[0] & ~quash),	// @[generators/rocket-chip-blocks/src/main/scala/util/RegMapFIFO.scala:18:{30,33}, :26:26, generators/rocket-chip/src/main/scala/tilelink/RegisterRouter.scala:82:24]
    .io_tx_bits         (auto_control_xing_in_a_bits_data[7:0]),	// @[generators/rocket-chip/src/main/scala/tilelink/RegisterRouter.scala:82:24]
    .io_rx_ready        (_out_wofireMux_T & out_front_bits_read & out_backSel_19 & _out_out_bits_data_WIRE_29 & auto_control_xing_in_a_bits_mask[0]),	// @[generators/rocket-chip/src/main/scala/tilelink/RegisterRouter.scala:69:36, :82:24]
    .io_rx_valid        (_fifo_io_rx_valid),
    .io_rx_bits         (_fifo_io_rx_bits),
    .io_ip_txwm         (_fifo_io_ip_txwm),
    .io_ip_rxwm         (_fifo_io_ip_rxwm)
  );
  SPIMedia mac (	// @[generators/rocket-chip-blocks/src/main/scala/devices/spi/TLSPI.scala:70:19]
    .clock                   (clock),
    .reset                   (reset),
    .io_port_sck             (auto_io_out_sck),
    .io_port_dq_0_i          (auto_io_out_dq_0_i),
    .io_port_dq_0_o          (auto_io_out_dq_0_o),
    .io_port_dq_0_oe         (auto_io_out_dq_0_oe),
    .io_port_dq_1_i          (auto_io_out_dq_1_i),
    .io_port_dq_1_o          (auto_io_out_dq_1_o),
    .io_port_dq_1_oe         (auto_io_out_dq_1_oe),
    .io_port_dq_2_i          (auto_io_out_dq_2_i),
    .io_port_dq_2_o          (auto_io_out_dq_2_o),
    .io_port_dq_2_oe         (auto_io_out_dq_2_oe),
    .io_port_dq_3_i          (auto_io_out_dq_3_i),
    .io_port_dq_3_o          (auto_io_out_dq_3_o),
    .io_port_dq_3_oe         (auto_io_out_dq_3_oe),
    .io_port_cs_0            (auto_io_out_cs_0),
    .io_ctrl_sck_div         (ctrl_sck_div),	// @[generators/rocket-chip-blocks/src/main/scala/devices/spi/TLSPI.scala:68:21]
    .io_ctrl_sck_pol         (ctrl_sck_pol),	// @[generators/rocket-chip-blocks/src/main/scala/devices/spi/TLSPI.scala:68:21]
    .io_ctrl_sck_pha         (ctrl_sck_pha),	// @[generators/rocket-chip-blocks/src/main/scala/devices/spi/TLSPI.scala:68:21]
    .io_ctrl_dla_cssck       (ctrl_dla_cssck),	// @[generators/rocket-chip-blocks/src/main/scala/devices/spi/TLSPI.scala:68:21]
    .io_ctrl_dla_sckcs       (ctrl_dla_sckcs),	// @[generators/rocket-chip-blocks/src/main/scala/devices/spi/TLSPI.scala:68:21]
    .io_ctrl_dla_intercs     (ctrl_dla_intercs),	// @[generators/rocket-chip-blocks/src/main/scala/devices/spi/TLSPI.scala:68:21]
    .io_ctrl_dla_interxfr    (ctrl_dla_interxfr),	// @[generators/rocket-chip-blocks/src/main/scala/devices/spi/TLSPI.scala:68:21]
    .io_ctrl_cs_id           (ctrl_cs_id),	// @[generators/rocket-chip-blocks/src/main/scala/devices/spi/TLSPI.scala:68:21]
    .io_ctrl_cs_dflt_0       (ctrl_cs_dflt_0),	// @[generators/rocket-chip-blocks/src/main/scala/devices/spi/TLSPI.scala:68:21]
    .io_ctrl_extradel_coarse (ctrl_extradel_coarse),	// @[generators/rocket-chip-blocks/src/main/scala/devices/spi/TLSPI.scala:68:21]
    .io_ctrl_sampledel_sd    (ctrl_sampledel_sd),	// @[generators/rocket-chip-blocks/src/main/scala/devices/spi/TLSPI.scala:68:21]
    .io_link_tx_ready        (_mac_io_link_tx_ready),
    .io_link_tx_valid        (_arb_io_outer_tx_valid),	// @[generators/rocket-chip-blocks/src/main/scala/devices/spi/TLSPIFlash.scala:58:19]
    .io_link_tx_bits         (_arb_io_outer_tx_bits),	// @[generators/rocket-chip-blocks/src/main/scala/devices/spi/TLSPIFlash.scala:58:19]
    .io_link_rx_valid        (_mac_io_link_rx_valid),
    .io_link_rx_bits         (_mac_io_link_rx_bits),
    .io_link_cnt             (_arb_io_outer_cnt),	// @[generators/rocket-chip-blocks/src/main/scala/devices/spi/TLSPIFlash.scala:58:19]
    .io_link_fmt_proto       (_arb_io_outer_fmt_proto),	// @[generators/rocket-chip-blocks/src/main/scala/devices/spi/TLSPIFlash.scala:58:19]
    .io_link_fmt_endian      (_arb_io_outer_fmt_endian),	// @[generators/rocket-chip-blocks/src/main/scala/devices/spi/TLSPIFlash.scala:58:19]
    .io_link_fmt_iodir       (_arb_io_outer_fmt_iodir),	// @[generators/rocket-chip-blocks/src/main/scala/devices/spi/TLSPIFlash.scala:58:19]
    .io_link_cs_set          (_arb_io_outer_cs_set),	// @[generators/rocket-chip-blocks/src/main/scala/devices/spi/TLSPIFlash.scala:58:19]
    .io_link_cs_clear        (_arb_io_outer_cs_clear),	// @[generators/rocket-chip-blocks/src/main/scala/devices/spi/TLSPIFlash.scala:58:19]
    .io_link_cs_hold         (_arb_io_outer_cs_hold),	// @[generators/rocket-chip-blocks/src/main/scala/devices/spi/TLSPIFlash.scala:58:19]
    .io_link_active          (_mac_io_link_active)
  );
  SPIFlashMap flash (	// @[generators/rocket-chip-blocks/src/main/scala/devices/spi/TLSPIFlash.scala:57:21]
    .clock                   (clock),
    .reset                   (reset),
    .io_en                   (flash_en),	// @[generators/rocket-chip-blocks/src/main/scala/devices/spi/TLSPIFlash.scala:83:25]
    .io_ctrl_insn_cmd_proto  (insn_cmd_proto),	// @[generators/rocket-chip-blocks/src/main/scala/devices/spi/TLSPIFlash.scala:82:21]
    .io_ctrl_insn_cmd_code   (insn_cmd_code),	// @[generators/rocket-chip-blocks/src/main/scala/devices/spi/TLSPIFlash.scala:82:21]
    .io_ctrl_insn_cmd_en     (insn_cmd_en),	// @[generators/rocket-chip-blocks/src/main/scala/devices/spi/TLSPIFlash.scala:82:21]
    .io_ctrl_insn_addr_proto (insn_addr_proto),	// @[generators/rocket-chip-blocks/src/main/scala/devices/spi/TLSPIFlash.scala:82:21]
    .io_ctrl_insn_addr_len   (insn_addr_len),	// @[generators/rocket-chip-blocks/src/main/scala/devices/spi/TLSPIFlash.scala:82:21]
    .io_ctrl_insn_pad_code   (insn_pad_code),	// @[generators/rocket-chip-blocks/src/main/scala/devices/spi/TLSPIFlash.scala:82:21]
    .io_ctrl_insn_pad_cnt    (insn_pad_cnt),	// @[generators/rocket-chip-blocks/src/main/scala/devices/spi/TLSPIFlash.scala:82:21]
    .io_ctrl_insn_data_proto (insn_data_proto),	// @[generators/rocket-chip-blocks/src/main/scala/devices/spi/TLSPIFlash.scala:82:21]
    .io_ctrl_fmt_endian      (ctrl_fmt_endian),	// @[generators/rocket-chip-blocks/src/main/scala/devices/spi/TLSPI.scala:68:21]
    .io_addr_ready           (_flash_io_addr_ready),
    .io_addr_valid           (auto_mem_xing_in_a_valid),
    .io_addr_bits_next       ({4'h0, auto_mem_xing_in_a_bits_address[27:0]}),	// @[generators/rocket-chip-blocks/src/main/scala/devices/spi/TLSPIFlash.scala:73:{27,46}, generators/rocket-chip/src/main/scala/tilelink/Bundles.scala:259:74]
    .io_addr_bits_hold       ({4'h0, a_address[27:0]}),	// @[generators/rocket-chip-blocks/src/main/scala/devices/spi/TLSPIFlash.scala:66:14, :74:{27,39}, generators/rocket-chip/src/main/scala/tilelink/Bundles.scala:259:74]
    .io_data_ready           (auto_mem_xing_in_d_ready),
    .io_data_valid           (_flash_io_data_valid),
    .io_data_bits            (auto_mem_xing_in_d_bits_data),
    .io_link_tx_ready        (_arb_io_inner_0_tx_ready),	// @[generators/rocket-chip-blocks/src/main/scala/devices/spi/TLSPIFlash.scala:58:19]
    .io_link_tx_valid        (_flash_io_link_tx_valid),
    .io_link_tx_bits         (_flash_io_link_tx_bits),
    .io_link_rx_valid        (_arb_io_inner_0_rx_valid),	// @[generators/rocket-chip-blocks/src/main/scala/devices/spi/TLSPIFlash.scala:58:19]
    .io_link_rx_bits         (_arb_io_inner_0_rx_bits),	// @[generators/rocket-chip-blocks/src/main/scala/devices/spi/TLSPIFlash.scala:58:19]
    .io_link_cnt             (_flash_io_link_cnt),
    .io_link_fmt_proto       (_flash_io_link_fmt_proto),
    .io_link_fmt_endian      (_flash_io_link_fmt_endian),
    .io_link_fmt_iodir       (_flash_io_link_fmt_iodir),
    .io_link_cs_clear        (_flash_io_link_cs_clear),
    .io_link_active          (_arb_io_inner_0_active),	// @[generators/rocket-chip-blocks/src/main/scala/devices/spi/TLSPIFlash.scala:58:19]
    .io_link_lock            (_flash_io_link_lock)
  );
  SPIArbiter arb (	// @[generators/rocket-chip-blocks/src/main/scala/devices/spi/TLSPIFlash.scala:58:19]
    .clock                 (clock),
    .reset                 (reset),
    .io_inner_0_tx_ready   (_arb_io_inner_0_tx_ready),
    .io_inner_0_tx_valid   (_flash_io_link_tx_valid),	// @[generators/rocket-chip-blocks/src/main/scala/devices/spi/TLSPIFlash.scala:57:21]
    .io_inner_0_tx_bits    (_flash_io_link_tx_bits),	// @[generators/rocket-chip-blocks/src/main/scala/devices/spi/TLSPIFlash.scala:57:21]
    .io_inner_0_rx_valid   (_arb_io_inner_0_rx_valid),
    .io_inner_0_rx_bits    (_arb_io_inner_0_rx_bits),
    .io_inner_0_cnt        (_flash_io_link_cnt),	// @[generators/rocket-chip-blocks/src/main/scala/devices/spi/TLSPIFlash.scala:57:21]
    .io_inner_0_fmt_proto  (_flash_io_link_fmt_proto),	// @[generators/rocket-chip-blocks/src/main/scala/devices/spi/TLSPIFlash.scala:57:21]
    .io_inner_0_fmt_endian (_flash_io_link_fmt_endian),	// @[generators/rocket-chip-blocks/src/main/scala/devices/spi/TLSPIFlash.scala:57:21]
    .io_inner_0_fmt_iodir  (_flash_io_link_fmt_iodir),	// @[generators/rocket-chip-blocks/src/main/scala/devices/spi/TLSPIFlash.scala:57:21]
    .io_inner_0_cs_clear   (_flash_io_link_cs_clear),	// @[generators/rocket-chip-blocks/src/main/scala/devices/spi/TLSPIFlash.scala:57:21]
    .io_inner_0_active     (_arb_io_inner_0_active),
    .io_inner_0_lock       (_flash_io_link_lock),	// @[generators/rocket-chip-blocks/src/main/scala/devices/spi/TLSPIFlash.scala:57:21]
    .io_inner_1_tx_ready   (_arb_io_inner_1_tx_ready),
    .io_inner_1_tx_valid   (_fifo_io_link_tx_valid),	// @[generators/rocket-chip-blocks/src/main/scala/devices/spi/TLSPI.scala:69:20]
    .io_inner_1_tx_bits    (_fifo_io_link_tx_bits),	// @[generators/rocket-chip-blocks/src/main/scala/devices/spi/TLSPI.scala:69:20]
    .io_inner_1_rx_valid   (_arb_io_inner_1_rx_valid),
    .io_inner_1_rx_bits    (_arb_io_inner_1_rx_bits),
    .io_inner_1_cnt        (_fifo_io_link_cnt),	// @[generators/rocket-chip-blocks/src/main/scala/devices/spi/TLSPI.scala:69:20]
    .io_inner_1_fmt_proto  (_fifo_io_link_fmt_proto),	// @[generators/rocket-chip-blocks/src/main/scala/devices/spi/TLSPI.scala:69:20]
    .io_inner_1_fmt_endian (_fifo_io_link_fmt_endian),	// @[generators/rocket-chip-blocks/src/main/scala/devices/spi/TLSPI.scala:69:20]
    .io_inner_1_fmt_iodir  (_fifo_io_link_fmt_iodir),	// @[generators/rocket-chip-blocks/src/main/scala/devices/spi/TLSPI.scala:69:20]
    .io_inner_1_cs_set     (_fifo_io_link_cs_set),	// @[generators/rocket-chip-blocks/src/main/scala/devices/spi/TLSPI.scala:69:20]
    .io_inner_1_cs_clear   (_fifo_io_link_cs_clear),	// @[generators/rocket-chip-blocks/src/main/scala/devices/spi/TLSPI.scala:69:20]
    .io_inner_1_lock       (_fifo_io_link_lock),	// @[generators/rocket-chip-blocks/src/main/scala/devices/spi/TLSPI.scala:69:20]
    .io_outer_tx_ready     (_mac_io_link_tx_ready),	// @[generators/rocket-chip-blocks/src/main/scala/devices/spi/TLSPI.scala:70:19]
    .io_outer_tx_valid     (_arb_io_outer_tx_valid),
    .io_outer_tx_bits      (_arb_io_outer_tx_bits),
    .io_outer_rx_valid     (_mac_io_link_rx_valid),	// @[generators/rocket-chip-blocks/src/main/scala/devices/spi/TLSPI.scala:70:19]
    .io_outer_rx_bits      (_mac_io_link_rx_bits),	// @[generators/rocket-chip-blocks/src/main/scala/devices/spi/TLSPI.scala:70:19]
    .io_outer_cnt          (_arb_io_outer_cnt),
    .io_outer_fmt_proto    (_arb_io_outer_fmt_proto),
    .io_outer_fmt_endian   (_arb_io_outer_fmt_endian),
    .io_outer_fmt_iodir    (_arb_io_outer_fmt_iodir),
    .io_outer_cs_set       (_arb_io_outer_cs_set),
    .io_outer_cs_clear     (_arb_io_outer_cs_clear),
    .io_outer_cs_hold      (_arb_io_outer_cs_hold),
    .io_outer_active       (_mac_io_link_active),	// @[generators/rocket-chip-blocks/src/main/scala/devices/spi/TLSPI.scala:70:19]
    .io_sel                (~flash_en)	// @[generators/rocket-chip-blocks/src/main/scala/devices/spi/TLSPIFlash.scala:83:25, :88:17]
  );
  assign auto_mem_xing_in_a_ready = _flash_io_addr_ready;	// @[generators/rocket-chip-blocks/src/main/scala/devices/spi/TLSPIFlash.scala:57:21]
  assign auto_mem_xing_in_d_valid = _flash_io_data_valid;	// @[generators/rocket-chip-blocks/src/main/scala/devices/spi/TLSPIFlash.scala:57:21]
  assign auto_mem_xing_in_d_bits_size = a_size;	// @[generators/rocket-chip-blocks/src/main/scala/devices/spi/TLSPIFlash.scala:66:14]
  assign auto_mem_xing_in_d_bits_source = a_source;	// @[generators/rocket-chip-blocks/src/main/scala/devices/spi/TLSPIFlash.scala:66:14]
  assign auto_control_xing_in_a_ready = auto_control_xing_in_d_ready;
  assign auto_control_xing_in_d_valid = auto_control_xing_in_a_valid;
  assign auto_control_xing_in_d_bits_opcode = controlXingIn_d_bits_opcode;	// @[generators/rocket-chip/src/main/scala/tilelink/RegisterRouter.scala:100:19]
  assign auto_control_xing_in_d_bits_size = auto_control_xing_in_a_bits_size;
  assign auto_control_xing_in_d_bits_source = auto_control_xing_in_a_bits_source;
  assign auto_control_xing_in_d_bits_data = _GEN[auto_control_xing_in_a_bits_address[6:2]] ? _GEN_0[auto_control_xing_in_a_bits_address[6:2]] : 32'h0;	// @[generators/rocket-chip/src/main/scala/tilelink/Bundles.scala:259:74, generators/rocket-chip/src/main/scala/tilelink/RegisterRouter.scala:82:24, generators/rocket-chip/src/main/scala/util/MuxLiteral.scala:49:10]
endmodule

