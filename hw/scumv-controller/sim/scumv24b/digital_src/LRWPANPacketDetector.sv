// Generated by CIRCT unknown git version
// Standard header to adapt well known macros for register randomization.
`ifndef RANDOMIZE
  `ifdef RANDOMIZE_MEM_INIT
    `define RANDOMIZE
  `endif // RANDOMIZE_MEM_INIT
`endif // not def RANDOMIZE
`ifndef RANDOMIZE
  `ifdef RANDOMIZE_REG_INIT
    `define RANDOMIZE
  `endif // RANDOMIZE_REG_INIT
`endif // not def RANDOMIZE

// RANDOM may be set to an expression that produces a 32-bit random unsigned value.
`ifndef RANDOM
  `define RANDOM $random
`endif // not def RANDOM

// Users can define INIT_RANDOM as general code that gets injected into the
// initializer block for modules with registers.
`ifndef INIT_RANDOM
  `define INIT_RANDOM
`endif // not def INIT_RANDOM

// If using random initialization, you can also define RANDOMIZE_DELAY to
// customize the delay used, otherwise 0.002 is used.
`ifndef RANDOMIZE_DELAY
  `define RANDOMIZE_DELAY 0.002
`endif // not def RANDOMIZE_DELAY

// Define INIT_RANDOM_PROLOG_ for use in our modules below.
`ifndef INIT_RANDOM_PROLOG_
  `ifdef RANDOMIZE
    `ifdef VERILATOR
      `define INIT_RANDOM_PROLOG_ `INIT_RANDOM
    `else  // VERILATOR
      `define INIT_RANDOM_PROLOG_ `INIT_RANDOM #`RANDOMIZE_DELAY begin end
    `endif // VERILATOR
  `else  // RANDOMIZE
    `define INIT_RANDOM_PROLOG_
  `endif // RANDOMIZE
`endif // not def INIT_RANDOM_PROLOG_

// Include register initializers in init blocks unless synthesis is set
`ifndef SYNTHESIS
  `ifndef ENABLE_INITIAL_REG_
    `define ENABLE_INITIAL_REG_
  `endif // not def ENABLE_INITIAL_REG_
`endif // not def SYNTHESIS

// Include rmemory initializers in init blocks unless synthesis is set
`ifndef SYNTHESIS
  `ifndef ENABLE_INITIAL_MEM_
    `define ENABLE_INITIAL_MEM_
  `endif // not def ENABLE_INITIAL_MEM_
`endif // not def SYNTHESIS

// Standard header to adapt well known macros for prints and assertions.

// Users can define 'PRINTF_COND' to add an extra gate to prints.
`ifndef PRINTF_COND_
  `ifdef PRINTF_COND
    `define PRINTF_COND_ (`PRINTF_COND)
  `else  // PRINTF_COND
    `define PRINTF_COND_ 1
  `endif // PRINTF_COND
`endif // not def PRINTF_COND_

// Users can define 'ASSERT_VERBOSE_COND' to add an extra gate to assert error printing.
`ifndef ASSERT_VERBOSE_COND_
  `ifdef ASSERT_VERBOSE_COND
    `define ASSERT_VERBOSE_COND_ (`ASSERT_VERBOSE_COND)
  `else  // ASSERT_VERBOSE_COND
    `define ASSERT_VERBOSE_COND_ 1
  `endif // ASSERT_VERBOSE_COND
`endif // not def ASSERT_VERBOSE_COND_

// Users can define 'STOP_COND' to add an extra gate to stop conditions.
`ifndef STOP_COND_
  `ifdef STOP_COND
    `define STOP_COND_ (`STOP_COND)
  `else  // STOP_COND
    `define STOP_COND_ 1
  `endif // STOP_COND
`endif // not def STOP_COND_

module LRWPANPacketDetector(
  input         clock,
                reset,
  input  [15:0] io_shr,	// @[generators/baseband/src/main/scala/modem/LRWPANPacketDetector.scala:8:14]
  output        io_sop,	// @[generators/baseband/src/main/scala/modem/LRWPANPacketDetector.scala:8:14]
  input         io_eop,	// @[generators/baseband/src/main/scala/modem/LRWPANPacketDetector.scala:8:14]
                io_in_valid,	// @[generators/baseband/src/main/scala/modem/LRWPANPacketDetector.scala:8:14]
                io_in_bits,	// @[generators/baseband/src/main/scala/modem/LRWPANPacketDetector.scala:8:14]
  output        io_out_valid,	// @[generators/baseband/src/main/scala/modem/LRWPANPacketDetector.scala:8:14]
  output [7:0]  io_out_bits	// @[generators/baseband/src/main/scala/modem/LRWPANPacketDetector.scala:8:14]
);

  wire [3:0]   _symbols_3_io_symbol;	// @[generators/baseband/src/main/scala/modem/LRWPANPacketDetector.scala:22:35]
  wire [3:0]   _symbols_2_io_symbol;	// @[generators/baseband/src/main/scala/modem/LRWPANPacketDetector.scala:22:35]
  wire [3:0]   _symbols_1_io_symbol;	// @[generators/baseband/src/main/scala/modem/LRWPANPacketDetector.scala:22:35]
  wire [3:0]   _symbols_0_io_symbol;	// @[generators/baseband/src/main/scala/modem/LRWPANPacketDetector.scala:22:35]
  reg  [127:0] rawWindow;	// @[generators/baseband/src/main/scala/modem/LRWPANPacketDetector.scala:21:22]
  reg          state;	// @[generators/baseband/src/main/scala/modem/LRWPANPacketDetector.scala:28:22]
  reg  [5:0]   counter;	// @[generators/baseband/src/main/scala/modem/LRWPANPacketDetector.scala:29:20]
  wire         _GEN = {_symbols_3_io_symbol, _symbols_2_io_symbol, _symbols_1_io_symbol, _symbols_0_io_symbol} == io_shr;	// @[generators/baseband/src/main/scala/modem/LRWPANPacketDetector.scala:22:35, :30:19, :50:21]
  wire         _GEN_0 = ~state & _GEN;	// @[generators/baseband/src/main/scala/modem/LRWPANPacketDetector.scala:28:22, :48:19, :50:{21,33}, :51:17]
  always @(posedge clock) begin
    if (io_eop)
      rawWindow <= 128'h0;	// @[generators/baseband/src/main/scala/modem/LRWPANPacketDetector.scala:21:22, :43:15]
    else if (io_in_valid)	// @[generators/baseband/src/main/scala/modem/LRWPANPacketDetector.scala:8:14]
      rawWindow <= {io_in_bits, rawWindow[127:1]};	// @[generators/baseband/src/main/scala/modem/LRWPANPacketDetector.scala:21:22, :45:{21,44}]
    if (reset)
      state <= 1'h0;	// @[generators/baseband/src/main/scala/modem/LRWPANPacketDetector.scala:21:22, :28:22]
    else
      state <= ~io_eop & (io_in_valid & _GEN_0 | state);	// @[generators/baseband/src/main/scala/modem/LRWPANPacketDetector.scala:28:22, :41:16, :42:12, :44:28, :48:19, :50:33, :51:17]
    if (io_eop | ~io_in_valid) begin	// @[generators/baseband/src/main/scala/modem/LRWPANPacketDetector.scala:29:20, :41:16, :44:28]
    end
    else if (_GEN_0)	// @[generators/baseband/src/main/scala/modem/LRWPANPacketDetector.scala:28:22, :48:19, :50:33, :51:17]
      counter <= 6'h1;	// @[generators/baseband/src/main/scala/modem/LRWPANPacketDetector.scala:29:20, :52:19]
    else	// @[generators/baseband/src/main/scala/modem/LRWPANPacketDetector.scala:28:22, :48:19, :50:33, :51:17]
      counter <= counter + 6'h1;	// @[generators/baseband/src/main/scala/modem/LRWPANPacketDetector.scala:29:20, :46:24, :52:19]
  end // always @(posedge)
  `ifdef ENABLE_INITIAL_REG_
    `ifdef FIRRTL_BEFORE_INITIAL
      `FIRRTL_BEFORE_INITIAL
    `endif // FIRRTL_BEFORE_INITIAL
    logic [31:0] _RANDOM[0:4];
    initial begin
      `ifdef INIT_RANDOM_PROLOG_
        `INIT_RANDOM_PROLOG_
      `endif // INIT_RANDOM_PROLOG_
      `ifdef RANDOMIZE_REG_INIT
        for (logic [2:0] i = 3'h0; i < 3'h5; i += 3'h1) begin
          _RANDOM[i] = `RANDOM;
        end
        rawWindow = {_RANDOM[3'h0], _RANDOM[3'h1], _RANDOM[3'h2], _RANDOM[3'h3]};	// @[generators/baseband/src/main/scala/modem/LRWPANPacketDetector.scala:21:22]
        state = _RANDOM[3'h4][0];	// @[generators/baseband/src/main/scala/modem/LRWPANPacketDetector.scala:28:22]
        counter = _RANDOM[3'h4][6:1];	// @[generators/baseband/src/main/scala/modem/LRWPANPacketDetector.scala:28:22, :29:20]
      `endif // RANDOMIZE_REG_INIT
    end // initial
    `ifdef FIRRTL_AFTER_INITIAL
      `FIRRTL_AFTER_INITIAL
    `endif // FIRRTL_AFTER_INITIAL
  `endif // ENABLE_INITIAL_REG_
  ChipToSymbolLUT symbols_0 (	// @[generators/baseband/src/main/scala/modem/LRWPANPacketDetector.scala:22:35]
    .io_chips  (rawWindow[31:0]),	// @[generators/baseband/src/main/scala/modem/LRWPANPacketDetector.scala:21:22, :23:35]
    .io_symbol (_symbols_0_io_symbol)
  );
  ChipToSymbolLUT symbols_1 (	// @[generators/baseband/src/main/scala/modem/LRWPANPacketDetector.scala:22:35]
    .io_chips  (rawWindow[63:32]),	// @[generators/baseband/src/main/scala/modem/LRWPANPacketDetector.scala:21:22, :24:35]
    .io_symbol (_symbols_1_io_symbol)
  );
  ChipToSymbolLUT symbols_2 (	// @[generators/baseband/src/main/scala/modem/LRWPANPacketDetector.scala:22:35]
    .io_chips  (rawWindow[95:64]),	// @[generators/baseband/src/main/scala/modem/LRWPANPacketDetector.scala:21:22, :25:35]
    .io_symbol (_symbols_2_io_symbol)
  );
  ChipToSymbolLUT symbols_3 (	// @[generators/baseband/src/main/scala/modem/LRWPANPacketDetector.scala:22:35]
    .io_chips  (rawWindow[127:96]),	// @[generators/baseband/src/main/scala/modem/LRWPANPacketDetector.scala:21:22, :26:35]
    .io_symbol (_symbols_3_io_symbol)
  );
  assign io_sop = ~io_eop & io_in_valid & ~state & _GEN;	// @[generators/baseband/src/main/scala/modem/LRWPANPacketDetector.scala:28:22, :38:10, :41:16, :42:12, :44:28, :48:19, :50:21]
  assign io_out_valid = ~io_eop & io_in_valid & state & counter == 6'h0;	// @[generators/baseband/src/main/scala/modem/LRWPANPacketDetector.scala:28:22, :29:20, :39:16, :41:16, :42:12, :44:28, :46:24, :58:22]
  assign io_out_bits = {_symbols_3_io_symbol, _symbols_2_io_symbol};	// @[generators/baseband/src/main/scala/modem/LRWPANPacketDetector.scala:22:35, :65:25]
endmodule

