// Generated by CIRCT unknown git version
// Standard header to adapt well known macros for register randomization.
`ifndef RANDOMIZE
  `ifdef RANDOMIZE_MEM_INIT
    `define RANDOMIZE
  `endif // RANDOMIZE_MEM_INIT
`endif // not def RANDOMIZE
`ifndef RANDOMIZE
  `ifdef RANDOMIZE_REG_INIT
    `define RANDOMIZE
  `endif // RANDOMIZE_REG_INIT
`endif // not def RANDOMIZE

// RANDOM may be set to an expression that produces a 32-bit random unsigned value.
`ifndef RANDOM
  `define RANDOM $random
`endif // not def RANDOM

// Users can define INIT_RANDOM as general code that gets injected into the
// initializer block for modules with registers.
`ifndef INIT_RANDOM
  `define INIT_RANDOM
`endif // not def INIT_RANDOM

// If using random initialization, you can also define RANDOMIZE_DELAY to
// customize the delay used, otherwise 0.002 is used.
`ifndef RANDOMIZE_DELAY
  `define RANDOMIZE_DELAY 0.002
`endif // not def RANDOMIZE_DELAY

// Define INIT_RANDOM_PROLOG_ for use in our modules below.
`ifndef INIT_RANDOM_PROLOG_
  `ifdef RANDOMIZE
    `ifdef VERILATOR
      `define INIT_RANDOM_PROLOG_ `INIT_RANDOM
    `else  // VERILATOR
      `define INIT_RANDOM_PROLOG_ `INIT_RANDOM #`RANDOMIZE_DELAY begin end
    `endif // VERILATOR
  `else  // RANDOMIZE
    `define INIT_RANDOM_PROLOG_
  `endif // RANDOMIZE
`endif // not def INIT_RANDOM_PROLOG_

// Include register initializers in init blocks unless synthesis is set
`ifndef SYNTHESIS
  `ifndef ENABLE_INITIAL_REG_
    `define ENABLE_INITIAL_REG_
  `endif // not def ENABLE_INITIAL_REG_
`endif // not def SYNTHESIS

// Include rmemory initializers in init blocks unless synthesis is set
`ifndef SYNTHESIS
  `ifndef ENABLE_INITIAL_MEM_
    `define ENABLE_INITIAL_MEM_
  `endif // not def ENABLE_INITIAL_MEM_
`endif // not def SYNTHESIS

// Standard header to adapt well known macros for prints and assertions.

// Users can define 'PRINTF_COND' to add an extra gate to prints.
`ifndef PRINTF_COND_
  `ifdef PRINTF_COND
    `define PRINTF_COND_ (`PRINTF_COND)
  `else  // PRINTF_COND
    `define PRINTF_COND_ 1
  `endif // PRINTF_COND
`endif // not def PRINTF_COND_

// Users can define 'ASSERT_VERBOSE_COND' to add an extra gate to assert error printing.
`ifndef ASSERT_VERBOSE_COND_
  `ifdef ASSERT_VERBOSE_COND
    `define ASSERT_VERBOSE_COND_ (`ASSERT_VERBOSE_COND)
  `else  // ASSERT_VERBOSE_COND
    `define ASSERT_VERBOSE_COND_ 1
  `endif // ASSERT_VERBOSE_COND
`endif // not def ASSERT_VERBOSE_COND_

// Users can define 'STOP_COND' to add an extra gate to stop conditions.
`ifndef STOP_COND_
  `ifdef STOP_COND
    `define STOP_COND_ (`STOP_COND)
  `else  // STOP_COND
    `define STOP_COND_ 1
  `endif // STOP_COND
`endif // not def STOP_COND_

module SymbolToChipSpreader(
  input  clock,
         reset,
  output io_in_data_ready,	// @[generators/baseband/src/main/scala/baseband/LRWPANLUT.scala:12:16]
  input  io_in_data_valid,	// @[generators/baseband/src/main/scala/baseband/LRWPANLUT.scala:12:16]
         io_in_data_bits,	// @[generators/baseband/src/main/scala/baseband/LRWPANLUT.scala:12:16]
         io_out_data_ready,	// @[generators/baseband/src/main/scala/baseband/LRWPANLUT.scala:12:16]
  output io_out_data_valid,	// @[generators/baseband/src/main/scala/baseband/LRWPANLUT.scala:12:16]
         io_out_data_bits	// @[generators/baseband/src/main/scala/baseband/LRWPANLUT.scala:12:16]
);

  wire [31:0] _chipLUT_io_chip;	// @[generators/baseband/src/main/scala/baseband/LRWPANLUT.scala:23:25]
  reg  [1:0]  state;	// @[generators/baseband/src/main/scala/baseband/LRWPANLUT.scala:18:24]
  reg  [3:0]  symbol;	// @[generators/baseband/src/main/scala/baseband/LRWPANLUT.scala:24:25]
  reg  [2:0]  symbolCounter;	// @[generators/baseband/src/main/scala/baseband/LRWPANLUT.scala:25:32]
  reg  [5:0]  chipCounter;	// @[generators/baseband/src/main/scala/baseband/LRWPANLUT.scala:27:30]
  wire [31:0] _io_out_data_bits_T = _chipLUT_io_chip >> chipCounter;	// @[generators/baseband/src/main/scala/baseband/LRWPANLUT.scala:23:25, :27:30, :28:40]
  reg         data_in_ready;	// @[generators/baseband/src/main/scala/baseband/LRWPANLUT.scala:30:32]
  reg         data_out_valid;	// @[generators/baseband/src/main/scala/baseband/LRWPANLUT.scala:33:33]
  wire        _GEN = io_out_data_ready & data_out_valid;	// @[generators/baseband/src/main/scala/baseband/LRWPANLUT.scala:33:33, src/main/scala/chisel3/util/Decoupled.scala:52:35]
  wire        _GEN_0 = chipCounter == 6'h1F;	// @[generators/baseband/src/main/scala/baseband/LRWPANLUT.scala:27:30, :65:30]
  wire        _GEN_1 = _GEN & _GEN_0;	// @[generators/baseband/src/main/scala/baseband/LRWPANLUT.scala:18:24, :64:34, :65:{30,40}, :66:23, src/main/scala/chisel3/util/Decoupled.scala:52:35]
  wire        _GEN_2 = state == 2'h1;	// @[generators/baseband/src/main/scala/baseband/LRWPANLUT.scala:18:24, :40:19, :47:22]
  wire        _GEN_3 = symbolCounter == 3'h3;	// @[generators/baseband/src/main/scala/baseband/LRWPANLUT.scala:25:32, :49:32]
  wire        _GEN_4 = data_in_ready & io_in_data_valid;	// @[generators/baseband/src/main/scala/baseband/LRWPANLUT.scala:30:32, src/main/scala/chisel3/util/Decoupled.scala:52:35]
  wire        _GEN_5 = _GEN_4 & _GEN_3;	// @[generators/baseband/src/main/scala/baseband/LRWPANLUT.scala:18:24, :48:33, :49:{32,41}, :51:23, src/main/scala/chisel3/util/Decoupled.scala:52:35]
  always @(posedge clock) begin
    if (reset) begin
      state <= 2'h0;	// @[generators/baseband/src/main/scala/baseband/LRWPANLUT.scala:18:24]
      symbol <= 4'h0;	// @[generators/baseband/src/main/scala/baseband/LRWPANLUT.scala:24:25]
      symbolCounter <= 3'h0;	// @[generators/baseband/src/main/scala/baseband/LRWPANLUT.scala:25:32]
      chipCounter <= 6'h0;	// @[generators/baseband/src/main/scala/baseband/LRWPANLUT.scala:27:30]
      data_in_ready <= 1'h1;	// @[generators/baseband/src/main/scala/baseband/LRWPANLUT.scala:30:32]
      data_out_valid <= 1'h0;	// @[generators/baseband/src/main/scala/baseband/LRWPANLUT.scala:33:33]
    end
    else if (state == 2'h0) begin	// @[generators/baseband/src/main/scala/baseband/LRWPANLUT.scala:18:24, :38:16]
      if (_GEN_4) begin	// @[src/main/scala/chisel3/util/Decoupled.scala:52:35]
        state <= 2'h1;	// @[generators/baseband/src/main/scala/baseband/LRWPANLUT.scala:18:24, :40:19]
        symbol <= {3'h0, io_in_data_bits};	// @[generators/baseband/src/main/scala/baseband/LRWPANLUT.scala:24:25, :25:32, :43:26]
        symbolCounter <= 3'h1;	// @[generators/baseband/src/main/scala/baseband/LRWPANLUT.scala:25:32, :44:27]
        chipCounter <= 6'h0;	// @[generators/baseband/src/main/scala/baseband/LRWPANLUT.scala:27:30]
      end
      data_in_ready <= _GEN_4 | data_in_ready;	// @[generators/baseband/src/main/scala/baseband/LRWPANLUT.scala:30:32, :39:33, :41:27, src/main/scala/chisel3/util/Decoupled.scala:52:35]
      data_out_valid <= ~_GEN_4 & data_out_valid;	// @[generators/baseband/src/main/scala/baseband/LRWPANLUT.scala:33:33, :39:33, :42:28, src/main/scala/chisel3/util/Decoupled.scala:52:35]
    end
    else begin	// @[generators/baseband/src/main/scala/baseband/LRWPANLUT.scala:38:16]
      if (_GEN_2) begin	// @[generators/baseband/src/main/scala/baseband/LRWPANLUT.scala:47:22]
        if (_GEN_5) begin	// @[generators/baseband/src/main/scala/baseband/LRWPANLUT.scala:18:24, :48:33, :49:41, :51:23]
          state <= 2'h2;	// @[generators/baseband/src/main/scala/baseband/LRWPANLUT.scala:18:24, :51:23]
          chipCounter <= 6'h0;	// @[generators/baseband/src/main/scala/baseband/LRWPANLUT.scala:27:30]
        end
        if (_GEN_4)	// @[src/main/scala/chisel3/util/Decoupled.scala:52:35]
          symbolCounter <= symbolCounter + 3'h1;	// @[generators/baseband/src/main/scala/baseband/LRWPANLUT.scala:25:32, :44:27, :61:44]
        data_in_ready <= ~_GEN_5 & data_in_ready;	// @[generators/baseband/src/main/scala/baseband/LRWPANLUT.scala:18:24, :30:32, :48:33, :49:41, :51:23, :52:31]
        data_out_valid <= _GEN_5 | data_out_valid;	// @[generators/baseband/src/main/scala/baseband/LRWPANLUT.scala:18:24, :33:33, :48:33, :49:41, :51:23, :53:32]
      end
      else begin	// @[generators/baseband/src/main/scala/baseband/LRWPANLUT.scala:47:22]
        if (_GEN_1) begin	// @[generators/baseband/src/main/scala/baseband/LRWPANLUT.scala:18:24, :64:34, :65:40, :66:23]
          state <= 2'h0;	// @[generators/baseband/src/main/scala/baseband/LRWPANLUT.scala:18:24]
          symbolCounter <= 3'h0;	// @[generators/baseband/src/main/scala/baseband/LRWPANLUT.scala:25:32]
        end
        if (_GEN) begin	// @[src/main/scala/chisel3/util/Decoupled.scala:52:35]
          if (_GEN_0)	// @[generators/baseband/src/main/scala/baseband/LRWPANLUT.scala:65:30]
            chipCounter <= 6'h0;	// @[generators/baseband/src/main/scala/baseband/LRWPANLUT.scala:27:30]
          else	// @[generators/baseband/src/main/scala/baseband/LRWPANLUT.scala:65:30]
            chipCounter <= chipCounter + 6'h1;	// @[generators/baseband/src/main/scala/baseband/LRWPANLUT.scala:27:30, :72:44]
        end
        data_in_ready <= _GEN_1 | data_in_ready;	// @[generators/baseband/src/main/scala/baseband/LRWPANLUT.scala:18:24, :30:32, :64:34, :65:40, :66:23, :67:31]
        data_out_valid <= ~_GEN_1 & data_out_valid;	// @[generators/baseband/src/main/scala/baseband/LRWPANLUT.scala:18:24, :33:33, :64:34, :65:40, :66:23, :68:32]
      end
      if (_GEN_2 & _GEN_4) begin	// @[generators/baseband/src/main/scala/baseband/LRWPANLUT.scala:24:25, :47:{22,37}, :48:33, :49:41, src/main/scala/chisel3/util/Decoupled.scala:52:35]
        if (_GEN_3)	// @[generators/baseband/src/main/scala/baseband/LRWPANLUT.scala:49:32]
          symbol <= {io_in_data_bits, symbol[2:0]};	// @[generators/baseband/src/main/scala/baseband/LRWPANLUT.scala:24:25, :50:{30,54}]
        else if (symbolCounter == 3'h2)	// @[generators/baseband/src/main/scala/baseband/LRWPANLUT.scala:25:32, :56:38]
          symbol <= {1'h0, io_in_data_bits, symbol[1:0]};	// @[generators/baseband/src/main/scala/baseband/LRWPANLUT.scala:24:25, :57:{30,64}]
        else if (symbolCounter == 3'h1)	// @[generators/baseband/src/main/scala/baseband/LRWPANLUT.scala:25:32, :44:27, :58:38]
          symbol <= {2'h0, io_in_data_bits, symbol[0]};	// @[generators/baseband/src/main/scala/baseband/LRWPANLUT.scala:18:24, :24:25, :59:{30,64}]
      end
    end
  end // always @(posedge)
  `ifdef ENABLE_INITIAL_REG_
    `ifdef FIRRTL_BEFORE_INITIAL
      `FIRRTL_BEFORE_INITIAL
    `endif // FIRRTL_BEFORE_INITIAL
    logic [31:0] _RANDOM[0:0];
    initial begin
      `ifdef INIT_RANDOM_PROLOG_
        `INIT_RANDOM_PROLOG_
      `endif // INIT_RANDOM_PROLOG_
      `ifdef RANDOMIZE_REG_INIT
        _RANDOM[/*Zero width*/ 1'b0] = `RANDOM;
        state = _RANDOM[/*Zero width*/ 1'b0][1:0];	// @[generators/baseband/src/main/scala/baseband/LRWPANLUT.scala:18:24]
        symbol = _RANDOM[/*Zero width*/ 1'b0][5:2];	// @[generators/baseband/src/main/scala/baseband/LRWPANLUT.scala:18:24, :24:25]
        symbolCounter = _RANDOM[/*Zero width*/ 1'b0][8:6];	// @[generators/baseband/src/main/scala/baseband/LRWPANLUT.scala:18:24, :25:32]
        chipCounter = _RANDOM[/*Zero width*/ 1'b0][14:9];	// @[generators/baseband/src/main/scala/baseband/LRWPANLUT.scala:18:24, :27:30]
        data_in_ready = _RANDOM[/*Zero width*/ 1'b0][15];	// @[generators/baseband/src/main/scala/baseband/LRWPANLUT.scala:18:24, :30:32]
        data_out_valid = _RANDOM[/*Zero width*/ 1'b0][16];	// @[generators/baseband/src/main/scala/baseband/LRWPANLUT.scala:18:24, :33:33]
      `endif // RANDOMIZE_REG_INIT
    end // initial
    `ifdef FIRRTL_AFTER_INITIAL
      `FIRRTL_AFTER_INITIAL
    `endif // FIRRTL_AFTER_INITIAL
  `endif // ENABLE_INITIAL_REG_
  SymbolToChipLUT chipLUT (	// @[generators/baseband/src/main/scala/baseband/LRWPANLUT.scala:23:25]
    .io_symbol (symbol),	// @[generators/baseband/src/main/scala/baseband/LRWPANLUT.scala:24:25]
    .io_chip   (_chipLUT_io_chip)
  );
  assign io_in_data_ready = data_in_ready;	// @[generators/baseband/src/main/scala/baseband/LRWPANLUT.scala:30:32]
  assign io_out_data_valid = data_out_valid;	// @[generators/baseband/src/main/scala/baseband/LRWPANLUT.scala:33:33]
  assign io_out_data_bits = _io_out_data_bits_T[0];	// @[generators/baseband/src/main/scala/baseband/LRWPANLUT.scala:28:40]
endmodule

