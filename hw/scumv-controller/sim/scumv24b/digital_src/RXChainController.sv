// Generated by CIRCT unknown git version
// Standard header to adapt well known macros for register randomization.
`ifndef RANDOMIZE
  `ifdef RANDOMIZE_MEM_INIT
    `define RANDOMIZE
  `endif // RANDOMIZE_MEM_INIT
`endif // not def RANDOMIZE
`ifndef RANDOMIZE
  `ifdef RANDOMIZE_REG_INIT
    `define RANDOMIZE
  `endif // RANDOMIZE_REG_INIT
`endif // not def RANDOMIZE

// RANDOM may be set to an expression that produces a 32-bit random unsigned value.
`ifndef RANDOM
  `define RANDOM $random
`endif // not def RANDOM

// Users can define INIT_RANDOM as general code that gets injected into the
// initializer block for modules with registers.
`ifndef INIT_RANDOM
  `define INIT_RANDOM
`endif // not def INIT_RANDOM

// If using random initialization, you can also define RANDOMIZE_DELAY to
// customize the delay used, otherwise 0.002 is used.
`ifndef RANDOMIZE_DELAY
  `define RANDOMIZE_DELAY 0.002
`endif // not def RANDOMIZE_DELAY

// Define INIT_RANDOM_PROLOG_ for use in our modules below.
`ifndef INIT_RANDOM_PROLOG_
  `ifdef RANDOMIZE
    `ifdef VERILATOR
      `define INIT_RANDOM_PROLOG_ `INIT_RANDOM
    `else  // VERILATOR
      `define INIT_RANDOM_PROLOG_ `INIT_RANDOM #`RANDOMIZE_DELAY begin end
    `endif // VERILATOR
  `else  // RANDOMIZE
    `define INIT_RANDOM_PROLOG_
  `endif // RANDOMIZE
`endif // not def INIT_RANDOM_PROLOG_

// Include register initializers in init blocks unless synthesis is set
`ifndef SYNTHESIS
  `ifndef ENABLE_INITIAL_REG_
    `define ENABLE_INITIAL_REG_
  `endif // not def ENABLE_INITIAL_REG_
`endif // not def SYNTHESIS

// Include rmemory initializers in init blocks unless synthesis is set
`ifndef SYNTHESIS
  `ifndef ENABLE_INITIAL_MEM_
    `define ENABLE_INITIAL_MEM_
  `endif // not def ENABLE_INITIAL_MEM_
`endif // not def SYNTHESIS

// Standard header to adapt well known macros for prints and assertions.

// Users can define 'PRINTF_COND' to add an extra gate to prints.
`ifndef PRINTF_COND_
  `ifdef PRINTF_COND
    `define PRINTF_COND_ (`PRINTF_COND)
  `else  // PRINTF_COND
    `define PRINTF_COND_ 1
  `endif // PRINTF_COND
`endif // not def PRINTF_COND_

// Users can define 'ASSERT_VERBOSE_COND' to add an extra gate to assert error printing.
`ifndef ASSERT_VERBOSE_COND_
  `ifdef ASSERT_VERBOSE_COND
    `define ASSERT_VERBOSE_COND_ (`ASSERT_VERBOSE_COND)
  `else  // ASSERT_VERBOSE_COND
    `define ASSERT_VERBOSE_COND_ 1
  `endif // ASSERT_VERBOSE_COND
`endif // not def ASSERT_VERBOSE_COND_

// Users can define 'STOP_COND' to add an extra gate to stop conditions.
`ifndef STOP_COND_
  `ifdef STOP_COND
    `define STOP_COND_ (`STOP_COND)
  `else  // STOP_COND
    `define STOP_COND_ 1
  `endif // STOP_COND
`endif // not def STOP_COND_

module RXChainController(
  input         clock,
                reset,
  output        io_interrupt_error,	// @[generators/baseband/src/main/scala/baseband/Controller.scala:237:14]
                io_interrupt_rxStart,	// @[generators/baseband/src/main/scala/baseband/Controller.scala:237:14]
                io_interrupt_rxFinish,	// @[generators/baseband/src/main/scala/baseband/Controller.scala:237:14]
                io_bleDisassemblerControl_in_valid,	// @[generators/baseband/src/main/scala/baseband/Controller.scala:237:14]
  output [1:0]  io_bleDisassemblerControl_in_bits_command,	// @[generators/baseband/src/main/scala/baseband/Controller.scala:237:14]
  input  [7:0]  io_bleDisassemblerControl_out_length,	// @[generators/baseband/src/main/scala/baseband/Controller.scala:237:14]
  input         io_bleDisassemblerControl_out_flag_crc,	// @[generators/baseband/src/main/scala/baseband/Controller.scala:237:14]
                io_bleDisassemblerControl_out_done,	// @[generators/baseband/src/main/scala/baseband/Controller.scala:237:14]
                io_bleDisassemblerControl_out_busy,	// @[generators/baseband/src/main/scala/baseband/Controller.scala:237:14]
  output        io_lrwpanDisassemblerControl_in_valid,	// @[generators/baseband/src/main/scala/baseband/Controller.scala:237:14]
  output [1:0]  io_lrwpanDisassemblerControl_in_bits_command,	// @[generators/baseband/src/main/scala/baseband/Controller.scala:237:14]
  input  [7:0]  io_lrwpanDisassemblerControl_out_length,	// @[generators/baseband/src/main/scala/baseband/Controller.scala:237:14]
  input         io_lrwpanDisassemblerControl_out_flag_crc,	// @[generators/baseband/src/main/scala/baseband/Controller.scala:237:14]
                io_lrwpanDisassemblerControl_out_done,	// @[generators/baseband/src/main/scala/baseband/Controller.scala:237:14]
                io_lrwpanDisassemblerControl_out_busy,	// @[generators/baseband/src/main/scala/baseband/Controller.scala:237:14]
                io_constants_radioMode,	// @[generators/baseband/src/main/scala/baseband/Controller.scala:237:14]
  output        io_control_cmd_ready,	// @[generators/baseband/src/main/scala/baseband/Controller.scala:237:14]
  input         io_control_cmd_valid,	// @[generators/baseband/src/main/scala/baseband/Controller.scala:237:14]
  input  [1:0]  io_control_cmd_bits_command,	// @[generators/baseband/src/main/scala/baseband/Controller.scala:237:14]
  input  [31:0] io_control_cmd_bits_addr,	// @[generators/baseband/src/main/scala/baseband/Controller.scala:237:14]
  output        io_control_baseAddr_valid,	// @[generators/baseband/src/main/scala/baseband/Controller.scala:237:14]
  output [31:0] io_control_baseAddr_bits,	// @[generators/baseband/src/main/scala/baseband/Controller.scala:237:14]
  output        io_control_done,	// @[generators/baseband/src/main/scala/baseband/Controller.scala:237:14]
  input         io_messages_rxErrorMessage_ready,	// @[generators/baseband/src/main/scala/baseband/Controller.scala:237:14]
  output        io_messages_rxErrorMessage_valid,	// @[generators/baseband/src/main/scala/baseband/Controller.scala:237:14]
  output [31:0] io_messages_rxErrorMessage_bits,	// @[generators/baseband/src/main/scala/baseband/Controller.scala:237:14]
  input         io_messages_rxFinishMessage_ready,	// @[generators/baseband/src/main/scala/baseband/Controller.scala:237:14]
  output        io_messages_rxFinishMessage_valid,	// @[generators/baseband/src/main/scala/baseband/Controller.scala:237:14]
  output [31:0] io_messages_rxFinishMessage_bits,	// @[generators/baseband/src/main/scala/baseband/Controller.scala:237:14]
  output [2:0]  io_state	// @[generators/baseband/src/main/scala/baseband/Controller.scala:237:14]
);

  reg  [1:0]  state;	// @[generators/baseband/src/main/scala/baseband/Controller.scala:255:22]
  reg         done;	// @[generators/baseband/src/main/scala/baseband/Controller.scala:257:21]
  reg  [1:0]  cmd_command;	// @[generators/baseband/src/main/scala/baseband/Controller.scala:258:16]
  reg  [31:0] cmd_addr;	// @[generators/baseband/src/main/scala/baseband/Controller.scala:258:16]
  reg         baseAddrValid;	// @[generators/baseband/src/main/scala/baseband/Controller.scala:260:30]
  reg         disassemblerReqValid;	// @[generators/baseband/src/main/scala/baseband/Controller.scala:262:37]
  reg         disassemblerBusy;	// @[generators/baseband/src/main/scala/baseband/Controller.scala:263:33]
  reg         error;	// @[generators/baseband/src/main/scala/baseband/Controller.scala:267:22]
  reg         rxStart;	// @[generators/baseband/src/main/scala/baseband/Controller.scala:268:24]
  reg         rxFinish;	// @[generators/baseband/src/main/scala/baseband/Controller.scala:269:25]
  reg         errorMessageValid;	// @[generators/baseband/src/main/scala/baseband/Controller.scala:271:34]
  reg  [31:0] errorMessageBits;	// @[generators/baseband/src/main/scala/baseband/Controller.scala:272:33]
  reg         rxFinishMessageValid;	// @[generators/baseband/src/main/scala/baseband/Controller.scala:274:37]
  reg  [31:0] rxFinishMessageBits;	// @[generators/baseband/src/main/scala/baseband/Controller.scala:275:36]
  wire        io_control_cmd_ready_0 = ~(|state) | state == 2'h1;	// @[generators/baseband/src/main/scala/baseband/Controller.scala:255:22, :293:{33,44,52}]
  wire        io_bleDisassemblerControl_in_valid_0 = ~io_constants_radioMode & disassemblerReqValid;	// @[generators/baseband/src/main/scala/baseband/Controller.scala:262:37, :299:{44,68}]
  wire        io_lrwpanDisassemblerControl_in_valid_0 = io_constants_radioMode & disassemblerReqValid;	// @[generators/baseband/src/main/scala/baseband/Controller.scala:262:37, :303:47]
  wire        flag_crc = io_constants_radioMode ? io_lrwpanDisassemblerControl_out_flag_crc : io_bleDisassemblerControl_out_flag_crc;	// @[generators/baseband/src/main/scala/baseband/Controller.scala:342:21]
  wire        ioDisassemblerDone = io_constants_radioMode ? io_lrwpanDisassemblerControl_out_done : io_bleDisassemblerControl_out_done;	// @[generators/baseband/src/main/scala/baseband/Controller.scala:344:31]
  wire        _GEN = ~disassemblerBusy & (io_bleDisassemblerControl_out_busy & ~io_constants_radioMode | io_lrwpanDisassemblerControl_out_busy & io_constants_radioMode);	// @[generators/baseband/src/main/scala/baseband/Controller.scala:263:33, :299:68, :328:17, :385:{14,33}, :386:52, :387:{13,54,102}, :389:21]
  wire        _GEN_0 = io_messages_rxFinishMessage_ready & rxFinishMessageValid;	// @[generators/baseband/src/main/scala/baseband/Controller.scala:274:37, src/main/scala/chisel3/util/Decoupled.scala:52:35]
  wire        _GEN_1 = (&state) & _GEN_0;	// @[generators/baseband/src/main/scala/baseband/Controller.scala:255:22, :332:18, :348:17, :417:46, :419:18, src/main/scala/chisel3/util/Decoupled.scala:52:35]
  wire        _GEN_2 = state == 2'h2 & io_messages_rxErrorMessage_ready & errorMessageValid;	// @[generators/baseband/src/main/scala/baseband/Controller.scala:255:22, :271:34, :324:15, :348:17, :426:45, :428:15]
  wire        _GEN_3 = ioDisassemblerDone & flag_crc;	// @[generators/baseband/src/main/scala/baseband/Controller.scala:271:34, :342:21, :344:31, :395:31, :399:39, :400:29]
  wire        _GEN_4 = io_control_cmd_ready_0 & io_control_cmd_valid;	// @[generators/baseband/src/main/scala/baseband/Controller.scala:293:44, src/main/scala/chisel3/util/Decoupled.scala:52:35]
  wire        _GEN_5 = _GEN_4 & (io_control_cmd_bits_command == 2'h0 | io_control_cmd_bits_command == 2'h1);	// @[generators/baseband/src/main/scala/baseband/Controller.scala:353:{32,63,101}, :354:65, src/main/scala/chisel3/util/Decoupled.scala:52:35]
  wire        _GEN_6 = io_control_cmd_bits_addr[1:0] == 2'h0;	// @[generators/baseband/src/main/scala/baseband/Controller.scala:355:{38,44}]
  wire        _GEN_7 = _GEN_5 & _GEN_6;	// @[generators/baseband/src/main/scala/baseband/Controller.scala:258:16, :353:32, :354:105, :355:{44,53}, :356:15]
  wire        _GEN_8 = state == 2'h1;	// @[generators/baseband/src/main/scala/baseband/Controller.scala:255:22, :348:17]
  wire        _GEN_9 = _GEN_4 & io_control_cmd_bits_command == 2'h2;	// @[generators/baseband/src/main/scala/baseband/Controller.scala:368:{32,63}, src/main/scala/chisel3/util/Decoupled.scala:52:35]
  wire        _GEN_10 = ~(|state) | _GEN_8;	// @[generators/baseband/src/main/scala/baseband/Controller.scala:255:22, :293:33, :332:18, :348:17]
  always @(posedge clock) begin
    if (reset) begin
      state <= 2'h0;	// @[generators/baseband/src/main/scala/baseband/Controller.scala:255:22]
      done <= 1'h0;	// @[generators/baseband/src/main/scala/baseband/Controller.scala:237:14, :257:21, :341:24]
      baseAddrValid <= 1'h0;	// @[generators/baseband/src/main/scala/baseband/Controller.scala:237:14, :260:30, :341:24]
      disassemblerReqValid <= 1'h0;	// @[generators/baseband/src/main/scala/baseband/Controller.scala:237:14, :262:37, :341:24]
      disassemblerBusy <= 1'h0;	// @[generators/baseband/src/main/scala/baseband/Controller.scala:237:14, :263:33, :341:24]
      error <= 1'h0;	// @[generators/baseband/src/main/scala/baseband/Controller.scala:237:14, :267:22, :341:24]
      rxStart <= 1'h0;	// @[generators/baseband/src/main/scala/baseband/Controller.scala:237:14, :268:24, :341:24]
      rxFinish <= 1'h0;	// @[generators/baseband/src/main/scala/baseband/Controller.scala:237:14, :269:25, :341:24]
      errorMessageValid <= 1'h0;	// @[generators/baseband/src/main/scala/baseband/Controller.scala:237:14, :271:34, :341:24]
      errorMessageBits <= 32'h0;	// @[generators/baseband/src/main/scala/baseband/Controller.scala:272:33]
      rxFinishMessageValid <= 1'h0;	// @[generators/baseband/src/main/scala/baseband/Controller.scala:237:14, :274:37, :341:24]
      rxFinishMessageBits <= 32'h0;	// @[generators/baseband/src/main/scala/baseband/Controller.scala:272:33, :275:36]
    end
    else begin
      if (|state) begin	// @[generators/baseband/src/main/scala/baseband/Controller.scala:255:22, :293:33]
        if (_GEN_8) begin	// @[generators/baseband/src/main/scala/baseband/Controller.scala:348:17]
          if (ioDisassemblerDone)	// @[generators/baseband/src/main/scala/baseband/Controller.scala:344:31]
            state <= {1'h1, ~flag_crc};	// @[generators/baseband/src/main/scala/baseband/Controller.scala:255:22, :274:37, :303:71, :342:21, :399:39, :408:17, :410:32, :412:17]
          disassemblerBusy <= ~ioDisassemblerDone & (~_GEN_9 & _GEN | disassemblerBusy);	// @[generators/baseband/src/main/scala/baseband/Controller.scala:263:33, :328:17, :344:31, :368:{32,102}, :385:33, :387:102, :389:21, :395:31, :397:26]
          errorMessageValid <= _GEN_3 | errorMessageValid;	// @[generators/baseband/src/main/scala/baseband/Controller.scala:271:34, :395:31, :399:39, :400:29]
          rxFinishMessageValid <= ioDisassemblerDone & ~flag_crc | rxFinishMessageValid;	// @[generators/baseband/src/main/scala/baseband/Controller.scala:274:37, :342:21, :344:31, :395:31, :399:39, :410:32]
        end
        else begin	// @[generators/baseband/src/main/scala/baseband/Controller.scala:348:17]
          if ((&state) ? _GEN_0 : _GEN_2)	// @[generators/baseband/src/main/scala/baseband/Controller.scala:255:22, :286:11, :324:15, :348:17, :417:46, :426:45, :428:15, src/main/scala/chisel3/util/Decoupled.scala:52:35]
            state <= 2'h0;	// @[generators/baseband/src/main/scala/baseband/Controller.scala:255:22]
          if (&state)	// @[generators/baseband/src/main/scala/baseband/Controller.scala:255:22, :348:17]
            disassemblerBusy <= ~_GEN_0 & disassemblerBusy;	// @[generators/baseband/src/main/scala/baseband/Controller.scala:263:33, :283:22, :417:46, src/main/scala/chisel3/util/Decoupled.scala:52:35]
          else	// @[generators/baseband/src/main/scala/baseband/Controller.scala:348:17]
            disassemblerBusy <= ~_GEN_2 & disassemblerBusy;	// @[generators/baseband/src/main/scala/baseband/Controller.scala:263:33, :271:34, :283:22, :324:15, :348:17, :426:45, :428:15, :430:27]
          errorMessageValid <= ((&state) | ~_GEN_2) & errorMessageValid;	// @[generators/baseband/src/main/scala/baseband/Controller.scala:255:22, :271:34, :324:15, :348:17, :426:45, :428:15, :430:27]
          rxFinishMessageValid <= ~_GEN_1 & rxFinishMessageValid;	// @[generators/baseband/src/main/scala/baseband/Controller.scala:274:37, :332:18, :348:17, :417:46, :419:18, :421:30]
        end
        baseAddrValid <= (~_GEN_8 | _GEN_9) & baseAddrValid;	// @[generators/baseband/src/main/scala/baseband/Controller.scala:260:30, :348:17, :368:{32,102}]
        if (_GEN_8 & _GEN_3)	// @[generators/baseband/src/main/scala/baseband/Controller.scala:271:34, :272:33, :348:17, :395:31, :399:39, :400:29, :401:41]
          errorMessageBits <= 32'h22;	// @[generators/baseband/src/main/scala/baseband/Controller.scala:272:33, :401:41, :402:30, :403:35]
      end
      else begin	// @[generators/baseband/src/main/scala/baseband/Controller.scala:293:33]
        if (_GEN_5)	// @[generators/baseband/src/main/scala/baseband/Controller.scala:353:32]
          state <= _GEN_6 ? 2'h1 : 2'h2;	// @[generators/baseband/src/main/scala/baseband/Controller.scala:255:22, :355:{44,53}, :359:17, :363:17]
        baseAddrValid <= _GEN_7 | baseAddrValid;	// @[generators/baseband/src/main/scala/baseband/Controller.scala:258:16, :260:30, :354:105, :355:53, :356:15, :357:25]
        errorMessageValid <= _GEN_5 & ~_GEN_6 | errorMessageValid;	// @[generators/baseband/src/main/scala/baseband/Controller.scala:271:34, :353:32, :354:105, :355:{44,53}, :361:29]
        if (~_GEN_5 | _GEN_6) begin	// @[generators/baseband/src/main/scala/baseband/Controller.scala:272:33, :353:32, :354:105, :355:{44,53}]
        end
        else	// @[generators/baseband/src/main/scala/baseband/Controller.scala:272:33, :354:105, :355:53]
          errorMessageBits <= 32'h20;	// @[generators/baseband/src/main/scala/baseband/BasebandISA.scala:68:8, generators/baseband/src/main/scala/baseband/Controller.scala:272:33]
      end
      done <= ~_GEN_10 & ((&state) ? _GEN_0 : _GEN_2);	// @[generators/baseband/src/main/scala/baseband/Controller.scala:255:22, :257:21, :324:15, :332:18, :336:14, :348:17, :417:46, :426:45, :428:15, src/main/scala/chisel3/util/Decoupled.scala:52:35]
      disassemblerReqValid <= (|state) & (_GEN_8 ? _GEN_9 | ~(io_constants_radioMode ? io_lrwpanDisassemblerControl_in_valid_0 : io_bleDisassemblerControl_in_valid_0) & (baseAddrValid | disassemblerReqValid) : (&state) ? ~_GEN_0 & disassemblerReqValid : ~_GEN_2 & disassemblerReqValid);	// @[generators/baseband/src/main/scala/baseband/Controller.scala:255:22, :260:30, :262:37, :263:33, :271:34, :283:22, :284:26, :293:33, :299:44, :303:47, :324:15, :343:37, :348:17, :350:28, :368:{32,102}, :370:30, :372:40, :375:32, :381:40, :382:32, :417:46, :426:45, :428:15, :430:27, src/main/scala/chisel3/util/Decoupled.scala:52:35]
      error <= ~(~(|state) | _GEN_8 | (&state)) & _GEN_2;	// @[generators/baseband/src/main/scala/baseband/Controller.scala:255:22, :267:22, :293:33, :324:15, :348:17, :426:45, :428:15]
      rxStart <= (|state) & _GEN_8 & ~_GEN_9 & _GEN;	// @[generators/baseband/src/main/scala/baseband/Controller.scala:255:22, :268:24, :293:33, :328:17, :348:17, :368:{32,102}, :385:33, :387:102, :389:21]
      rxFinish <= ~_GEN_10 & _GEN_1;	// @[generators/baseband/src/main/scala/baseband/Controller.scala:269:25, :332:18, :348:17, :417:46, :419:18]
      if (~(|state) | ~(_GEN_8 & ioDisassemblerDone) | flag_crc) begin	// @[generators/baseband/src/main/scala/baseband/Controller.scala:255:22, :275:36, :293:33, :342:21, :344:31, :348:17, :395:31, :399:39]
      end
      else	// @[generators/baseband/src/main/scala/baseband/Controller.scala:275:36, :348:17]
        rxFinishMessageBits <= {24'h0, io_constants_radioMode ? io_lrwpanDisassemblerControl_out_length : io_bleDisassemblerControl_out_length};	// @[generators/baseband/src/main/scala/baseband/BasebandISA.scala:76:22, generators/baseband/src/main/scala/baseband/Controller.scala:275:36, :345:33]
    end
    if ((|state) ? _GEN_8 & _GEN_9 : _GEN_7) begin	// @[generators/baseband/src/main/scala/baseband/Controller.scala:255:22, :258:16, :293:33, :348:17, :354:105, :355:53, :356:15, :368:{32,102}, :369:13]
      cmd_command <= io_control_cmd_bits_command;	// @[generators/baseband/src/main/scala/baseband/Controller.scala:258:16]
      cmd_addr <= io_control_cmd_bits_addr;	// @[generators/baseband/src/main/scala/baseband/Controller.scala:258:16]
    end
  end // always @(posedge)
  `ifdef ENABLE_INITIAL_REG_
    `ifdef FIRRTL_BEFORE_INITIAL
      `FIRRTL_BEFORE_INITIAL
    `endif // FIRRTL_BEFORE_INITIAL
    logic [31:0] _RANDOM[0:3];
    initial begin
      `ifdef INIT_RANDOM_PROLOG_
        `INIT_RANDOM_PROLOG_
      `endif // INIT_RANDOM_PROLOG_
      `ifdef RANDOMIZE_REG_INIT
        for (logic [2:0] i = 3'h0; i < 3'h4; i += 3'h1) begin
          _RANDOM[i[1:0]] = `RANDOM;
        end
        state = _RANDOM[2'h0][1:0];	// @[generators/baseband/src/main/scala/baseband/Controller.scala:255:22]
        done = _RANDOM[2'h0][2];	// @[generators/baseband/src/main/scala/baseband/Controller.scala:255:22, :257:21]
        cmd_command = _RANDOM[2'h0][4:3];	// @[generators/baseband/src/main/scala/baseband/Controller.scala:255:22, :258:16]
        cmd_addr = {_RANDOM[2'h0][31:5], _RANDOM[2'h1][4:0]};	// @[generators/baseband/src/main/scala/baseband/Controller.scala:255:22, :258:16]
        baseAddrValid = _RANDOM[2'h1][5];	// @[generators/baseband/src/main/scala/baseband/Controller.scala:258:16, :260:30]
        disassemblerReqValid = _RANDOM[2'h1][6];	// @[generators/baseband/src/main/scala/baseband/Controller.scala:258:16, :262:37]
        disassemblerBusy = _RANDOM[2'h1][7];	// @[generators/baseband/src/main/scala/baseband/Controller.scala:258:16, :263:33]
        error = _RANDOM[2'h1][9];	// @[generators/baseband/src/main/scala/baseband/Controller.scala:258:16, :267:22]
        rxStart = _RANDOM[2'h1][10];	// @[generators/baseband/src/main/scala/baseband/Controller.scala:258:16, :268:24]
        rxFinish = _RANDOM[2'h1][11];	// @[generators/baseband/src/main/scala/baseband/Controller.scala:258:16, :269:25]
        errorMessageValid = _RANDOM[2'h1][12];	// @[generators/baseband/src/main/scala/baseband/Controller.scala:258:16, :271:34]
        errorMessageBits = {_RANDOM[2'h1][31:13], _RANDOM[2'h2][12:0]};	// @[generators/baseband/src/main/scala/baseband/Controller.scala:258:16, :272:33]
        rxFinishMessageValid = _RANDOM[2'h2][13];	// @[generators/baseband/src/main/scala/baseband/Controller.scala:272:33, :274:37]
        rxFinishMessageBits = {_RANDOM[2'h2][31:14], _RANDOM[2'h3][13:0]};	// @[generators/baseband/src/main/scala/baseband/Controller.scala:272:33, :275:36]
      `endif // RANDOMIZE_REG_INIT
    end // initial
    `ifdef FIRRTL_AFTER_INITIAL
      `FIRRTL_AFTER_INITIAL
    `endif // FIRRTL_AFTER_INITIAL
  `endif // ENABLE_INITIAL_REG_
  assign io_interrupt_error = error;	// @[generators/baseband/src/main/scala/baseband/Controller.scala:267:22]
  assign io_interrupt_rxStart = rxStart;	// @[generators/baseband/src/main/scala/baseband/Controller.scala:268:24]
  assign io_interrupt_rxFinish = rxFinish;	// @[generators/baseband/src/main/scala/baseband/Controller.scala:269:25]
  assign io_bleDisassemblerControl_in_valid = io_bleDisassemblerControl_in_valid_0;	// @[generators/baseband/src/main/scala/baseband/Controller.scala:299:44]
  assign io_bleDisassemblerControl_in_bits_command = cmd_command;	// @[generators/baseband/src/main/scala/baseband/Controller.scala:258:16]
  assign io_lrwpanDisassemblerControl_in_valid = io_lrwpanDisassemblerControl_in_valid_0;	// @[generators/baseband/src/main/scala/baseband/Controller.scala:303:47]
  assign io_lrwpanDisassemblerControl_in_bits_command = cmd_command;	// @[generators/baseband/src/main/scala/baseband/Controller.scala:258:16]
  assign io_control_cmd_ready = io_control_cmd_ready_0;	// @[generators/baseband/src/main/scala/baseband/Controller.scala:293:44]
  assign io_control_baseAddr_valid = baseAddrValid;	// @[generators/baseband/src/main/scala/baseband/Controller.scala:260:30]
  assign io_control_baseAddr_bits = cmd_addr;	// @[generators/baseband/src/main/scala/baseband/Controller.scala:258:16]
  assign io_control_done = done;	// @[generators/baseband/src/main/scala/baseband/Controller.scala:257:21]
  assign io_messages_rxErrorMessage_valid = errorMessageValid;	// @[generators/baseband/src/main/scala/baseband/Controller.scala:271:34]
  assign io_messages_rxErrorMessage_bits = errorMessageBits;	// @[generators/baseband/src/main/scala/baseband/Controller.scala:272:33]
  assign io_messages_rxFinishMessage_valid = rxFinishMessageValid;	// @[generators/baseband/src/main/scala/baseband/Controller.scala:274:37]
  assign io_messages_rxFinishMessage_bits = rxFinishMessageBits;	// @[generators/baseband/src/main/scala/baseband/Controller.scala:275:36]
  assign io_state = {1'h0, state};	// @[generators/baseband/src/main/scala/baseband/Controller.scala:237:14, :255:22, :290:12, :341:24]
endmodule

