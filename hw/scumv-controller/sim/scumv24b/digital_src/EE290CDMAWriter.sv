// Generated by CIRCT unknown git version
// Standard header to adapt well known macros for register randomization.
`ifndef RANDOMIZE
  `ifdef RANDOMIZE_MEM_INIT
    `define RANDOMIZE
  `endif // RANDOMIZE_MEM_INIT
`endif // not def RANDOMIZE
`ifndef RANDOMIZE
  `ifdef RANDOMIZE_REG_INIT
    `define RANDOMIZE
  `endif // RANDOMIZE_REG_INIT
`endif // not def RANDOMIZE

// RANDOM may be set to an expression that produces a 32-bit random unsigned value.
`ifndef RANDOM
  `define RANDOM $random
`endif // not def RANDOM

// Users can define INIT_RANDOM as general code that gets injected into the
// initializer block for modules with registers.
`ifndef INIT_RANDOM
  `define INIT_RANDOM
`endif // not def INIT_RANDOM

// If using random initialization, you can also define RANDOMIZE_DELAY to
// customize the delay used, otherwise 0.002 is used.
`ifndef RANDOMIZE_DELAY
  `define RANDOMIZE_DELAY 0.002
`endif // not def RANDOMIZE_DELAY

// Define INIT_RANDOM_PROLOG_ for use in our modules below.
`ifndef INIT_RANDOM_PROLOG_
  `ifdef RANDOMIZE
    `ifdef VERILATOR
      `define INIT_RANDOM_PROLOG_ `INIT_RANDOM
    `else  // VERILATOR
      `define INIT_RANDOM_PROLOG_ `INIT_RANDOM #`RANDOMIZE_DELAY begin end
    `endif // VERILATOR
  `else  // RANDOMIZE
    `define INIT_RANDOM_PROLOG_
  `endif // RANDOMIZE
`endif // not def INIT_RANDOM_PROLOG_

// Include register initializers in init blocks unless synthesis is set
`ifndef SYNTHESIS
  `ifndef ENABLE_INITIAL_REG_
    `define ENABLE_INITIAL_REG_
  `endif // not def ENABLE_INITIAL_REG_
`endif // not def SYNTHESIS

// Include rmemory initializers in init blocks unless synthesis is set
`ifndef SYNTHESIS
  `ifndef ENABLE_INITIAL_MEM_
    `define ENABLE_INITIAL_MEM_
  `endif // not def ENABLE_INITIAL_MEM_
`endif // not def SYNTHESIS

// Standard header to adapt well known macros for prints and assertions.

// Users can define 'PRINTF_COND' to add an extra gate to prints.
`ifndef PRINTF_COND_
  `ifdef PRINTF_COND
    `define PRINTF_COND_ (`PRINTF_COND)
  `else  // PRINTF_COND
    `define PRINTF_COND_ 1
  `endif // PRINTF_COND
`endif // not def PRINTF_COND_

// Users can define 'ASSERT_VERBOSE_COND' to add an extra gate to assert error printing.
`ifndef ASSERT_VERBOSE_COND_
  `ifdef ASSERT_VERBOSE_COND
    `define ASSERT_VERBOSE_COND_ (`ASSERT_VERBOSE_COND)
  `else  // ASSERT_VERBOSE_COND
    `define ASSERT_VERBOSE_COND_ 1
  `endif // ASSERT_VERBOSE_COND
`endif // not def ASSERT_VERBOSE_COND_

// Users can define 'STOP_COND' to add an extra gate to stop conditions.
`ifndef STOP_COND_
  `ifdef STOP_COND
    `define STOP_COND_ (`STOP_COND)
  `else  // STOP_COND
    `define STOP_COND_ 1
  `endif // STOP_COND
`endif // not def STOP_COND_

module EE290CDMAWriter(
  input         clock,
                reset,
                auto_out_a_ready,	// @[generators/rocket-chip/src/main/scala/diplomacy/LazyModule.scala:366:18]
  output        auto_out_a_valid,	// @[generators/rocket-chip/src/main/scala/diplomacy/LazyModule.scala:366:18]
  output [2:0]  auto_out_a_bits_opcode,	// @[generators/rocket-chip/src/main/scala/diplomacy/LazyModule.scala:366:18]
  output [31:0] auto_out_a_bits_address,	// @[generators/rocket-chip/src/main/scala/diplomacy/LazyModule.scala:366:18]
  output [3:0]  auto_out_a_bits_mask,	// @[generators/rocket-chip/src/main/scala/diplomacy/LazyModule.scala:366:18]
  output [31:0] auto_out_a_bits_data,	// @[generators/rocket-chip/src/main/scala/diplomacy/LazyModule.scala:366:18]
  input         auto_out_d_valid,	// @[generators/rocket-chip/src/main/scala/diplomacy/LazyModule.scala:366:18]
  output        io_req_ready,	// @[generators/dma/src/main/scala/dma/DMA.scala:161:16]
  input         io_req_valid,	// @[generators/dma/src/main/scala/dma/DMA.scala:161:16]
  input  [31:0] io_req_bits_addr,	// @[generators/dma/src/main/scala/dma/DMA.scala:161:16]
                io_req_bits_data,	// @[generators/dma/src/main/scala/dma/DMA.scala:161:16]
  input  [2:0]  io_req_bits_totalBytes	// @[generators/dma/src/main/scala/dma/DMA.scala:161:16]
);

  wire [3:0][2:0] _GEN = '{3'h7, 3'h3, 3'h1, 3'h0};	// @[generators/dma/src/main/scala/dma/DMA.scala:190:31]
  reg  [31:0]     req_addr;	// @[generators/dma/src/main/scala/dma/DMA.scala:166:18]
  reg  [31:0]     req_data;	// @[generators/dma/src/main/scala/dma/DMA.scala:166:18]
  reg  [2:0]      req_totalBytes;	// @[generators/dma/src/main/scala/dma/DMA.scala:166:18]
  reg  [1:0]      state;	// @[generators/dma/src/main/scala/dma/DMA.scala:169:24]
  reg  [2:0]      bytesSent;	// @[generators/dma/src/main/scala/dma/DMA.scala:173:24]
  wire [2:0]      _bytesLeft_T = req_totalBytes - bytesSent;	// @[generators/dma/src/main/scala/dma/DMA.scala:166:18, :173:24, :174:36]
  wire [94:0]     _putPartial_T = {63'h0, req_data} << {90'h0, req_addr[1:0], 3'h0};	// @[generators/dma/src/main/scala/dma/DMA.scala:166:18, :171:23, :183:31, :189:24]
  wire [65:0]     _putPartial_T_2 = {63'h0, _GEN[_bytesLeft_T[1:0]]} << req_addr[1:0];	// @[generators/dma/src/main/scala/dma/DMA.scala:166:18, :174:36, :183:31, :189:24, :190:31]
  wire            nodeOut_a_valid = state == 2'h1;	// @[generators/dma/src/main/scala/dma/DMA.scala:169:24, :192:26]
  wire            io_req_ready_0 = state == 2'h0 | (&state);	// @[generators/dma/src/main/scala/dma/DMA.scala:169:24, :209:{27,38,46}]
  wire            done = auto_out_a_ready & nodeOut_a_valid;	// @[generators/dma/src/main/scala/dma/DMA.scala:192:26, src/main/scala/chisel3/util/Decoupled.scala:52:35]
  wire            _GEN_0 = io_req_ready_0 & io_req_valid;	// @[generators/dma/src/main/scala/dma/DMA.scala:209:38, src/main/scala/chisel3/util/Decoupled.scala:52:35]
  always @(posedge clock) begin
    if (_GEN_0) begin	// @[src/main/scala/chisel3/util/Decoupled.scala:52:35]
      req_addr <= io_req_bits_addr;	// @[generators/dma/src/main/scala/dma/DMA.scala:166:18]
      req_data <= io_req_bits_data;	// @[generators/dma/src/main/scala/dma/DMA.scala:166:18]
      req_totalBytes <= io_req_bits_totalBytes;	// @[generators/dma/src/main/scala/dma/DMA.scala:166:18]
      bytesSent <= 3'h0;	// @[generators/dma/src/main/scala/dma/DMA.scala:171:23, :173:24]
    end
    else if (done) begin	// @[src/main/scala/chisel3/util/Decoupled.scala:52:35]
      req_addr <= req_addr + 32'h4;	// @[generators/dma/src/main/scala/dma/DMA.scala:166:18, :200:28]
      bytesSent <= bytesSent + (_bytesLeft_T[2] ? 3'h4 : _bytesLeft_T);	// @[generators/dma/src/main/scala/dma/DMA.scala:173:24, :174:36, :193:33, :201:{30,35}]
    end
    if (reset)
      state <= 2'h0;	// @[generators/dma/src/main/scala/dma/DMA.scala:169:24]
    else if (_GEN_0)	// @[src/main/scala/chisel3/util/Decoupled.scala:52:35]
      state <= 2'h1;	// @[generators/dma/src/main/scala/dma/DMA.scala:169:24]
    else if (auto_out_d_valid)	// @[generators/rocket-chip/src/main/scala/diplomacy/LazyModule.scala:366:18]
      state <= {_bytesLeft_T == 3'h0, 1'h1};	// @[generators/dma/src/main/scala/dma/DMA.scala:169:24, :171:23, :174:36, :206:{19,30}]
    else if (done)	// @[src/main/scala/chisel3/util/Decoupled.scala:52:35]
      state <= 2'h2;	// @[generators/dma/src/main/scala/dma/DMA.scala:169:24]
  end // always @(posedge)
  `ifdef ENABLE_INITIAL_REG_
    `ifdef FIRRTL_BEFORE_INITIAL
      `FIRRTL_BEFORE_INITIAL
    `endif // FIRRTL_BEFORE_INITIAL
    logic [31:0] _RANDOM[0:2];
    initial begin
      `ifdef INIT_RANDOM_PROLOG_
        `INIT_RANDOM_PROLOG_
      `endif // INIT_RANDOM_PROLOG_
      `ifdef RANDOMIZE_REG_INIT
        for (logic [1:0] i = 2'h0; i < 2'h3; i += 2'h1) begin
          _RANDOM[i] = `RANDOM;
        end
        req_addr = _RANDOM[2'h0];	// @[generators/dma/src/main/scala/dma/DMA.scala:166:18]
        req_data = _RANDOM[2'h1];	// @[generators/dma/src/main/scala/dma/DMA.scala:166:18]
        req_totalBytes = _RANDOM[2'h2][2:0];	// @[generators/dma/src/main/scala/dma/DMA.scala:166:18]
        state = _RANDOM[2'h2][4:3];	// @[generators/dma/src/main/scala/dma/DMA.scala:166:18, :169:24]
        bytesSent = _RANDOM[2'h2][7:5];	// @[generators/dma/src/main/scala/dma/DMA.scala:166:18, :173:24]
      `endif // RANDOMIZE_REG_INIT
    end // initial
    `ifdef FIRRTL_AFTER_INITIAL
      `FIRRTL_AFTER_INITIAL
    `endif // FIRRTL_AFTER_INITIAL
  `endif // ENABLE_INITIAL_REG_
  assign auto_out_a_valid = nodeOut_a_valid;	// @[generators/dma/src/main/scala/dma/DMA.scala:192:26]
  assign auto_out_a_bits_opcode = {2'h0, ~(_bytesLeft_T[2])};	// @[generators/dma/src/main/scala/dma/DMA.scala:174:36, :193:{22,33}]
  assign auto_out_a_bits_address = req_addr;	// @[generators/dma/src/main/scala/dma/DMA.scala:166:18]
  assign auto_out_a_bits_mask = _bytesLeft_T[2] ? 4'hF : _putPartial_T_2[3:0];	// @[generators/dma/src/main/scala/dma/DMA.scala:174:36, :190:31, :193:{22,33}, generators/rocket-chip/src/main/scala/tilelink/Edges.scala:508:15, generators/rocket-chip/src/main/scala/util/Misc.scala:222:10]
  assign auto_out_a_bits_data = _bytesLeft_T[2] ? req_data : _putPartial_T[31:0];	// @[generators/dma/src/main/scala/dma/DMA.scala:166:18, :174:36, :189:24, :193:{22,33}, generators/rocket-chip/src/main/scala/tilelink/Edges.scala:509:15]
  assign io_req_ready = io_req_ready_0;	// @[generators/dma/src/main/scala/dma/DMA.scala:209:38]
endmodule

