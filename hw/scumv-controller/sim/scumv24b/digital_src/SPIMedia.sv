// Generated by CIRCT unknown git version
// Standard header to adapt well known macros for register randomization.
`ifndef RANDOMIZE
  `ifdef RANDOMIZE_MEM_INIT
    `define RANDOMIZE
  `endif // RANDOMIZE_MEM_INIT
`endif // not def RANDOMIZE
`ifndef RANDOMIZE
  `ifdef RANDOMIZE_REG_INIT
    `define RANDOMIZE
  `endif // RANDOMIZE_REG_INIT
`endif // not def RANDOMIZE

// RANDOM may be set to an expression that produces a 32-bit random unsigned value.
`ifndef RANDOM
  `define RANDOM $random
`endif // not def RANDOM

// Users can define INIT_RANDOM as general code that gets injected into the
// initializer block for modules with registers.
`ifndef INIT_RANDOM
  `define INIT_RANDOM
`endif // not def INIT_RANDOM

// If using random initialization, you can also define RANDOMIZE_DELAY to
// customize the delay used, otherwise 0.002 is used.
`ifndef RANDOMIZE_DELAY
  `define RANDOMIZE_DELAY 0.002
`endif // not def RANDOMIZE_DELAY

// Define INIT_RANDOM_PROLOG_ for use in our modules below.
`ifndef INIT_RANDOM_PROLOG_
  `ifdef RANDOMIZE
    `ifdef VERILATOR
      `define INIT_RANDOM_PROLOG_ `INIT_RANDOM
    `else  // VERILATOR
      `define INIT_RANDOM_PROLOG_ `INIT_RANDOM #`RANDOMIZE_DELAY begin end
    `endif // VERILATOR
  `else  // RANDOMIZE
    `define INIT_RANDOM_PROLOG_
  `endif // RANDOMIZE
`endif // not def INIT_RANDOM_PROLOG_

// Include register initializers in init blocks unless synthesis is set
`ifndef SYNTHESIS
  `ifndef ENABLE_INITIAL_REG_
    `define ENABLE_INITIAL_REG_
  `endif // not def ENABLE_INITIAL_REG_
`endif // not def SYNTHESIS

// Include rmemory initializers in init blocks unless synthesis is set
`ifndef SYNTHESIS
  `ifndef ENABLE_INITIAL_MEM_
    `define ENABLE_INITIAL_MEM_
  `endif // not def ENABLE_INITIAL_MEM_
`endif // not def SYNTHESIS

// Standard header to adapt well known macros for prints and assertions.

// Users can define 'PRINTF_COND' to add an extra gate to prints.
`ifndef PRINTF_COND_
  `ifdef PRINTF_COND
    `define PRINTF_COND_ (`PRINTF_COND)
  `else  // PRINTF_COND
    `define PRINTF_COND_ 1
  `endif // PRINTF_COND
`endif // not def PRINTF_COND_

// Users can define 'ASSERT_VERBOSE_COND' to add an extra gate to assert error printing.
`ifndef ASSERT_VERBOSE_COND_
  `ifdef ASSERT_VERBOSE_COND
    `define ASSERT_VERBOSE_COND_ (`ASSERT_VERBOSE_COND)
  `else  // ASSERT_VERBOSE_COND
    `define ASSERT_VERBOSE_COND_ 1
  `endif // ASSERT_VERBOSE_COND
`endif // not def ASSERT_VERBOSE_COND_

// Users can define 'STOP_COND' to add an extra gate to stop conditions.
`ifndef STOP_COND_
  `ifdef STOP_COND
    `define STOP_COND_ (`STOP_COND)
  `else  // STOP_COND
    `define STOP_COND_ 1
  `endif // STOP_COND
`endif // not def STOP_COND_

module SPIMedia(
  input         clock,
                reset,
  output        io_port_sck,	// @[generators/rocket-chip-blocks/src/main/scala/devices/spi/SPIMedia.scala:23:14]
  input         io_port_dq_0_i,	// @[generators/rocket-chip-blocks/src/main/scala/devices/spi/SPIMedia.scala:23:14]
  output        io_port_dq_0_o,	// @[generators/rocket-chip-blocks/src/main/scala/devices/spi/SPIMedia.scala:23:14]
                io_port_dq_0_oe,	// @[generators/rocket-chip-blocks/src/main/scala/devices/spi/SPIMedia.scala:23:14]
  input         io_port_dq_1_i,	// @[generators/rocket-chip-blocks/src/main/scala/devices/spi/SPIMedia.scala:23:14]
  output        io_port_dq_1_o,	// @[generators/rocket-chip-blocks/src/main/scala/devices/spi/SPIMedia.scala:23:14]
                io_port_dq_1_oe,	// @[generators/rocket-chip-blocks/src/main/scala/devices/spi/SPIMedia.scala:23:14]
  input         io_port_dq_2_i,	// @[generators/rocket-chip-blocks/src/main/scala/devices/spi/SPIMedia.scala:23:14]
  output        io_port_dq_2_o,	// @[generators/rocket-chip-blocks/src/main/scala/devices/spi/SPIMedia.scala:23:14]
                io_port_dq_2_oe,	// @[generators/rocket-chip-blocks/src/main/scala/devices/spi/SPIMedia.scala:23:14]
  input         io_port_dq_3_i,	// @[generators/rocket-chip-blocks/src/main/scala/devices/spi/SPIMedia.scala:23:14]
  output        io_port_dq_3_o,	// @[generators/rocket-chip-blocks/src/main/scala/devices/spi/SPIMedia.scala:23:14]
                io_port_dq_3_oe,	// @[generators/rocket-chip-blocks/src/main/scala/devices/spi/SPIMedia.scala:23:14]
                io_port_cs_0,	// @[generators/rocket-chip-blocks/src/main/scala/devices/spi/SPIMedia.scala:23:14]
  input  [11:0] io_ctrl_sck_div,	// @[generators/rocket-chip-blocks/src/main/scala/devices/spi/SPIMedia.scala:23:14]
  input         io_ctrl_sck_pol,	// @[generators/rocket-chip-blocks/src/main/scala/devices/spi/SPIMedia.scala:23:14]
                io_ctrl_sck_pha,	// @[generators/rocket-chip-blocks/src/main/scala/devices/spi/SPIMedia.scala:23:14]
  input  [7:0]  io_ctrl_dla_cssck,	// @[generators/rocket-chip-blocks/src/main/scala/devices/spi/SPIMedia.scala:23:14]
                io_ctrl_dla_sckcs,	// @[generators/rocket-chip-blocks/src/main/scala/devices/spi/SPIMedia.scala:23:14]
                io_ctrl_dla_intercs,	// @[generators/rocket-chip-blocks/src/main/scala/devices/spi/SPIMedia.scala:23:14]
                io_ctrl_dla_interxfr,	// @[generators/rocket-chip-blocks/src/main/scala/devices/spi/SPIMedia.scala:23:14]
  input         io_ctrl_cs_id,	// @[generators/rocket-chip-blocks/src/main/scala/devices/spi/SPIMedia.scala:23:14]
                io_ctrl_cs_dflt_0,	// @[generators/rocket-chip-blocks/src/main/scala/devices/spi/SPIMedia.scala:23:14]
  input  [11:0] io_ctrl_extradel_coarse,	// @[generators/rocket-chip-blocks/src/main/scala/devices/spi/SPIMedia.scala:23:14]
  input  [4:0]  io_ctrl_sampledel_sd,	// @[generators/rocket-chip-blocks/src/main/scala/devices/spi/SPIMedia.scala:23:14]
  output        io_link_tx_ready,	// @[generators/rocket-chip-blocks/src/main/scala/devices/spi/SPIMedia.scala:23:14]
  input         io_link_tx_valid,	// @[generators/rocket-chip-blocks/src/main/scala/devices/spi/SPIMedia.scala:23:14]
  input  [7:0]  io_link_tx_bits,	// @[generators/rocket-chip-blocks/src/main/scala/devices/spi/SPIMedia.scala:23:14]
  output        io_link_rx_valid,	// @[generators/rocket-chip-blocks/src/main/scala/devices/spi/SPIMedia.scala:23:14]
  output [7:0]  io_link_rx_bits,	// @[generators/rocket-chip-blocks/src/main/scala/devices/spi/SPIMedia.scala:23:14]
  input  [7:0]  io_link_cnt,	// @[generators/rocket-chip-blocks/src/main/scala/devices/spi/SPIMedia.scala:23:14]
  input  [1:0]  io_link_fmt_proto,	// @[generators/rocket-chip-blocks/src/main/scala/devices/spi/SPIMedia.scala:23:14]
  input         io_link_fmt_endian,	// @[generators/rocket-chip-blocks/src/main/scala/devices/spi/SPIMedia.scala:23:14]
                io_link_fmt_iodir,	// @[generators/rocket-chip-blocks/src/main/scala/devices/spi/SPIMedia.scala:23:14]
                io_link_cs_set,	// @[generators/rocket-chip-blocks/src/main/scala/devices/spi/SPIMedia.scala:23:14]
                io_link_cs_clear,	// @[generators/rocket-chip-blocks/src/main/scala/devices/spi/SPIMedia.scala:23:14]
                io_link_cs_hold,	// @[generators/rocket-chip-blocks/src/main/scala/devices/spi/SPIMedia.scala:23:14]
  output        io_link_active	// @[generators/rocket-chip-blocks/src/main/scala/devices/spi/SPIMedia.scala:23:14]
);

  wire            _phy_io_op_ready;	// @[generators/rocket-chip-blocks/src/main/scala/devices/spi/SPIMedia.scala:35:19]
  reg             cs_id;	// @[generators/rocket-chip-blocks/src/main/scala/devices/spi/SPIMedia.scala:49:15]
  reg             cs_dflt_0;	// @[generators/rocket-chip-blocks/src/main/scala/devices/spi/SPIMedia.scala:49:15]
  reg             cs_set;	// @[generators/rocket-chip-blocks/src/main/scala/devices/spi/SPIMedia.scala:50:19]
  wire [1:0]      cs_active_mask = {1'h0, io_link_cs_set} << io_ctrl_cs_id;	// @[generators/rocket-chip-blocks/src/main/scala/devices/spi/SPIBundle.scala:48:19]
  wire            cs_active_0 = io_ctrl_cs_dflt_0 ^ cs_active_mask[0];	// @[generators/rocket-chip-blocks/src/main/scala/devices/spi/SPIBundle.scala:48:19, :49:33]
  reg             clear;	// @[generators/rocket-chip-blocks/src/main/scala/devices/spi/SPIMedia.scala:54:22]
  reg             cs_assert;	// @[generators/rocket-chip-blocks/src/main/scala/devices/spi/SPIMedia.scala:55:26]
  wire            cs_deassert = clear | cs_active_0 != cs_dflt_0 & ~io_link_cs_hold;	// @[generators/rocket-chip-blocks/src/main/scala/devices/spi/SPIBundle.scala:49:33, generators/rocket-chip-blocks/src/main/scala/devices/spi/SPIMedia.scala:49:15, :52:37, :54:22, :56:{27,41,44}]
  reg  [1:0]      state;	// @[generators/rocket-chip-blocks/src/main/scala/devices/spi/SPIMedia.scala:71:22]
  wire            _GEN = state == 2'h0;	// @[generators/rocket-chip-blocks/src/main/scala/devices/spi/SPIMedia.scala:71:22, :73:18]
  wire            _GEN_0 = _GEN & cs_assert;	// @[generators/rocket-chip-blocks/src/main/scala/devices/spi/SPIMedia.scala:43:14, :55:26, :73:18, :75:24, :76:28]
  wire            _GEN_1 = state == 2'h1;	// @[generators/rocket-chip-blocks/src/main/scala/devices/spi/SPIMedia.scala:71:22, :73:18, :88:19]
  wire            _GEN_2 = _GEN ? ~cs_assert | cs_deassert | io_link_tx_valid : ~_GEN_1 | (|io_ctrl_dla_interxfr);	// @[generators/rocket-chip-blocks/src/main/scala/devices/spi/SPIMedia.scala:42:12, :55:26, :56:27, :60:42, :73:18, :75:24, :76:28, :109:16]
  wire            _GEN_3 = state == 2'h2;	// @[generators/rocket-chip-blocks/src/main/scala/devices/spi/SPIMedia.scala:71:22, :73:18, :79:19]
  wire [3:0][7:0] _GEN_4 = {{io_link_cnt}, {io_ctrl_dla_intercs}, {io_ctrl_dla_interxfr}, {cs_assert ? (cs_deassert ? io_ctrl_dla_sckcs : io_link_cnt) : io_link_tx_valid ? io_ctrl_dla_cssck : 8'h0}};	// @[generators/rocket-chip-blocks/src/main/scala/devices/spi/SPIMedia.scala:45:15, :55:26, :56:27, :73:18, :75:24, :76:28, :77:23, :91:38, :93:21, :101:21, :110:19, :118:19]
  wire [1:0]      mask = {1'h0, cs_set} << cs_id;	// @[generators/rocket-chip-blocks/src/main/scala/devices/spi/SPIBundle.scala:48:19, generators/rocket-chip-blocks/src/main/scala/devices/spi/SPIMedia.scala:49:15, :50:19]
  wire            _GEN_5 = io_link_tx_valid & _phy_io_op_ready;	// @[generators/rocket-chip-blocks/src/main/scala/devices/spi/SPIMedia.scala:35:19, :55:26, :91:38, :94:25, :95:21]
  wire            _GEN_6 = _GEN_3 & _phy_io_op_ready;	// @[generators/rocket-chip-blocks/src/main/scala/devices/spi/SPIMedia.scala:35:19, :49:15, :73:18, :122:23, :123:17]
  always @(posedge clock) begin
    if (~_GEN | cs_assert | io_link_tx_valid) begin	// @[generators/rocket-chip-blocks/src/main/scala/devices/spi/SPIMedia.scala:49:15, :50:19, :55:26, :73:18, :75:24]
    end
    else	// @[generators/rocket-chip-blocks/src/main/scala/devices/spi/SPIMedia.scala:49:15, :73:18, :75:24]
      cs_id <= io_ctrl_cs_id;	// @[generators/rocket-chip-blocks/src/main/scala/devices/spi/SPIMedia.scala:49:15]
    if (_GEN) begin	// @[generators/rocket-chip-blocks/src/main/scala/devices/spi/SPIMedia.scala:73:18]
      if (cs_assert) begin	// @[generators/rocket-chip-blocks/src/main/scala/devices/spi/SPIMedia.scala:55:26]
      end
      else if (io_link_tx_valid) begin	// @[generators/rocket-chip-blocks/src/main/scala/devices/spi/SPIMedia.scala:23:14]
        if (_phy_io_op_ready)	// @[generators/rocket-chip-blocks/src/main/scala/devices/spi/SPIMedia.scala:35:19]
          cs_dflt_0 <= cs_active_0;	// @[generators/rocket-chip-blocks/src/main/scala/devices/spi/SPIBundle.scala:49:33, generators/rocket-chip-blocks/src/main/scala/devices/spi/SPIMedia.scala:49:15]
      end
      else	// @[generators/rocket-chip-blocks/src/main/scala/devices/spi/SPIMedia.scala:23:14]
        cs_dflt_0 <= io_ctrl_cs_dflt_0;	// @[generators/rocket-chip-blocks/src/main/scala/devices/spi/SPIMedia.scala:49:15]
    end
    else	// @[generators/rocket-chip-blocks/src/main/scala/devices/spi/SPIMedia.scala:73:18]
      cs_dflt_0 <= ~_GEN_1 & _GEN_6 & mask[0] ^ cs_dflt_0;	// @[generators/rocket-chip-blocks/src/main/scala/devices/spi/SPIBundle.scala:48:19, generators/rocket-chip-blocks/src/main/scala/devices/spi/SPIMedia.scala:42:12, :49:15, :73:18, :109:16, :122:23, :123:17]
    if (~_GEN | cs_assert | ~_GEN_5) begin	// @[generators/rocket-chip-blocks/src/main/scala/devices/spi/SPIMedia.scala:50:19, :55:26, :73:18, :75:24, :91:38, :94:25, :95:21]
    end
    else	// @[generators/rocket-chip-blocks/src/main/scala/devices/spi/SPIMedia.scala:50:19, :73:18, :75:24]
      cs_set <= io_link_cs_set;	// @[generators/rocket-chip-blocks/src/main/scala/devices/spi/SPIMedia.scala:50:19]
    if (reset) begin
      clear <= 1'h0;	// @[generators/rocket-chip-blocks/src/main/scala/devices/spi/SPIMedia.scala:54:22]
      cs_assert <= 1'h0;	// @[generators/rocket-chip-blocks/src/main/scala/devices/spi/SPIMedia.scala:55:26]
      state <= 2'h0;	// @[generators/rocket-chip-blocks/src/main/scala/devices/spi/SPIMedia.scala:71:22]
    end
    else begin
      clear <= (_GEN | _GEN_1 | ~_GEN_3) & (clear | io_link_cs_clear & cs_assert);	// @[generators/rocket-chip-blocks/src/main/scala/devices/spi/SPIMedia.scala:54:22, :55:26, :58:{9,18,39}, :73:18, :120:17]
      if (_GEN) begin	// @[generators/rocket-chip-blocks/src/main/scala/devices/spi/SPIMedia.scala:73:18]
        cs_assert <= ~cs_assert & _GEN_5 | cs_assert;	// @[generators/rocket-chip-blocks/src/main/scala/devices/spi/SPIMedia.scala:42:12, :55:26, :75:24, :76:28, :91:38, :94:25, :95:21]
        if (cs_assert) begin	// @[generators/rocket-chip-blocks/src/main/scala/devices/spi/SPIMedia.scala:55:26]
          if (cs_deassert) begin	// @[generators/rocket-chip-blocks/src/main/scala/devices/spi/SPIMedia.scala:56:27]
            if (_phy_io_op_ready)	// @[generators/rocket-chip-blocks/src/main/scala/devices/spi/SPIMedia.scala:35:19]
              state <= 2'h2;	// @[generators/rocket-chip-blocks/src/main/scala/devices/spi/SPIMedia.scala:71:22, :79:19]
          end
          else if (_phy_io_op_ready & _GEN_2)	// @[generators/rocket-chip-blocks/src/main/scala/devices/spi/SPIMedia.scala:35:19, :73:18, :75:24, src/main/scala/chisel3/util/Decoupled.scala:52:35]
            state <= 2'h1;	// @[generators/rocket-chip-blocks/src/main/scala/devices/spi/SPIMedia.scala:71:22, :88:19]
        end
      end
      else begin	// @[generators/rocket-chip-blocks/src/main/scala/devices/spi/SPIMedia.scala:73:18]
        cs_assert <= (_GEN_1 | ~_GEN_3) & cs_assert;	// @[generators/rocket-chip-blocks/src/main/scala/devices/spi/SPIMedia.scala:55:26, :73:18, :120:17]
        if (_GEN_1 ? _phy_io_op_ready | ~(|io_ctrl_dla_interxfr) : _GEN_6)	// @[generators/rocket-chip-blocks/src/main/scala/devices/spi/SPIMedia.scala:35:19, :49:15, :60:42, :71:22, :73:18, :111:{22,37}, :112:15, :122:23, :123:17, :124:15]
          state <= 2'h0;	// @[generators/rocket-chip-blocks/src/main/scala/devices/spi/SPIMedia.scala:71:22]
      end
    end
  end // always @(posedge)
  `ifdef ENABLE_INITIAL_REG_
    `ifdef FIRRTL_BEFORE_INITIAL
      `FIRRTL_BEFORE_INITIAL
    `endif // FIRRTL_BEFORE_INITIAL
    logic [31:0] _RANDOM[0:0];
    initial begin
      `ifdef INIT_RANDOM_PROLOG_
        `INIT_RANDOM_PROLOG_
      `endif // INIT_RANDOM_PROLOG_
      `ifdef RANDOMIZE_REG_INIT
        _RANDOM[/*Zero width*/ 1'b0] = `RANDOM;
        cs_id = _RANDOM[/*Zero width*/ 1'b0][0];	// @[generators/rocket-chip-blocks/src/main/scala/devices/spi/SPIMedia.scala:49:15]
        cs_dflt_0 = _RANDOM[/*Zero width*/ 1'b0][1];	// @[generators/rocket-chip-blocks/src/main/scala/devices/spi/SPIMedia.scala:49:15]
        cs_set = _RANDOM[/*Zero width*/ 1'b0][2];	// @[generators/rocket-chip-blocks/src/main/scala/devices/spi/SPIMedia.scala:49:15, :50:19]
        clear = _RANDOM[/*Zero width*/ 1'b0][3];	// @[generators/rocket-chip-blocks/src/main/scala/devices/spi/SPIMedia.scala:49:15, :54:22]
        cs_assert = _RANDOM[/*Zero width*/ 1'b0][4];	// @[generators/rocket-chip-blocks/src/main/scala/devices/spi/SPIMedia.scala:49:15, :55:26]
        state = _RANDOM[/*Zero width*/ 1'b0][6:5];	// @[generators/rocket-chip-blocks/src/main/scala/devices/spi/SPIMedia.scala:49:15, :71:22]
      `endif // RANDOMIZE_REG_INIT
    end // initial
    `ifdef FIRRTL_AFTER_INITIAL
      `FIRRTL_AFTER_INITIAL
    `endif // FIRRTL_AFTER_INITIAL
  `endif // ENABLE_INITIAL_REG_
  SPIPhysical phy (	// @[generators/rocket-chip-blocks/src/main/scala/devices/spi/SPIMedia.scala:35:19]
    .clock                   (clock),
    .reset                   (reset),
    .io_port_sck             (io_port_sck),
    .io_port_dq_0_i          (io_port_dq_0_i),
    .io_port_dq_0_o          (io_port_dq_0_o),
    .io_port_dq_0_oe         (io_port_dq_0_oe),
    .io_port_dq_1_i          (io_port_dq_1_i),
    .io_port_dq_1_o          (io_port_dq_1_o),
    .io_port_dq_1_oe         (io_port_dq_1_oe),
    .io_port_dq_2_i          (io_port_dq_2_i),
    .io_port_dq_2_o          (io_port_dq_2_o),
    .io_port_dq_2_oe         (io_port_dq_2_oe),
    .io_port_dq_3_i          (io_port_dq_3_i),
    .io_port_dq_3_o          (io_port_dq_3_o),
    .io_port_dq_3_oe         (io_port_dq_3_oe),
    .io_ctrl_sck_div         (io_ctrl_sck_div),
    .io_ctrl_sck_pol         (io_ctrl_sck_pol),
    .io_ctrl_sck_pha         (io_ctrl_sck_pha),
    .io_ctrl_fmt_proto       (io_link_fmt_proto),
    .io_ctrl_fmt_endian      (io_link_fmt_endian),
    .io_ctrl_fmt_iodir       (io_link_fmt_iodir),
    .io_ctrl_extradel_coarse (io_ctrl_extradel_coarse),
    .io_ctrl_sampledel_sd    (io_ctrl_sampledel_sd),
    .io_op_ready             (_phy_io_op_ready),
    .io_op_valid             (_GEN_2),	// @[generators/rocket-chip-blocks/src/main/scala/devices/spi/SPIMedia.scala:73:18, :75:24]
    .io_op_bits_fn           (~_GEN_0 | cs_deassert),	// @[generators/rocket-chip-blocks/src/main/scala/devices/spi/SPIMedia.scala:43:14, :56:27, :73:18, :75:24, :76:28]
    .io_op_bits_stb          (_GEN ? (cs_assert ? ~cs_deassert : ~io_link_tx_valid) : ~_GEN_1 & _GEN_3),	// @[generators/rocket-chip-blocks/src/main/scala/devices/spi/SPIMedia.scala:42:12, :44:15, :55:26, :56:27, :73:18, :75:24, :76:28, :83:23, :91:38, :102:21, :109:16]
    .io_op_bits_cnt          (_GEN_4[state]),	// @[generators/rocket-chip-blocks/src/main/scala/devices/spi/SPIMedia.scala:45:15, :71:22, :73:18, :75:24, :110:19, :118:19]
    .io_op_bits_data         (io_link_tx_bits),
    .io_rx_valid             (io_link_rx_valid),
    .io_rx_bits              (io_link_rx_bits)
  );
  assign io_port_cs_0 = cs_dflt_0;	// @[generators/rocket-chip-blocks/src/main/scala/devices/spi/SPIMedia.scala:49:15]
  assign io_link_tx_ready = _GEN_0 & ~cs_deassert & _phy_io_op_ready;	// @[generators/rocket-chip-blocks/src/main/scala/devices/spi/SPIMedia.scala:35:19, :43:14, :56:27, :67:20, :73:18, :75:24, :76:28, :86:28]
  assign io_link_active = cs_assert;	// @[generators/rocket-chip-blocks/src/main/scala/devices/spi/SPIMedia.scala:55:26]
endmodule

