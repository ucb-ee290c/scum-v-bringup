// Generated by CIRCT unknown git version
// Standard header to adapt well known macros for register randomization.
`ifndef RANDOMIZE
  `ifdef RANDOMIZE_MEM_INIT
    `define RANDOMIZE
  `endif // RANDOMIZE_MEM_INIT
`endif // not def RANDOMIZE
`ifndef RANDOMIZE
  `ifdef RANDOMIZE_REG_INIT
    `define RANDOMIZE
  `endif // RANDOMIZE_REG_INIT
`endif // not def RANDOMIZE

// RANDOM may be set to an expression that produces a 32-bit random unsigned value.
`ifndef RANDOM
  `define RANDOM $random
`endif // not def RANDOM

// Users can define INIT_RANDOM as general code that gets injected into the
// initializer block for modules with registers.
`ifndef INIT_RANDOM
  `define INIT_RANDOM
`endif // not def INIT_RANDOM

// If using random initialization, you can also define RANDOMIZE_DELAY to
// customize the delay used, otherwise 0.002 is used.
`ifndef RANDOMIZE_DELAY
  `define RANDOMIZE_DELAY 0.002
`endif // not def RANDOMIZE_DELAY

// Define INIT_RANDOM_PROLOG_ for use in our modules below.
`ifndef INIT_RANDOM_PROLOG_
  `ifdef RANDOMIZE
    `ifdef VERILATOR
      `define INIT_RANDOM_PROLOG_ `INIT_RANDOM
    `else  // VERILATOR
      `define INIT_RANDOM_PROLOG_ `INIT_RANDOM #`RANDOMIZE_DELAY begin end
    `endif // VERILATOR
  `else  // RANDOMIZE
    `define INIT_RANDOM_PROLOG_
  `endif // RANDOMIZE
`endif // not def INIT_RANDOM_PROLOG_

// Include register initializers in init blocks unless synthesis is set
`ifndef SYNTHESIS
  `ifndef ENABLE_INITIAL_REG_
    `define ENABLE_INITIAL_REG_
  `endif // not def ENABLE_INITIAL_REG_
`endif // not def SYNTHESIS

// Include rmemory initializers in init blocks unless synthesis is set
`ifndef SYNTHESIS
  `ifndef ENABLE_INITIAL_MEM_
    `define ENABLE_INITIAL_MEM_
  `endif // not def ENABLE_INITIAL_MEM_
`endif // not def SYNTHESIS

// Standard header to adapt well known macros for prints and assertions.

// Users can define 'PRINTF_COND' to add an extra gate to prints.
`ifndef PRINTF_COND_
  `ifdef PRINTF_COND
    `define PRINTF_COND_ (`PRINTF_COND)
  `else  // PRINTF_COND
    `define PRINTF_COND_ 1
  `endif // PRINTF_COND
`endif // not def PRINTF_COND_

// Users can define 'ASSERT_VERBOSE_COND' to add an extra gate to assert error printing.
`ifndef ASSERT_VERBOSE_COND_
  `ifdef ASSERT_VERBOSE_COND
    `define ASSERT_VERBOSE_COND_ (`ASSERT_VERBOSE_COND)
  `else  // ASSERT_VERBOSE_COND
    `define ASSERT_VERBOSE_COND_ 1
  `endif // ASSERT_VERBOSE_COND
`endif // not def ASSERT_VERBOSE_COND_

// Users can define 'STOP_COND' to add an extra gate to stop conditions.
`ifndef STOP_COND_
  `ifdef STOP_COND
    `define STOP_COND_ (`STOP_COND)
  `else  // STOP_COND
    `define STOP_COND_ 1
  `endif // STOP_COND
`endif // not def STOP_COND_

module IFCounter(
  input         clock,
                reset,
  input  [7:0]  io_data,	// @[generators/baseband/src/main/scala/modem/IFCounter.scala:39:14]
  input         io_sop,	// @[generators/baseband/src/main/scala/modem/IFCounter.scala:39:14]
  input  [31:0] io_state_input_ifTickThreshold,	// @[generators/baseband/src/main/scala/modem/IFCounter.scala:39:14]
  input         io_state_input_control_restartCounter,	// @[generators/baseband/src/main/scala/modem/IFCounter.scala:39:14]
  output [31:0] io_state_output_adcTicks,	// @[generators/baseband/src/main/scala/modem/IFCounter.scala:39:14]
                io_state_output_ifTicksPacket,	// @[generators/baseband/src/main/scala/modem/IFCounter.scala:39:14]
                io_state_output_adcTicksPacket,	// @[generators/baseband/src/main/scala/modem/IFCounter.scala:39:14]
                io_state_output_ifTicksPrevPacket,	// @[generators/baseband/src/main/scala/modem/IFCounter.scala:39:14]
                io_state_output_adcTicksPrevPacket,	// @[generators/baseband/src/main/scala/modem/IFCounter.scala:39:14]
  output        io_state_output_thresholdInterrupt	// @[generators/baseband/src/main/scala/modem/IFCounter.scala:39:14]
);

  reg  [31:0] if_tick_threshold;	// @[generators/baseband/src/main/scala/modem/IFCounter.scala:45:34]
  reg  [31:0] adc_ticks;	// @[generators/baseband/src/main/scala/modem/IFCounter.scala:46:26]
  reg  [31:0] if_ticks_packet;	// @[generators/baseband/src/main/scala/modem/IFCounter.scala:47:32]
  reg  [31:0] adc_ticks_packet;	// @[generators/baseband/src/main/scala/modem/IFCounter.scala:48:33]
  reg  [31:0] if_ticks_prev_packet;	// @[generators/baseband/src/main/scala/modem/IFCounter.scala:49:37]
  reg  [31:0] adc_ticks_prev_packet;	// @[generators/baseband/src/main/scala/modem/IFCounter.scala:50:38]
  reg         threshold_interrupt;	// @[generators/baseband/src/main/scala/modem/IFCounter.scala:52:36]
  reg         threshold_interrupted;	// @[generators/baseband/src/main/scala/modem/IFCounter.scala:53:38]
  reg  [7:0]  prev_data;	// @[generators/baseband/src/main/scala/modem/IFCounter.scala:55:26]
  wire        _GEN = io_sop | io_state_input_control_restartCounter;	// @[generators/baseband/src/main/scala/modem/IFCounter.scala:75:26]
  wire        _GEN_0 = if_ticks_packet == if_tick_threshold;	// @[generators/baseband/src/main/scala/modem/IFCounter.scala:45:34, :47:32, :86:{26,49}, :89:23]
  always @(posedge clock) begin
    if (reset) begin
      if_tick_threshold <= 32'hC8;	// @[generators/baseband/src/main/scala/modem/IFCounter.scala:45:34]
      adc_ticks <= 32'h0;	// @[generators/baseband/src/main/scala/modem/IFCounter.scala:46:26]
      if_ticks_packet <= 32'h0;	// @[generators/baseband/src/main/scala/modem/IFCounter.scala:46:26, :47:32]
      adc_ticks_packet <= 32'h0;	// @[generators/baseband/src/main/scala/modem/IFCounter.scala:46:26, :48:33]
      if_ticks_prev_packet <= 32'h0;	// @[generators/baseband/src/main/scala/modem/IFCounter.scala:46:26, :49:37]
      adc_ticks_prev_packet <= 32'h0;	// @[generators/baseband/src/main/scala/modem/IFCounter.scala:46:26, :50:38]
      threshold_interrupt <= 1'h0;	// @[generators/baseband/src/main/scala/modem/IFCounter.scala:52:36]
      threshold_interrupted <= 1'h0;	// @[generators/baseband/src/main/scala/modem/IFCounter.scala:52:36, :53:38]
    end
    else begin
      if (_GEN) begin	// @[generators/baseband/src/main/scala/modem/IFCounter.scala:75:26]
        if_tick_threshold <= io_state_input_ifTickThreshold;	// @[generators/baseband/src/main/scala/modem/IFCounter.scala:45:34]
        if_ticks_packet <= 32'h0;	// @[generators/baseband/src/main/scala/modem/IFCounter.scala:46:26, :47:32]
        adc_ticks_packet <= 32'h0;	// @[generators/baseband/src/main/scala/modem/IFCounter.scala:46:26, :48:33]
        if_ticks_prev_packet <= if_ticks_packet;	// @[generators/baseband/src/main/scala/modem/IFCounter.scala:47:32, :49:37]
        adc_ticks_prev_packet <= adc_ticks_packet;	// @[generators/baseband/src/main/scala/modem/IFCounter.scala:48:33, :50:38]
      end
      else begin	// @[generators/baseband/src/main/scala/modem/IFCounter.scala:75:26]
        if (_GEN_0 | ~(~(prev_data[7]) & io_data[7])) begin	// @[generators/baseband/src/main/scala/modem/IFCounter.scala:47:32, :55:26, :57:{31,41,52}, :86:{26,49}, :89:23]
        end
        else	// @[generators/baseband/src/main/scala/modem/IFCounter.scala:47:32, :86:{26,49}, :89:23]
          if_ticks_packet <= if_ticks_packet + 32'h1;	// @[generators/baseband/src/main/scala/modem/IFCounter.scala:47:32, :72:26, :89:58]
        if (~_GEN_0)	// @[generators/baseband/src/main/scala/modem/IFCounter.scala:47:32, :86:{26,49}, :89:23]
          adc_ticks_packet <= adc_ticks_packet + 32'h1;	// @[generators/baseband/src/main/scala/modem/IFCounter.scala:48:33, :72:26, :91:44]
      end
      adc_ticks <= adc_ticks + 32'h1;	// @[generators/baseband/src/main/scala/modem/IFCounter.scala:46:26, :72:26]
      threshold_interrupt <= ~_GEN & _GEN_0 & ~threshold_interrupted;	// @[generators/baseband/src/main/scala/modem/IFCounter.scala:47:32, :52:36, :53:38, :68:23, :75:{26,79}, :86:{26,49}, :89:23, :94:34]
      threshold_interrupted <= ~_GEN & (_GEN_0 & ~threshold_interrupted | threshold_interrupted);	// @[generators/baseband/src/main/scala/modem/IFCounter.scala:47:32, :53:38, :68:23, :75:{26,79}, :84:27, :86:{26,49}, :89:23, :94:{34,47}, :96:31]
    end
    prev_data <= io_data;	// @[generators/baseband/src/main/scala/modem/IFCounter.scala:55:26]
  end // always @(posedge)
  `ifdef ENABLE_INITIAL_REG_
    `ifdef FIRRTL_BEFORE_INITIAL
      `FIRRTL_BEFORE_INITIAL
    `endif // FIRRTL_BEFORE_INITIAL
    logic [31:0] _RANDOM[0:6];
    initial begin
      `ifdef INIT_RANDOM_PROLOG_
        `INIT_RANDOM_PROLOG_
      `endif // INIT_RANDOM_PROLOG_
      `ifdef RANDOMIZE_REG_INIT
        for (logic [2:0] i = 3'h0; i < 3'h7; i += 3'h1) begin
          _RANDOM[i] = `RANDOM;
        end
        if_tick_threshold = _RANDOM[3'h0];	// @[generators/baseband/src/main/scala/modem/IFCounter.scala:45:34]
        adc_ticks = _RANDOM[3'h1];	// @[generators/baseband/src/main/scala/modem/IFCounter.scala:46:26]
        if_ticks_packet = _RANDOM[3'h2];	// @[generators/baseband/src/main/scala/modem/IFCounter.scala:47:32]
        adc_ticks_packet = _RANDOM[3'h3];	// @[generators/baseband/src/main/scala/modem/IFCounter.scala:48:33]
        if_ticks_prev_packet = _RANDOM[3'h4];	// @[generators/baseband/src/main/scala/modem/IFCounter.scala:49:37]
        adc_ticks_prev_packet = _RANDOM[3'h5];	// @[generators/baseband/src/main/scala/modem/IFCounter.scala:50:38]
        threshold_interrupt = _RANDOM[3'h6][0];	// @[generators/baseband/src/main/scala/modem/IFCounter.scala:52:36]
        threshold_interrupted = _RANDOM[3'h6][1];	// @[generators/baseband/src/main/scala/modem/IFCounter.scala:52:36, :53:38]
        prev_data = _RANDOM[3'h6][9:2];	// @[generators/baseband/src/main/scala/modem/IFCounter.scala:52:36, :55:26]
      `endif // RANDOMIZE_REG_INIT
    end // initial
    `ifdef FIRRTL_AFTER_INITIAL
      `FIRRTL_AFTER_INITIAL
    `endif // FIRRTL_AFTER_INITIAL
  `endif // ENABLE_INITIAL_REG_
  assign io_state_output_adcTicks = adc_ticks;	// @[generators/baseband/src/main/scala/modem/IFCounter.scala:46:26]
  assign io_state_output_ifTicksPacket = if_ticks_packet;	// @[generators/baseband/src/main/scala/modem/IFCounter.scala:47:32]
  assign io_state_output_adcTicksPacket = adc_ticks_packet;	// @[generators/baseband/src/main/scala/modem/IFCounter.scala:48:33]
  assign io_state_output_ifTicksPrevPacket = if_ticks_prev_packet;	// @[generators/baseband/src/main/scala/modem/IFCounter.scala:49:37]
  assign io_state_output_adcTicksPrevPacket = adc_ticks_prev_packet;	// @[generators/baseband/src/main/scala/modem/IFCounter.scala:50:38]
  assign io_state_output_thresholdInterrupt = threshold_interrupt;	// @[generators/baseband/src/main/scala/modem/IFCounter.scala:52:36]
endmodule

