// Generated by CIRCT unknown git version
// Standard header to adapt well known macros for register randomization.
`ifndef RANDOMIZE
  `ifdef RANDOMIZE_MEM_INIT
    `define RANDOMIZE
  `endif // RANDOMIZE_MEM_INIT
`endif // not def RANDOMIZE
`ifndef RANDOMIZE
  `ifdef RANDOMIZE_REG_INIT
    `define RANDOMIZE
  `endif // RANDOMIZE_REG_INIT
`endif // not def RANDOMIZE

// RANDOM may be set to an expression that produces a 32-bit random unsigned value.
`ifndef RANDOM
  `define RANDOM $random
`endif // not def RANDOM

// Users can define INIT_RANDOM as general code that gets injected into the
// initializer block for modules with registers.
`ifndef INIT_RANDOM
  `define INIT_RANDOM
`endif // not def INIT_RANDOM

// If using random initialization, you can also define RANDOMIZE_DELAY to
// customize the delay used, otherwise 0.002 is used.
`ifndef RANDOMIZE_DELAY
  `define RANDOMIZE_DELAY 0.002
`endif // not def RANDOMIZE_DELAY

// Define INIT_RANDOM_PROLOG_ for use in our modules below.
`ifndef INIT_RANDOM_PROLOG_
  `ifdef RANDOMIZE
    `ifdef VERILATOR
      `define INIT_RANDOM_PROLOG_ `INIT_RANDOM
    `else  // VERILATOR
      `define INIT_RANDOM_PROLOG_ `INIT_RANDOM #`RANDOMIZE_DELAY begin end
    `endif // VERILATOR
  `else  // RANDOMIZE
    `define INIT_RANDOM_PROLOG_
  `endif // RANDOMIZE
`endif // not def INIT_RANDOM_PROLOG_

// Include register initializers in init blocks unless synthesis is set
`ifndef SYNTHESIS
  `ifndef ENABLE_INITIAL_REG_
    `define ENABLE_INITIAL_REG_
  `endif // not def ENABLE_INITIAL_REG_
`endif // not def SYNTHESIS

// Include rmemory initializers in init blocks unless synthesis is set
`ifndef SYNTHESIS
  `ifndef ENABLE_INITIAL_MEM_
    `define ENABLE_INITIAL_MEM_
  `endif // not def ENABLE_INITIAL_MEM_
`endif // not def SYNTHESIS

// Standard header to adapt well known macros for prints and assertions.

// Users can define 'PRINTF_COND' to add an extra gate to prints.
`ifndef PRINTF_COND_
  `ifdef PRINTF_COND
    `define PRINTF_COND_ (`PRINTF_COND)
  `else  // PRINTF_COND
    `define PRINTF_COND_ 1
  `endif // PRINTF_COND
`endif // not def PRINTF_COND_

// Users can define 'ASSERT_VERBOSE_COND' to add an extra gate to assert error printing.
`ifndef ASSERT_VERBOSE_COND_
  `ifdef ASSERT_VERBOSE_COND
    `define ASSERT_VERBOSE_COND_ (`ASSERT_VERBOSE_COND)
  `else  // ASSERT_VERBOSE_COND
    `define ASSERT_VERBOSE_COND_ 1
  `endif // ASSERT_VERBOSE_COND
`endif // not def ASSERT_VERBOSE_COND_

// Users can define 'STOP_COND' to add an extra gate to stop conditions.
`ifndef STOP_COND_
  `ifdef STOP_COND
    `define STOP_COND_ (`STOP_COND)
  `else  // STOP_COND
    `define STOP_COND_ 1
  `endif // STOP_COND
`endif // not def STOP_COND_

module TXChainController(
  input         clock,
                reset,
  output        io_interrupt_error,	// @[generators/baseband/src/main/scala/baseband/Controller.scala:26:14]
                io_interrupt_txFinish,	// @[generators/baseband/src/main/scala/baseband/Controller.scala:26:14]
  input         io_bleAssemblerControl_in_ready,	// @[generators/baseband/src/main/scala/baseband/Controller.scala:26:14]
  output        io_bleAssemblerControl_in_valid,	// @[generators/baseband/src/main/scala/baseband/Controller.scala:26:14]
  output [31:0] io_bleAssemblerControl_in_bits_aa,	// @[generators/baseband/src/main/scala/baseband/Controller.scala:26:14]
  output [7:0]  io_bleAssemblerControl_in_bits_pduLength,	// @[generators/baseband/src/main/scala/baseband/Controller.scala:26:14]
  input         io_bleAssemblerControl_out_done,	// @[generators/baseband/src/main/scala/baseband/Controller.scala:26:14]
                io_lrwpanAssemblerControl_in_ready,	// @[generators/baseband/src/main/scala/baseband/Controller.scala:26:14]
  output        io_lrwpanAssemblerControl_in_valid,	// @[generators/baseband/src/main/scala/baseband/Controller.scala:26:14]
  output [7:0]  io_lrwpanAssemblerControl_in_bits_pduLength,	// @[generators/baseband/src/main/scala/baseband/Controller.scala:26:14]
  input         io_lrwpanAssemblerControl_out_done,	// @[generators/baseband/src/main/scala/baseband/Controller.scala:26:14]
                io_modemTXControl_in_ready,	// @[generators/baseband/src/main/scala/baseband/Controller.scala:26:14]
  output        io_modemTXControl_in_valid,	// @[generators/baseband/src/main/scala/baseband/Controller.scala:26:14]
  output [8:0]  io_modemTXControl_in_bits_totalBytes,	// @[generators/baseband/src/main/scala/baseband/Controller.scala:26:14]
  input         io_modemTXControl_out_done,	// @[generators/baseband/src/main/scala/baseband/Controller.scala:26:14]
                io_dma_readReq_ready,	// @[generators/baseband/src/main/scala/baseband/Controller.scala:26:14]
  output        io_dma_readReq_valid,	// @[generators/baseband/src/main/scala/baseband/Controller.scala:26:14]
  output [31:0] io_dma_readReq_bits_addr,	// @[generators/baseband/src/main/scala/baseband/Controller.scala:26:14]
  output [8:0]  io_dma_readReq_bits_totalBytes,	// @[generators/baseband/src/main/scala/baseband/Controller.scala:26:14]
  input         io_dma_readResp_valid,	// @[generators/baseband/src/main/scala/baseband/Controller.scala:26:14]
  input  [8:0]  io_dma_readResp_bits_bytesRead,	// @[generators/baseband/src/main/scala/baseband/Controller.scala:26:14]
  input         io_constants_radioMode,	// @[generators/baseband/src/main/scala/baseband/Controller.scala:26:14]
  input  [31:0] io_constants_accessAddress,	// @[generators/baseband/src/main/scala/baseband/Controller.scala:26:14]
  input         io_control_cmd_valid,	// @[generators/baseband/src/main/scala/baseband/Controller.scala:26:14]
                io_control_cmd_bits_command,	// @[generators/baseband/src/main/scala/baseband/Controller.scala:26:14]
  input  [31:0] io_control_cmd_bits_addr,	// @[generators/baseband/src/main/scala/baseband/Controller.scala:26:14]
  input  [8:0]  io_control_cmd_bits_totalBytes,	// @[generators/baseband/src/main/scala/baseband/Controller.scala:26:14]
  output        io_control_done,	// @[generators/baseband/src/main/scala/baseband/Controller.scala:26:14]
  input         io_messages_txErrorMessage_ready,	// @[generators/baseband/src/main/scala/baseband/Controller.scala:26:14]
  output        io_messages_txErrorMessage_valid,	// @[generators/baseband/src/main/scala/baseband/Controller.scala:26:14]
  output [31:0] io_messages_txErrorMessage_bits,	// @[generators/baseband/src/main/scala/baseband/Controller.scala:26:14]
  output [1:0]  io_state	// @[generators/baseband/src/main/scala/baseband/Controller.scala:26:14]
);

  reg  [1:0]  state;	// @[generators/baseband/src/main/scala/baseband/Controller.scala:45:22]
  reg         done;	// @[generators/baseband/src/main/scala/baseband/Controller.scala:47:21]
  reg         cmd_command;	// @[generators/baseband/src/main/scala/baseband/Controller.scala:48:16]
  reg  [31:0] cmd_addr;	// @[generators/baseband/src/main/scala/baseband/Controller.scala:48:16]
  reg  [8:0]  cmd_totalBytes;	// @[generators/baseband/src/main/scala/baseband/Controller.scala:48:16]
  reg         assemblerReqValid;	// @[generators/baseband/src/main/scala/baseband/Controller.scala:50:34]
  reg         assemblerDone;	// @[generators/baseband/src/main/scala/baseband/Controller.scala:51:30]
  reg         modemTXReqValid;	// @[generators/baseband/src/main/scala/baseband/Controller.scala:53:32]
  reg         modemTXDone;	// @[generators/baseband/src/main/scala/baseband/Controller.scala:54:28]
  reg         dmaReqValid;	// @[generators/baseband/src/main/scala/baseband/Controller.scala:56:28]
  reg         dmaRespReady;	// @[generators/baseband/src/main/scala/baseband/Controller.scala:57:29]
  reg  [8:0]  dmaReadResp_bytesRead;	// @[generators/baseband/src/main/scala/baseband/Controller.scala:58:24]
  reg         error;	// @[generators/baseband/src/main/scala/baseband/Controller.scala:60:22]
  reg         txFinish;	// @[generators/baseband/src/main/scala/baseband/Controller.scala:61:25]
  reg         errorMessageValid;	// @[generators/baseband/src/main/scala/baseband/Controller.scala:63:34]
  reg  [31:0] errorMessageBits;	// @[generators/baseband/src/main/scala/baseband/Controller.scala:64:33]
  wire        io_bleAssemblerControl_in_valid_0 = ~io_constants_radioMode & assemblerReqValid;	// @[generators/baseband/src/main/scala/baseband/Controller.scala:50:34, :74:{41,65}]
  wire        io_lrwpanAssemblerControl_in_valid_0 = io_constants_radioMode & assemblerReqValid;	// @[generators/baseband/src/main/scala/baseband/Controller.scala:50:34, :79:44]
  wire        _GEN = io_dma_readReq_ready & dmaReqValid;	// @[generators/baseband/src/main/scala/baseband/Controller.scala:56:28, src/main/scala/chisel3/util/Decoupled.scala:52:35]
  wire        _GEN_0 = assemblerDone & (modemTXDone | cmd_command);	// @[generators/baseband/src/main/scala/baseband/Controller.scala:48:16, :51:30, :54:28, :185:{26,42}]
  wire        _GEN_1 = dmaReadResp_bytesRead == cmd_totalBytes;	// @[generators/baseband/src/main/scala/baseband/Controller.scala:48:16, :58:24, :195:36]
  wire        _GEN_2 = _GEN_0 & _GEN_1;	// @[generators/baseband/src/main/scala/baseband/Controller.scala:112:18, :185:{26,99}, :195:{36,56}, :197:20]
  wire        _GEN_3 = state == 2'h2 & io_messages_txErrorMessage_ready & errorMessageValid;	// @[generators/baseband/src/main/scala/baseband/Controller.scala:45:22, :63:34, :108:15, :125:17, :211:46, :213:15]
  wire        _GEN_4 = state == 2'h0;	// @[generators/baseband/src/main/scala/baseband/Controller.scala:45:22, :125:17]
  wire        _GEN_5 = (|(io_control_cmd_bits_totalBytes[8:1])) & io_control_cmd_bits_totalBytes < 9'h102;	// @[generators/baseband/src/main/scala/baseband/Controller.scala:128:{45,51,84}]
  wire        _GEN_6 = state == 2'h1;	// @[generators/baseband/src/main/scala/baseband/Controller.scala:45:22, :125:17]
  wire        _GEN_7 = dmaRespReady & io_dma_readResp_valid;	// @[generators/baseband/src/main/scala/baseband/Controller.scala:57:29, src/main/scala/chisel3/util/Decoupled.scala:52:35]
  wire        _GEN_8 = ~io_control_cmd_valid | _GEN_5;	// @[generators/baseband/src/main/scala/baseband/Controller.scala:51:30, :127:33, :128:{51,93}]
  always @(posedge clock) begin
    if (reset) begin
      state <= 2'h0;	// @[generators/baseband/src/main/scala/baseband/Controller.scala:45:22]
      done <= 1'h0;	// @[generators/baseband/src/main/scala/baseband/Controller.scala:47:21]
      assemblerReqValid <= 1'h0;	// @[generators/baseband/src/main/scala/baseband/Controller.scala:47:21, :50:34]
      assemblerDone <= 1'h0;	// @[generators/baseband/src/main/scala/baseband/Controller.scala:47:21, :51:30]
      modemTXReqValid <= 1'h0;	// @[generators/baseband/src/main/scala/baseband/Controller.scala:47:21, :53:32]
      modemTXDone <= 1'h0;	// @[generators/baseband/src/main/scala/baseband/Controller.scala:47:21, :54:28]
      dmaReqValid <= 1'h0;	// @[generators/baseband/src/main/scala/baseband/Controller.scala:47:21, :56:28]
      dmaRespReady <= 1'h0;	// @[generators/baseband/src/main/scala/baseband/Controller.scala:47:21, :57:29]
      error <= 1'h0;	// @[generators/baseband/src/main/scala/baseband/Controller.scala:47:21, :60:22]
      txFinish <= 1'h0;	// @[generators/baseband/src/main/scala/baseband/Controller.scala:47:21, :61:25]
      errorMessageValid <= 1'h0;	// @[generators/baseband/src/main/scala/baseband/Controller.scala:47:21, :63:34]
      errorMessageBits <= 32'h0;	// @[generators/baseband/src/main/scala/baseband/Controller.scala:64:33]
    end
    else begin
      if (_GEN_4) begin	// @[generators/baseband/src/main/scala/baseband/Controller.scala:125:17]
        if (io_control_cmd_valid) begin	// @[generators/baseband/src/main/scala/baseband/Controller.scala:26:14]
          state <= _GEN_5 ? 2'h1 : 2'h2;	// @[generators/baseband/src/main/scala/baseband/Controller.scala:45:22, :128:{51,93}, :139:17, :152:17]
          assemblerReqValid <= _GEN_5;	// @[generators/baseband/src/main/scala/baseband/Controller.scala:50:34, :128:51]
          modemTXReqValid <= _GEN_5;	// @[generators/baseband/src/main/scala/baseband/Controller.scala:53:32, :128:51]
          dmaReqValid <= _GEN_5;	// @[generators/baseband/src/main/scala/baseband/Controller.scala:56:28, :128:51]
        end
        assemblerDone <= _GEN_8 & assemblerDone;	// @[generators/baseband/src/main/scala/baseband/Controller.scala:51:30, :127:33, :128:93]
        modemTXDone <= _GEN_8 & modemTXDone;	// @[generators/baseband/src/main/scala/baseband/Controller.scala:51:30, :54:28, :127:33, :128:93]
        dmaRespReady <= _GEN_8 & dmaRespReady;	// @[generators/baseband/src/main/scala/baseband/Controller.scala:51:30, :57:29, :127:33, :128:93]
        errorMessageValid <= io_control_cmd_valid & ~_GEN_5 | errorMessageValid;	// @[generators/baseband/src/main/scala/baseband/Controller.scala:63:34, :127:33, :128:{51,93}, :149:29]
        if (_GEN_8) begin	// @[generators/baseband/src/main/scala/baseband/Controller.scala:51:30, :64:33, :127:33, :128:93]
        end
        else	// @[generators/baseband/src/main/scala/baseband/Controller.scala:64:33, :127:33, :128:93]
          errorMessageBits <= {17'h0, io_control_cmd_bits_totalBytes, 6'h0};	// @[generators/baseband/src/main/scala/baseband/BasebandISA.scala:72:{8,20}, generators/baseband/src/main/scala/baseband/Controller.scala:64:33]
      end
      else begin	// @[generators/baseband/src/main/scala/baseband/Controller.scala:125:17]
        if (_GEN_6) begin	// @[generators/baseband/src/main/scala/baseband/Controller.scala:125:17]
          if (_GEN_0)	// @[generators/baseband/src/main/scala/baseband/Controller.scala:185:26]
            state <= {~_GEN_1, 1'h0};	// @[generators/baseband/src/main/scala/baseband/Controller.scala:45:22, :47:21, :63:34, :195:{36,56}, :202:17, :204:29, :206:17]
          assemblerDone <= ~_GEN_0 & ((io_constants_radioMode ? io_lrwpanAssemblerControl_out_done : io_bleAssemblerControl_out_done) | assemblerDone);	// @[generators/baseband/src/main/scala/baseband/Controller.scala:51:30, :122:28, :177:29, :178:23, :185:{26,99}, :188:23]
          modemTXDone <= ~_GEN_0 & (io_modemTXControl_out_done | modemTXDone);	// @[generators/baseband/src/main/scala/baseband/Controller.scala:54:28, :177:29, :181:40, :182:21, :185:{26,99}, :188:23, :190:21]
          dmaRespReady <= ~(_GEN_0 | _GEN_7) & (_GEN | dmaRespReady);	// @[generators/baseband/src/main/scala/baseband/Controller.scala:57:29, :157:33, :159:22, :171:34, :173:22, :185:{26,99}, :192:22, src/main/scala/chisel3/util/Decoupled.scala:52:35]
          errorMessageValid <= _GEN_0 & ~_GEN_1 | errorMessageValid;	// @[generators/baseband/src/main/scala/baseband/Controller.scala:63:34, :185:{26,99}, :195:{36,56}, :204:29]
        end
        else begin	// @[generators/baseband/src/main/scala/baseband/Controller.scala:125:17]
          if (_GEN_3)	// @[generators/baseband/src/main/scala/baseband/Controller.scala:108:15, :125:17, :211:46, :213:15]
            state <= 2'h0;	// @[generators/baseband/src/main/scala/baseband/Controller.scala:45:22]
          errorMessageValid <= ~_GEN_3 & errorMessageValid;	// @[generators/baseband/src/main/scala/baseband/Controller.scala:63:34, :108:15, :125:17, :211:46, :213:15, :214:27]
        end
        assemblerReqValid <= ~(_GEN_6 & (_GEN_0 | (io_constants_radioMode ? io_lrwpanAssemblerControl_in_ready & io_lrwpanAssemblerControl_in_valid_0 : io_bleAssemblerControl_in_ready & io_bleAssemblerControl_in_valid_0))) & assemblerReqValid;	// @[generators/baseband/src/main/scala/baseband/Controller.scala:50:34, :74:41, :79:44, :121:34, :125:17, :163:35, :164:27, :185:{26,99}, :187:27, src/main/scala/chisel3/util/Decoupled.scala:52:35]
        modemTXReqValid <= ~(_GEN_6 & (_GEN_0 | io_modemTXControl_in_ready & modemTXReqValid)) & modemTXReqValid;	// @[generators/baseband/src/main/scala/baseband/Controller.scala:53:32, :125:17, :167:39, :168:25, :185:{26,99}, :189:25, src/main/scala/chisel3/util/Decoupled.scala:52:35]
        dmaReqValid <= ~(_GEN_6 & (_GEN_0 | _GEN)) & dmaReqValid;	// @[generators/baseband/src/main/scala/baseband/Controller.scala:56:28, :125:17, :157:33, :158:21, :185:{26,99}, :191:21, src/main/scala/chisel3/util/Decoupled.scala:52:35]
        if (~(_GEN_6 & _GEN_0) | _GEN_1) begin	// @[generators/baseband/src/main/scala/baseband/Controller.scala:64:33, :125:17, :185:{26,99}, :195:{36,56}]
        end
        else	// @[generators/baseband/src/main/scala/baseband/Controller.scala:64:33, :125:17, :185:99, :195:56]
          errorMessageBits <= {17'h0, io_control_cmd_bits_totalBytes, 6'h1};	// @[generators/baseband/src/main/scala/baseband/BasebandISA.scala:72:{8,20}, generators/baseband/src/main/scala/baseband/Controller.scala:64:33]
      end
      done <= ~_GEN_4 & (_GEN_6 ? _GEN_2 : _GEN_3);	// @[generators/baseband/src/main/scala/baseband/Controller.scala:47:21, :108:15, :112:18, :116:14, :125:17, :185:99, :195:56, :197:20, :211:46, :213:15]
      error <= ~(_GEN_4 | _GEN_6) & _GEN_3;	// @[generators/baseband/src/main/scala/baseband/Controller.scala:60:22, :108:15, :125:17, :211:46, :213:15]
      txFinish <= ~_GEN_4 & _GEN_6 & _GEN_2;	// @[generators/baseband/src/main/scala/baseband/Controller.scala:61:25, :112:18, :125:17, :185:99, :195:56, :197:20]
    end
    if (_GEN_4 & io_control_cmd_valid & _GEN_5) begin	// @[generators/baseband/src/main/scala/baseband/Controller.scala:48:16, :125:17, :127:33, :128:{51,93}, :129:15]
      cmd_command <= io_control_cmd_bits_command;	// @[generators/baseband/src/main/scala/baseband/Controller.scala:48:16]
      cmd_addr <= io_control_cmd_bits_addr;	// @[generators/baseband/src/main/scala/baseband/Controller.scala:48:16]
      cmd_totalBytes <= io_control_cmd_bits_totalBytes;	// @[generators/baseband/src/main/scala/baseband/Controller.scala:48:16]
    end
    if (_GEN_4 | ~(_GEN_6 & _GEN_7)) begin	// @[generators/baseband/src/main/scala/baseband/Controller.scala:58:24, :125:17, :171:34, :172:21, src/main/scala/chisel3/util/Decoupled.scala:52:35]
    end
    else	// @[generators/baseband/src/main/scala/baseband/Controller.scala:58:24, :125:17]
      dmaReadResp_bytesRead <= io_dma_readResp_bits_bytesRead;	// @[generators/baseband/src/main/scala/baseband/Controller.scala:58:24]
  end // always @(posedge)
  `ifdef ENABLE_INITIAL_REG_
    `ifdef FIRRTL_BEFORE_INITIAL
      `FIRRTL_BEFORE_INITIAL
    `endif // FIRRTL_BEFORE_INITIAL
    logic [31:0] _RANDOM[0:2];
    initial begin
      `ifdef INIT_RANDOM_PROLOG_
        `INIT_RANDOM_PROLOG_
      `endif // INIT_RANDOM_PROLOG_
      `ifdef RANDOMIZE_REG_INIT
        for (logic [1:0] i = 2'h0; i < 2'h3; i += 2'h1) begin
          _RANDOM[i] = `RANDOM;
        end
        state = _RANDOM[2'h0][1:0];	// @[generators/baseband/src/main/scala/baseband/Controller.scala:45:22]
        done = _RANDOM[2'h0][2];	// @[generators/baseband/src/main/scala/baseband/Controller.scala:45:22, :47:21]
        cmd_command = _RANDOM[2'h0][3];	// @[generators/baseband/src/main/scala/baseband/Controller.scala:45:22, :48:16]
        cmd_addr = {_RANDOM[2'h0][31:4], _RANDOM[2'h1][3:0]};	// @[generators/baseband/src/main/scala/baseband/Controller.scala:45:22, :48:16]
        cmd_totalBytes = _RANDOM[2'h1][12:4];	// @[generators/baseband/src/main/scala/baseband/Controller.scala:48:16]
        assemblerReqValid = _RANDOM[2'h1][13];	// @[generators/baseband/src/main/scala/baseband/Controller.scala:48:16, :50:34]
        assemblerDone = _RANDOM[2'h1][14];	// @[generators/baseband/src/main/scala/baseband/Controller.scala:48:16, :51:30]
        modemTXReqValid = _RANDOM[2'h1][15];	// @[generators/baseband/src/main/scala/baseband/Controller.scala:48:16, :53:32]
        modemTXDone = _RANDOM[2'h1][16];	// @[generators/baseband/src/main/scala/baseband/Controller.scala:48:16, :54:28]
        dmaReqValid = _RANDOM[2'h1][17];	// @[generators/baseband/src/main/scala/baseband/Controller.scala:48:16, :56:28]
        dmaRespReady = _RANDOM[2'h1][18];	// @[generators/baseband/src/main/scala/baseband/Controller.scala:48:16, :57:29]
        dmaReadResp_bytesRead = _RANDOM[2'h1][27:19];	// @[generators/baseband/src/main/scala/baseband/Controller.scala:48:16, :58:24]
        error = _RANDOM[2'h1][28];	// @[generators/baseband/src/main/scala/baseband/Controller.scala:48:16, :60:22]
        txFinish = _RANDOM[2'h1][29];	// @[generators/baseband/src/main/scala/baseband/Controller.scala:48:16, :61:25]
        errorMessageValid = _RANDOM[2'h1][30];	// @[generators/baseband/src/main/scala/baseband/Controller.scala:48:16, :63:34]
        errorMessageBits = {_RANDOM[2'h1][31], _RANDOM[2'h2][30:0]};	// @[generators/baseband/src/main/scala/baseband/Controller.scala:48:16, :64:33]
      `endif // RANDOMIZE_REG_INIT
    end // initial
    `ifdef FIRRTL_AFTER_INITIAL
      `FIRRTL_AFTER_INITIAL
    `endif // FIRRTL_AFTER_INITIAL
  `endif // ENABLE_INITIAL_REG_
  assign io_interrupt_error = error;	// @[generators/baseband/src/main/scala/baseband/Controller.scala:60:22]
  assign io_interrupt_txFinish = txFinish;	// @[generators/baseband/src/main/scala/baseband/Controller.scala:61:25]
  assign io_bleAssemblerControl_in_valid = io_bleAssemblerControl_in_valid_0;	// @[generators/baseband/src/main/scala/baseband/Controller.scala:74:41]
  assign io_bleAssemblerControl_in_bits_aa = io_constants_accessAddress;
  assign io_bleAssemblerControl_in_bits_pduLength = cmd_totalBytes[7:0] - 8'h2;	// @[generators/baseband/src/main/scala/baseband/Controller.scala:48:16, :75:62]
  assign io_lrwpanAssemblerControl_in_valid = io_lrwpanAssemblerControl_in_valid_0;	// @[generators/baseband/src/main/scala/baseband/Controller.scala:79:44]
  assign io_lrwpanAssemblerControl_in_bits_pduLength = cmd_totalBytes[7:0];	// @[generators/baseband/src/main/scala/baseband/Controller.scala:48:16, :80:47]
  assign io_modemTXControl_in_valid = modemTXReqValid;	// @[generators/baseband/src/main/scala/baseband/Controller.scala:53:32]
  assign io_modemTXControl_in_bits_totalBytes = cmd_totalBytes;	// @[generators/baseband/src/main/scala/baseband/Controller.scala:48:16]
  assign io_dma_readReq_valid = dmaReqValid;	// @[generators/baseband/src/main/scala/baseband/Controller.scala:56:28]
  assign io_dma_readReq_bits_addr = cmd_addr;	// @[generators/baseband/src/main/scala/baseband/Controller.scala:48:16]
  assign io_dma_readReq_bits_totalBytes = cmd_totalBytes;	// @[generators/baseband/src/main/scala/baseband/Controller.scala:48:16]
  assign io_control_done = done;	// @[generators/baseband/src/main/scala/baseband/Controller.scala:47:21]
  assign io_messages_txErrorMessage_valid = errorMessageValid;	// @[generators/baseband/src/main/scala/baseband/Controller.scala:63:34]
  assign io_messages_txErrorMessage_bits = errorMessageBits;	// @[generators/baseband/src/main/scala/baseband/Controller.scala:64:33]
  assign io_state = state;	// @[generators/baseband/src/main/scala/baseband/Controller.scala:45:22]
endmodule

